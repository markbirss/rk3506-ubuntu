## buildroot/configs/rockchip_rv1126b_32_defconfig
```kconfig
#include "base/base.config"
#include "wifibt/bt.config"
#include "wifibt/wireless.config"
#include "chips/rk3576_arm.config"
#include "toolchain/arm_10_armhf.config"
BR2_PACKAGE_ALSA_UTILS=y
BR2_PACKAGE_ALSA_UTILS_AMIXER=y
BR2_PACKAGE_ANDROID_ADBD=y
# BR2_PACKAGE_EUDEV_ENABLE_HWDB is not set
BR2_PACKAGE_GST1_PLUGINS_BAD=y
BR2_PACKAGE_GST1_PLUGINS_BAD_PLUGIN_FAAD=y
BR2_PACKAGE_GST1_PLUGINS_BAD_PLUGIN_KMS=y
BR2_PACKAGE_GST1_PLUGINS_BAD_PLUGIN_VIDEOPARSERS=y
BR2_PACKAGE_GST1_PLUGINS_BASE_INSTALL_TOOLS=y
BR2_PACKAGE_GST1_PLUGINS_BASE_PLUGIN_ALSA=y
# BR2_PACKAGE_GST1_PLUGINS_BASE_PLUGIN_AUDIOCONVERT is not set
# BR2_PACKAGE_GST1_PLUGINS_BASE_PLUGIN_VIDEOCONVERTSCALE is not set
BR2_PACKAGE_GST1_PLUGINS_GOOD=y
BR2_PACKAGE_GST1_PLUGINS_GOOD_PLUGIN_AUTODETECT=y
# BR2_PACKAGE_GST1_PLUGINS_GOOD_PLUGIN_AVI is not set
# BR2_PACKAGE_GST1_PLUGINS_GOOD_PLUGIN_WAVPARSE is not set
BR2_PACKAGE_GSTREAMER1=y
BR2_PACKAGE_GSTREAMER1_ROCKCHIP=y
# BR2_PACKAGE_RKTOOLKIT is reset to default
BR2_PACKAGE_ROCKCHIP_MPP=y
BR2_PACKAGE_ROCKCHIP_RGA=y
BR2_PACKAGE_ROCKIT=y
BR2_PACKAGE_WAYLAND=y
BR2_ROOTFS_DEVICE_CREATION_DYNAMIC_EUDEV=y
BR2_STRIP_EXCLUDE_FILES="libgraphic_lsf.so"
BR2_TARGET_GENERIC_HOSTNAME="rv1126b"
BR2_TARGET_GENERIC_ISSUE="Welcome to RV1126b Buildroot"
BR2_TARGET_ROOTFS_SQUASHFS4_XZ=y
```

## buildroot/package/android-adb/Config.in
```kconfig
config BR2_PACKAGE_ANDROID_ADB
	bool "android-adb"
	depends on !BR2_PACKAGE_ANDROID_TOOLS_ADB
  select BR2_PACKAGE_LIBUSB
	select BR2_PACKAGE_OPENSSL
	help
	  Client tool for Android Debug Bridge.

if BR2_PACKAGE_ANDROID_ADB

config BR2_PACKAGE_ANDROID_ADB_STATIC
	bool "Enable static"
  select BR2_PACKAGE_LIBUSB_STATIC
	default y if BR2_STATIC_LIBS

endif
```

## buildroot/package/android-adbd/Config.in
```kconfig
config BR2_PACKAGE_ANDROID_ADBD
	bool "android-adbd"
	depends on !BR2_PACKAGE_ANDROID_TOOLS_ADBD
	select BR2_PACKAGE_OPENSSL
	help
	  Daemon for Android Debug Bridge.

if BR2_PACKAGE_ANDROID_ADBD

config BR2_PACKAGE_ANDROID_ADBD_STATIC
	bool "Enable static"
	default y if BR2_STATIC_LIBS

config BR2_PACKAGE_ANDROID_ADBD_TCP_PORT
	int "adbd TCP port"
	default 0

config BR2_PACKAGE_ANDROID_ADBD_SECURE
	bool "adbd secure"

if BR2_PACKAGE_ANDROID_ADBD_SECURE

config BR2_PACKAGE_ANDROID_ADBD_PASSWORD
	string "adbd password"

config BR2_PACKAGE_ANDROID_ADBD_KEYS
	string "Android public keys"
	default "~/.android/adbkey.pub" if BR2_PACKAGE_ANDROID_ADBD_PASSWORD = ""

endif

endif
```

## buildroot/package/coremark/Config.in
```kconfig
config BR2_PACKAGE_COREMARK
	bool "coremark"
	help
	  CoreMark is a benchmark that measures the performance of
	  microcontrollers (MCUs) and central processing units (CPUs)
	  used in embedded systems

	  https://www.eembc.org/coremark/

if BR2_PACKAGE_COREMARK

config BR2_PACKAGE_COREMARK_STATIC
	bool "Enable static"
	default y if BR2_STATIC_LIBS

endif
```

## buildroot/package/dhrystone/Config.in
```kconfig
config BR2_PACKAGE_DHRYSTONE
	bool "dhrystone"
	help
	  easy-to-use integer benchmark

	  http://www.netlib.org/benchmark/dhry-c

if BR2_PACKAGE_DHRYSTONE

config BR2_PACKAGE_DHRYSTONE_STATIC
	bool "Enable static"
	default y if BR2_STATIC_LIBS

endif
```

## buildroot/package/flutter-embedded-linux/Config.in
```kconfig
menuconfig BR2_PACKAGE_FLUTTER_EMBEDDED_LINUX
	bool "flutter-embedded-linux"
	depends on BR2_PACKAGE_HOST_FLUTTER_SDK_BIN_ARCH_SUPPORTS
	depends on BR2_PACKAGE_FLUTTER_ENGINE_ARCH_SUPPORTS
	depends on BR2_HOST_GCC_AT_LEAST_5 # flutter-engine
	depends on BR2_TOOLCHAIN_GCC_AT_LEAST_5 # flutter-engine
	depends on !BR2_TOOLCHAIN_HAS_GCC_BUG_64735 # flutter-engine
	depends on BR2_TOOLCHAIN_USES_GLIBC # flutter-engine
	depends on BR2_INSTALL_LIBSTDCPP # flutter-engine
	depends on !BR2_STATIC_LIBS # flutter-engine, wayland
	depends on BR2_USE_WCHAR # flutter-engine
	depends on BR2_PACKAGE_HAS_LIBGLES # flutter-engine
	depends on BR2_PACKAGE_WAYLAND
	select BR2_PACKAGE_HOST_FLUTTER_SDK_BIN
	select BR2_PACKAGE_FLUTTER_ENGINE
	select BR2_PACKAGE_LIBXKBCOMMON
	help
	  Embedded Linux embedding for Flutter.

	  https://github.com/sony/flutter-embedded-linux

if BR2_PACKAGE_FLUTTER_EMBEDDED_LINUX

config BR2_PACKAGE_FLUTTER_EMBEDDED_LINUX_SO
	bool "build elinux .so"

endif
```

## buildroot/package/frecon/Config.in
```kconfig
config BR2_PACKAGE_FRECON
	bool "frecon"
	depends on BR2_INSTALL_LIBSTDCPP
	depends on BR2_PACKAGE_HAS_UDEV
	select BR2_PACKAGE_LIBDRM
	select BR2_PACKAGE_LIBPNG
	select BR2_PACKAGE_LIBTSM
	help
	  This is a terminal emulator that replaces the kernel Virtual
	  Terminal (VT) console.  It uses the Kernel Mode Setting (KMS)
	  support in the kernel.  It is similar to the kmscon project:
	    https://www.freedesktop.org/wiki/Software/kmscon

if BR2_PACKAGE_FRECON

config BR2_PACKAGE_FRECON_USE_GETTY
	bool "use getty"
	default n if BR2_TARGET_SERIAL_SHELL_SH

config BR2_PACKAGE_FRECON_VTS
	bool "enable vts"
	default y

config BR2_PACKAGE_FRECON_VT1
	bool "enable vt1"
	default y if !BR2_PACKAGE_WESTON && !BR2_PACKAGE_XORG7

config BR2_PACKAGE_FRECON_ROTATE
	int
	default 270 if BR2_PACKAGE_FRECON_ROTATE_270
	default 180 if BR2_PACKAGE_FRECON_ROTATE_180
	default 90 if BR2_PACKAGE_FRECON_ROTATE_90
	default 0

choice
	prompt "frecon rotate"
	default BR2_PACKAGE_FRECON_ROTATE_0

config BR2_PACKAGE_FRECON_ROTATE_0
	bool "0"

config BR2_PACKAGE_FRECON_ROTATE_90
	bool "90"

config BR2_PACKAGE_FRECON_ROTATE_180
	bool "180"

config BR2_PACKAGE_FRECON_ROTATE_270
	bool "270"

endchoice

config BR2_PACKAGE_FRECON_OUTPUT_CONFIG
	string "custom output configs"
	help
	  <monitor name>=<fit|strech>:<0|90|180|270>
	  For example:
	    DSI-1=fit:90,HDMI-A-2=strech:270

config BR2_PACKAGE_FRECON_SCALE
	int "frecon scale"
	range 1 100

config BR2_PACKAGE_FRECON_STATIC
	bool "Enable static"
	select BR2_PACKAGE_EUDEV_STATIC if BR2_PACKAGE_EUDEV
	select BR2_PACKAGE_LIBDRM_STATIC
	select BR2_PACKAGE_LIBPNG_STATIC
	select BR2_PACKAGE_LIBTSM_STATIC
	default y if BR2_STATIC_LIBS

endif
```

## buildroot/package/labwc/Config.in
```kconfig
config BR2_PACKAGE_LABWC
	bool "labwc"
	depends on !BR2_STATIC_LIBS # wlroots
	depends on BR2_TOOLCHAIN_HAS_THREADS # wlroots
	depends on BR2_PACKAGE_HAS_LIBEGL # wlroots
	depends on BR2_PACKAGE_HAS_LIBEGL_WAYLAND # wlroots
	depends on BR2_PACKAGE_HAS_LIBGLES # wlroots
	depends on BR2_PACKAGE_HAS_UDEV # wlroots
	depends on BR2_PACKAGE_XKEYBOARD_CONFIG
	select BR2_PACKAGE_LIBRSVG
	select BR2_PACKAGE_WLROOTS
	help
	  A Wayland window-stacking compositor.

	  https://github.com/labwc/labwc
```

## buildroot/package/liblockfile/Config.in
```kconfig
config BR2_PACKAGE_LIBLOCKFILE
	bool "liblockfile"
	depends on BR2_USE_MMU # fork()
	help
	  NFS-safe locking library.

	  https://github.com/miquels/liblockfile

if BR2_PACKAGE_LIBLOCKFILE

config BR2_PACKAGE_LIBLOCKFILE_STATIC
	bool "Enable static"
	default y if BR2_STATIC_LIBS

endif
```

## buildroot/package/libpng/Config.in
```kconfig
config BR2_PACKAGE_LIBPNG
	bool "libpng"
	select BR2_PACKAGE_ZLIB
	help
	  Library for handling PNG (Portable Network Graphics)
	  images.

	  http://www.libpng.org/

if BR2_PACKAGE_LIBPNG

config BR2_PACKAGE_LIBPNG_STATIC
	bool "Enable static"
	default y if BR2_STATIC_LIBS

endif
```

## buildroot/package/libtsm/Config.in
```kconfig
menuconfig BR2_PACKAGE_LIBTSM
	bool "libtsm"
	select BR2_PACKAGE_LIBXKBCOMMON
	help
		TSM is a state machine for DEC VT100-VT520
		compatible terminal emulators. It tries to
		support all common standards while keeping
		compatibility to existing emulators.

		https://github.com/Aetf/libtsm

if BR2_PACKAGE_LIBTSM

config BR2_PACKAGE_LIBTSM_STATIC
	bool "Enable static"
	default y if BR2_STATIC_LIBS

endif
```

## buildroot/package/lockfile-progs/Config.in
```kconfig
config BR2_PACKAGE_LOCKFILE_PROGS
	bool "lockfile programs"
	depends on BR2_USE_MMU # liblockfile
	select BR2_PACKAGE_LIBLOCKFILE
	help
	  Build lockfile utility programs.

if BR2_PACKAGE_LOCKFILE_PROGS

config BR2_PACKAGE_LOCKFILE_PROGS_STATIC
	bool "Enable static"
	depends on BR2_PACKAGE_LIBLOCKFILE_STATIC
	default y if BR2_STATIC_LIBS

endif
```

## buildroot/package/lvgl/Config.in
```kconfig
# LVGL - Light and Versatile Graphics Library
menuconfig BR2_PACKAGE_LVGL
	bool "LVGL"
	default n
	help
	  Light and Versatile Graphics Library

	choice BR2_PACKAGE_LVGL_VERSION
		prompt "LVGL Version."
		default BR2_PACKAGE_LVGL_VERSION_8
		depends on BR2_PACKAGE_LVGL
		help
		  Select LVGL version.

		config BR2_PACKAGE_LVGL_VERSION_8
			bool "v8.x"
		config BR2_PACKAGE_LVGL_VERSION_9
			bool "v9.x"
	endchoice

if BR2_PACKAGE_LVGL
	if BR2_PACKAGE_LVGL_VERSION_8
		source "package/lvgl/lvgl/8.4.0/Config.in"
		source "package/lvgl/lv_drivers/Config.in"
	endif

	if BR2_PACKAGE_LVGL_VERSION_9
		source "package/lvgl/lvgl/9.1/Config.in"
	endif
endif
```

## buildroot/package/lvgl/lv_drivers/Config.in
```kconfig
config BR2_PACKAGE_LV_DRIVERS
	bool "lv-drivers"
	default n
	help
	  The concrete implementation of hardware

if BR2_PACKAGE_LV_DRIVERS
	config BR2_LV_DRIVERS_USE_SDL_GPU
		bool "Use SDL to open window on PC and handle mouse and keyboard"
		default y if LV_USE_GPU_SDL
		help
		  Enbale sdl renderer

	config BR2_LV_DRIVERS_USE_OPENGL
		bool "Enable OpenGLES"
		depends on BR2_LV_DRIVERS_USE_SDL_GPU
		help
		  Enbale OpenGLES

	config BR2_LV_DRIVERS_USE_DRM
		bool "Use Linux DRM device"
		select BR2_PACKAGE_LIBDRM
		help
		  Enbale drm renderer

	config BR2_LV_DRIVERS_USE_RGA
		bool "Use RGA in DRM rendering"
		default n
		depends on BR2_PACKAGE_ROCKCHIP_RGA
		depends on BR2_LV_DRIVERS_USE_DRM
		help
		  Enbale RGA to copy image

	config BR2_LV_DRIVERS_USE_RKADK
		bool "Use RKADK"
		select BR2_PACKAGE_RKADK
		select BR2_PACKAGE_RKADK_PLAYER
		select BR2_PACKAGE_RKADK_DISPLAY
		help
		  Enbale rkadk renderer
endif
```

## buildroot/package/memtester/Config.in
```kconfig
config BR2_PACKAGE_MEMTESTER
	bool "memtester"
	help
	  A userspace utility for testing the memory subsystem for
	  faults.

	  http://pyropus.ca/software/memtester/

if BR2_PACKAGE_MEMTESTER

config BR2_PACKAGE_MEMTESTER_STATIC
	bool "Enable static"
	default y if BR2_STATIC_LIBS

endif
```

## buildroot/package/mupen64plus/Config.in
```kconfig
config BR2_PACKAGE_MUPEN64PLUS
	bool "mupen64plus"
        help
	  https://mupen64plus.org/

if BR2_PACKAGE_MUPEN64PLUS
	source "package/mupen64plus/mupen64plus-core/Config.in"
	source "package/mupen64plus/mupen64plus-ui-console/Config.in"
	source "package/mupen64plus/mupen64plus-audio-sdl/Config.in"
	source "package/mupen64plus/mupen64plus-input-sdl/Config.in"
	source "package/mupen64plus/mupen64plus-rsp-cxd4/Config.in"
	source "package/mupen64plus/mupen64plus-rsp-hle/Config.in"
	source "package/mupen64plus/mupen64plus-rsp-parallel/Config.in"
	source "package/mupen64plus/mupen64plus-rsp-z64/Config.in"
	source "package/mupen64plus/mupen64plus-video-gles2n64/Config.in"
	source "package/mupen64plus/mupen64plus-video-glide64mk2/Config.in"
	source "package/mupen64plus/mupen64plus-video-gliden64/Config.in"
	source "package/mupen64plus/mupen64plus-video-rice/Config.in"
endif
```

## buildroot/package/mupen64plus/mupen64plus-audio-sdl/Config.in
```kconfig
config BR2_PACKAGE_MUPEN64PLUS_AUDIO_SDL
        bool "mupen64plus-audio-sdl"
	depends on BR2_PACKAGE_MUPEN64PLUS_CORE
	depends on BR2_PACKAGE_SDL2
        help
          mupen64plus audio sdl.

	  https://mupen64plus.org/
```

## buildroot/package/mupen64plus/mupen64plus-core/Config.in
```kconfig
config BR2_PACKAGE_MUPEN64PLUS_CORE
        bool "mupen64plus-core"
	depends on BR2_PACKAGE_SDL2
	depends on BR2_INSTALL_LIBSTDCPP
	depends on BR2_PACKAGE_LIBPNG
	depends on BR2_PACKAGE_ZLIB
	default y
        help
          mupen64plus core.

	  https://mupen64plus.org/
```

## buildroot/package/mupen64plus/mupen64plus-input-sdl/Config.in
```kconfig
config BR2_PACKAGE_MUPEN64PLUS_INPUT_SDL
        bool "mupen64plus-input-sdl"
	depends on BR2_PACKAGE_MUPEN64PLUS_CORE
	depends on BR2_PACKAGE_SDL2
        help
          mupen64plus input sdl.

	  https://mupen64plus.org/
```

## buildroot/package/mupen64plus/mupen64plus-rsp-cxd4/Config.in
```kconfig
config BR2_PACKAGE_MUPEN64PLUS_RSP_CXD4
        bool "mupen64plus-video-rsp-cxd4"
	depends on BR2_PACKAGE_MUPEN64PLUS_CORE
        help
          mupen64plus rsp cxd4.

	  https://mupen64plus.org/
```

## buildroot/package/mupen64plus/mupen64plus-rsp-hle/Config.in
```kconfig
config BR2_PACKAGE_MUPEN64PLUS_RSP_HLE
        bool "mupen64plus-video-rsp-hle"
	depends on BR2_PACKAGE_MUPEN64PLUS_CORE
        help
          mupen64plus rsp hle.

	  https://mupen64plus.org/
```

## buildroot/package/mupen64plus/mupen64plus-rsp-parallel/Config.in
```kconfig
config BR2_PACKAGE_MUPEN64PLUS_RSP_PARALLEL
        bool "mupen64plus-video-rsp-parallel"
	depends on BR2_PACKAGE_MUPEN64PLUS_CORE
        help
          mupen64plus rsp parallel.

	  https://github.com/Mastergatto/parallel-rsp.
```

## buildroot/package/mupen64plus/mupen64plus-rsp-z64/Config.in
```kconfig
config BR2_PACKAGE_MUPEN64PLUS_RSP_Z64
        bool "mupen64plus-video-rsp-z64"
	depends on BR2_PACKAGE_MUPEN64PLUS_CORE
        help
          mupen64plus rsp z64.

	  https://mupen64plus.org/
```
