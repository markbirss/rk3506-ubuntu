## hal/project/rk3576-64/Image/smp.its
```
/* SPDX-License-Identifier: BSD-3-Clause */
/*
 * Copyright (c) 2024 Rockchip Electronics Co., Ltd.
 */

/dts-v1/;
/ {
	description = "FIT source file for rockchip AMP";
	#address-cells = <1>;

	images {

		amp0 {
			description  = "bare-mental-core0";
			data         = /incbin/("hal0.bin");
			type         = "firmware";
			compression  = "none";
			arch         = "arm64";	 // "arm64" or "arm"
			cpu          = <0x000>;  // mpidr
			thumb        = <0>;      // 0: arm or thumb2; 1: thumb
			hyp          = <0>;      // 0: el1/svc; 1: el2/hyp
			load         = <0x44000000>;
			size         = <0x00800000>;
			srambase     = <0x3ff80000>;
			sramsize     = <0x00080000>;
			udelay       = <10000>;
			hash {
				algo = "sha256";
			};
		};

	};

	share_memory {
		base         = <0x47800000>;
		size         = <0x00400000>;
	};

	configurations {
		default = "conf";
		conf {
			description = "Rockchip AMP images";
			rollback-index = <0x0>;
			loadables = "amp0";

			signature {
				algo = "sha256,rsa2048";
				padding = "pss";
				key-name-hint = "dev";
				sign-images = "loadables";
			};
		};
	};
};
```

## hal/project/rv1103/Image/hal.its
```
/*
 * Copyright (C) 2023 Rockchip Electronic Co.,Ltd
 *
 * Simple U-boot fit source file containing ATF/OP-TEE/U-Boot/dtb/MCU
 */

/dts-v1/;

/ {
	description = "FIT Image with RT-thread";
	#address-cells = <1>;

	images {

		hal {
			description = "Bare Metal";
			data = /incbin/("../GCC/TestDemo.bin");
			type = "standalone";
			arch = "arm";
			os = "rtos";
			load = <0x00200000>;
			udelay = <10000>;
			hash {
				algo = "sha256";
			};
		};
	};

	configurations {
		default = "conf";
		conf {
			description = "rv1103-rtt";
			loadables = "rt-thread";
			signature {
				algo = "sha26,rsa2048";
				key-name-hint = "dev";
				sign-images = "loadables";
			};
		};
	};
};
```
