## buildroot/package/rockchip/rockchip-uac-app/Config.in
```kconfig
config BR2_PACKAGE_ROCKCHIP_UAC_APP
	bool "rockchip-uac-app"
	depends on BR2_PACKAGE_ROCKIT
	help
	  Rockchip uac app.
```

## buildroot/package/rockchip/rockchip-uvc-app/Config.in
```kconfig
config BR2_PACKAGE_ROCKCHIP_UVC_APP
    bool "rockchip uvc app"
    select BR2_PACKAGE_LIBDRM
```

## buildroot/package/rockchip/rockit-uvc/Config.in
```kconfig
config BR2_PACKAGE_ROCKIT_UVC
    bool "rockit uvc"
    depends on BR2_PACKAGE_ROCKIT
    depends on BR2_PACKAGE_ROCKCHIP_UVC_APP
```

## buildroot/package/rockchip/rockit/Config.in
```kconfig
config BR2_PACKAGE_ROCKIT
	bool "rockit"
	select BR2_PACKAGE_ALSA_PLUGINS
	default n
	help
		rockit
```

## buildroot/package/stressapptest/Config.in
```kconfig
config BR2_PACKAGE_STRESSAPPTEST
	bool "stressapptest"
	help
	  Stressful Application Test - userspace memory and IO test.

	  https://github.com/stressapptest/stressapptest

if BR2_PACKAGE_STRESSAPPTEST

config BR2_PACKAGE_STRESSAPPTEST_STATIC
	bool "Enable static"
	default y if BR2_STATIC_LIBS

endif
```

## buildroot/package/tcp-wrappers/Config.in
```kconfig
config BR2_PACKAGE_TCP_WRAPPERS
	bool "tcp-wrappers"
	help
	  TCP/IP daemon wrapper package.

	  http://ftp.porcupine.org/pub/security/index.html
```

## buildroot/package/umtprd/Config.in
```kconfig
config BR2_PACKAGE_UMTPRD
	bool "umtprd"
	depends on BR2_TOOLCHAIN_HAS_THREADS
	depends on BR2_TOOLCHAIN_HEADERS_AT_LEAST_3_15
	help
	  Lightweight USB MTP responder daemon for GNU/Linux

	  https://github.com/viveris/uMTP-Responder

comment "umtprd needs a toolchain w/ threads, headers >= 3.15"
	depends on !BR2_TOOLCHAIN_HAS_THREADS || !BR2_TOOLCHAIN_HEADERS_AT_LEAST_3_15

if BR2_PACKAGE_UMTPRD

config BR2_PACKAGE_UMTPRD_USE_SYSLOG
	bool "Use syslog"
	default y

config BR2_PACKAGE_UMTPRD_STATIC
	bool "Enable static"
	default y if BR2_STATIC_LIBS

endif
```

## buildroot/package/uvc-gadget/Config.in
```kconfig
config BR2_PACKAGE_UVC_GADGET
	bool "uvc-gadget"
	depends on BR2_PACKAGE_JPEG
	depends on BR2_TOOLCHAIN_HAS_THREADS
	help
	  uvcgadget is a pure C library that implements handling of UVC gadget
	  functions.

	  https://gitlab.freedesktop.org/camera/uvc-gadget

if BR2_PACKAGE_UVC_GADGET

config BR2_PACKAGE_UVC_GADGET_STATIC
	bool "Enable static"
	depends on BR2_PACKAGE_JPEG_TURBO_STATIC
	default y if BR2_STATIC_LIBS

endif
```

## device/rockchip/.chips/rk3506/amp_linux_mcu.its
```
/* SPDX-License-Identifier: BSD-3-Clause */
/*
 * Copyright (c) 2024 Rockchip Electronics Co., Ltd.
 */

/dts-v1/;
/ {
	description = "FIT source file for rockchip AMP";
	#address-cells = <1>;

	images {
		amp2 {
			description  = "rtos-core2";
			data         = /incbin/("rtt2.bin");
			type         = "firmware";
			compression  = "none";
			arch         = "arm";	 // "arm64" or "arm"
			cpu          = <0xf02>;  // mpidr
			thumb        = <0>;      // 0: arm or thumb2; 1: thumb
			hyp          = <0>;      // 0: el1/svc; 1: el2/hyp
			load         = <0x03e00000>;
			srambase     = <0xfff80000>;
			sramsize     = <0x0000c000>;
			compile {
				size     = <0x00100000>;
				sys      = "rtt";
				core     = "ap";
				rtt_config = "board/evb1/defconfig";
			};
			udelay       = <10000>;
			hash {
				algo = "sha256";
			};
		};
		mcu {
			description = "mcu";
			data = /incbin/("mcu.bin");
			type = "standalone"; // must be "standalone"
			compression = "none";
			arch = "arm"; // "arm64" or "arm", the same as UBoot state
			load = <0xfff84000>;
			compile {
				size = <0x00800000>;
				sys = "hal";
				core = "mcu"; // core type: ap or mcu
			};
			udelay = <1000000>;
			hash {
				algo = "sha256";
			};
		};
	};

	share {
		rpmsg_base       = <0x03c00000>;
		rpmsg_size       = <0x00200000>;
	};

	configurations {
		default = "conf";
		conf {
			description = "Rockchip AMP images";
			rollback-index = <0x0>;
			loadables = "amp2";

			signature {
				algo = "sha256,rsa2048";
				padding = "pss";
				key-name-hint = "dev";
				sign-images = "loadables";
			};

			/* - run linux on cpu0
			 * - it is brought up by amp(that run on U-Boot)
			 * - it is boot entry depends on U-Boot
			 */
			linux {
				description  = "linux-os";
				arch         = "arm";
				cpu          = <0xf00>;
				thumb        = <0>;
				hyp          = <0>;
				load         = <0x00900000>;
				udelay       = <0>;
			};
		};
	};
};
```

## device/rockchip/common/configs/Config.in
```kconfig
#

mainmenu "Rockchip Linux SDK Configuration"

config RK_DEFCONFIG_FROM_ENV
	string
	option env="RK_DEFCONFIG"

config RK_DEFCONFIG
	string "Name of defconfig to save"
	default RK_DEFCONFIG_FROM_ENV if RK_DEFCONFIG_FROM_ENV != ""
	default "rockchip_defconfig"
	help
	  When running 'make savedefconfig', the defconfig file will be
	  saved under this name.

config RK_CHIP_FAMILY_FROM_ENV
	string
	option env="RK_CHIP_FAMILY"

config RK_CHIP_FAMILY
	string
	default RK_CHIP_FAMILY_FROM_ENV if RK_CHIP_FAMILY_FROM_ENV != ""
	help
	  Rockchip SoC family, available chip familys are in
	  <SDK>/device/rockchip/.

config RK_CHIP_FROM_ENV
	string
	option env="RK_CHIP"

config RK_CHIP
	string
	default RK_CHIP_FROM_ENV if RK_CHIP_FROM_ENV != ""
	default RK_CHIP_FAMILY
	help
	  Rockchip SoC.

config RK_CHIP_ARM32
	bool
	depends on RK_CHIP_FAMILY = "px3se" || RK_CHIP_FAMILY = "rk3036" || \
		RK_CHIP_FAMILY = "rk3128h" || RK_CHIP_FAMILY = "rk312x" || \
		RK_CHIP_FAMILY = "rk3229" || RK_CHIP_FAMILY = "rk3288" || \
		RK_CHIP_FAMILY = "rv1126_rv1109" || RK_CHIP_FAMILY = "rk3506"
	default y

config RK_CHIP_HAS_GPU
	bool
	default n if RK_CHIP_FAMILY = "rk1806" || RK_CHIP_FAMILY = "rk1808" || \
		RK_CHIP_FAMILY = "rk3229" || RK_CHIP_FAMILY = "rk3308" || \
		RK_CHIP_FAMILY = "rk3358" || RK_CHIP_FAMILY = "rv1126_rv1109" || \
		RK_CHIP_FAMILY = "rk3506"
	default y

source "Config.in.rootfs"
source "Config.in.loader"
source "Config.in.amp"
source "Config.in.kernel"
source "Config.in.boot"
source "Config.in.recovery"
source "Config.in.security"
source "Config.in.extra-parts"
source "Config.in.firmware"
source "Config.in.update"
source "Config.in.others"
```

## external/rkwifibt/drivers/rk960/Kconfig
```kconfig
config RK960
       tristate "RK960 WLAN support"
       select MAC80211
       select CFG80211
       help

           Rockchip RK960 Wireless drivers
```

## external/rockit/Kconfig
```kconfig
menuconfig RT_USING_ROCKIT
    bool "rockit"
    select RT_USING_POSIX_FS
    select RT_USING_POSIX_DEVIO
    select RT_USING_POSIX_POLL
    select RT_USING_POSIX_SELECT
    select RT_USING_POSIX_DELAY
    select RT_USING_POSIX_CLOCK
    select RT_USING_POSIX_PIPE
    select RT_USING_POSIX_MESSAGE_SEMAPHORE
    select RT_USING_RTC
    select RT_USING_SOFT_RTC
    select RT_USING_POSIX_STDIO
    select RT_USING_PTHREADS
    select RT_USING_DFS
    select RT_USING_UNCACHE_HEAP
    default n
    help
        rockit: light-weight multimedia api

if RT_USING_ROCKIT
    config RT_USING_ROCKIT_VI
        bool "vi"
        default n
        help
            rockit video input module

    config RT_USING_ROCKIT_VPSS
        bool "vpss"
        default n
        help
            rockit video process module

    config RT_USING_ROCKIT_VENC
        bool "venc"
        default n
        help
            rockit video encoder module

    config RT_USING_ROCKIT_VDEC
        bool "vdec"
        default y
        help
            rockit video decoder module

    config RT_USING_ROCKIT_VO
        bool "vo"
        default y
        help
            rockit video output module

    config RT_USING_ROCKIT_TDE
        bool "tde"
        default y
        help
            rockit video Two Dimensional Engine module

    config RT_USING_ROCKIT_VGS
        bool "vgs"
        default n
        help
            rockit video Graphics sub system module

    config RT_USING_ROCKIT_AVS
        bool "avs"
        default n
        help
            rockit Any View Stitching system module

    config RT_USING_ROCKIT_RGN
        bool "rgn"
        default y
        help
            rockit region manange module

    config RT_USING_ROCKIT_AI
        bool "ai"
        default y
        help
            rockit Audio input module

    config RT_USING_ROCKIT_AO
        bool "ao"
        default y
        help
            rockit Audio output module

    config RT_USING_ROCKIT_ADEC
        bool "adec"
        default y
        help
            rockit Audio decoder module

    config RT_USING_ROCKIT_AENC
        bool "aenc"
        default y
        help
            rockit Audio encoder module

endif
```

## hal/project/rk3576-64/Image/amp.its
```
/* SPDX-License-Identifier: BSD-3-Clause */
/*
 * Copyright (c) 2024 Rockchip Electronics Co., Ltd.
 */

/dts-v1/;
/ {
	description = "FIT source file for rockchip AMP";
	#address-cells = <1>;

	images {

		amp0 {
			description  = "bare-mental-core0";
			data         = /incbin/("hal0.bin");
			type         = "firmware";
			compression  = "none";
			arch         = "arm64";	 // "arm64" or "arm"
			cpu          = <0x000>;  // mpidr
			thumb        = <0>;      // 0: arm or thumb2; 1: thumb
			hyp          = <0>;      // 0: el1/svc; 1: el2/hyp
			load         = <0x44000000>;
			size         = <0x00800000>;
			srambase     = <0x3FF80000>;
			sramsize     = <0x00080000>;
			udelay       = <10000>;
			hash {
				algo = "sha256";
			};
		};

		amp1 {
			description  = "bare-mental-core1";
			data         = /incbin/("hal1.bin");
			type         = "firmware";
			compression  = "none";
			arch         = "arm64";	 // "arm64" or "arm"
			cpu          = <0x001>;  // mpidr
			thumb        = <0>;      // 0: arm or thumb2; 1: thumb
			hyp          = <0>;      // 0: el1/svc; 1: el2/hyp
			load         = <0x40800000>;
			size         = <0x00800000>;
			srambase     = <0x3FF80000>;
			sramsize     = <0x00080000>;
			udelay       = <10000>;
			hash {
				algo = "sha256";
			};
		};

		amp2 {
			description  = "bare-mental-core2";
			data         = /incbin/("hal2.bin");
			type         = "firmware";
			compression  = "none";
			arch         = "arm64";	 // "arm64" or "arm"
			cpu          = <0x002>;  // mpidr
			thumb        = <0>;      // 0: arm or thumb2; 1: thumb
			hyp          = <0>;      // 0: el1/svc; 1: el2/hyp
			load         = <0x41000000>;
			size         = <0x00800000>;
			srambase     = <0x3FF80000>;
			sramsize     = <0x00080000>;
			udelay       = <10000>;
			hash {
				algo = "sha256";
			};
		};

		amp3 {
			description  = "rtt-core3";
			data         = /incbin/("rtt3.bin");
			type         = "firmware";
			compression  = "none";
			arch         = "arm64";	 // "arm64" or "arm"
			cpu          = <0x003>;  // mpidr
			thumb        = <0>;      // 0: arm or thumb2; 1: thumb
			hyp          = <0>;      // 0: el1/svc; 1: el2/hyp
			load         = <0x41800000>;
			size         = <0x00800000>;
			srambase     = <0x3FF80000>;
			sramsize     = <0x00080000>;
			udelay       = <20000>;
			hash {
				algo = "sha256";
			};
		};

		amp4 {
			description  = "bare-mental-core4";
			data         = /incbin/("hal4.bin");
			type         = "firmware";
			compression  = "none";
			arch         = "arm64";	 // "arm64" or "arm"
			cpu          = <0x100>;  // mpidr
			thumb        = <0>;      // 0: arm or thumb2; 1: thumb
			hyp          = <0>;      // 0: el1/svc; 1: el2/hyp
			load         = <0x42000000>;
			size         = <0x00800000>;
			srambase     = <0x3FF80000>;
			sramsize     = <0x00080000>;
			udelay       = <10000>;
			hash {
				algo = "sha256";
			};
		};

		amp5 {
			description  = "bare-mental-core5";
			data         = /incbin/("hal5.bin");
			type         = "firmware";
			compression  = "none";
			arch         = "arm64";	 // "arm64" or "arm"
			cpu          = <0x101>;  // mpidr
			thumb        = <0>;      // 0: arm or thumb2; 1: thumb
			hyp          = <0>;      // 0: el1/svc; 1: el2/hyp
			load         = <0x42800000>;
			size         = <0x00800000>;
			srambase     = <0x3FF80000>;
			sramsize     = <0x00080000>;
			udelay       = <10000>;
			hash {
				algo = "sha256";
			};
		};

		amp6 {
			description  = "bare-mental-core6";
			data         = /incbin/("hal6.bin");
			type         = "firmware";
			compression  = "none";
			arch         = "arm64";	 // "arm64" or "arm"
			cpu          = <0x102>;  // mpidr
			thumb        = <0>;      // 0: arm or thumb2; 1: thumb
			hyp          = <0>;      // 0: el1/svc; 1: el2/hyp
			load         = <0x43000000>;
			size         = <0x00800000>;
			srambase     = <0x3FF80000>;
			sramsize     = <0x00080000>;
			udelay       = <10000>;
			hash {
				algo = "sha256";
			};
		};

		amp7 {
			description  = "bare-mental-core7";
			data         = /incbin/("hal7.bin");
			type         = "firmware";
			compression  = "none";
			arch         = "arm64";	 // "arm64" or "arm"
			cpu          = <0x103>;  // mpidr
			thumb        = <0>;      // 0: arm or thumb2; 1: thumb
			hyp          = <0>;      // 0: el1/svc; 1: el2/hyp
			load         = <0x43800000>;
			size         = <0x00800000>;
			srambase     = <0x3FF80000>;
			sramsize     = <0x00080000>;
			udelay       = <10000>;
			hash {
				algo = "sha256";
			};
		};

	};

	share_memory {
		base         = <0x47800000>;
		size         = <0x00400000>;
	};

	configurations {
		default = "conf";
		conf {
			description = "Rockchip AMP images";
			rollback-index = <0x0>;
			loadables = "amp0", "amp1", "amp2", "amp3", "amp4", "amp5", "amp6", "amp7";

			signature {
				algo = "sha256,rsa2048";
				padding = "pss";
				key-name-hint = "dev";
				sign-images = "loadables";
			};
		};
	};
};
```

## hal/project/rk3576-64/Image/amp_linux.its
```
/* SPDX-License-Identifier: BSD-3-Clause */
/*
 * Copyright (c) 2024 Rockchip Electronics Co., Ltd.
 */

/dts-v1/;
/ {
	description = "FIT source file for rockchip AMP";
	#address-cells = <1>;

	images {
		amp3 {
			description  = "bare-core3";
			data         = /incbin/("hal3.bin");
			type         = "firmware";
			compression  = "none";
			arch         = "arm64";	 // "arm64" or "arm"
			cpu          = <0x003>;  // mpidr
			thumb        = <0>;      // 0: arm or thumb2; 1: thumb
			hyp          = <0>;      // 0: el1/svc; 1: el2/hyp
			load         = <0x41800000>;
			size         = <0x00800000>;
			srambase     = <0x3ff80000>;
			sramsize     = <0x00080000>;
			udelay       = <10000>;
			hash {
				algo = "sha256";
			};
		};
	};

	configurations {
		default = "conf";
		conf {
			description = "Rockchip AMP images";
			rollback-index = <0x0>;
			loadables = "amp3";

			signature {
				algo = "sha256,rsa2048";
				padding = "pss";
				key-name-hint = "dev";
				sign-images = "loadables";
			};

			/* - run linux on cpu0
			 * - it is brought up by amp(that run on U-Boot)
			 * - it is boot entry depends on U-Boot
			 */
			linux {
				description  = "linux-os";
				arch         = "arm64";
				cpu          = <0x000>;
				thumb        = <0>;
				hyp          = <0>;
				load         = <0x42100000>;
				load_c       = <0x45480000>;
				udelay       = <0>;
			};
		};
	};
};
```
