## rtos/bsp/rockchip/common/fwmgr/Kconfig
```kconfig
config RT_USING_FWANALYSIS
    bool "Enable firmware analysis"
    default n
    help
        Select this option to enable firmware analysis
config RT_USING_VENDOR_STORAGE
    bool "Enable vendor storage support"
    default n
    help
        Select this option to enable vendor storage support
config RT_USING_USER_DATA_PART
    bool "Enable userdata partition support"
    default n
    help
        Select this option to enable userdata partition support

config RT_USING_AVB_LIBAVB_AB
    bool "Use uboot libavb ab system"
    default n
    help
        Select this option to boot ab system using uboot
```

## rtos/bsp/rockchip/koala/board/Kconfig
```kconfig
menu "RT-Thread board config"

choice
    prompt "Board Type"
    default RT_USING_BOARD_KOALA_EVB

    config RT_USING_BOARD_KOALA_EVB
        bool "Enable KOALA EVB board"

endchoice

endmenu
```

## rtos/bsp/rockchip/koala/drivers/Kconfig
```kconfig
source "$BSP_DIR/../common/drivers/Kconfig"

menu "RT-Thread rockchip koala drivers"

config RT_USING_CRU
    bool "Enable CRU"
    default n

config RT_USING_DMA
    bool "Enable General DMA Framework"
    default n

if RT_USING_DMA
    config RT_USING_DMA_PL330
        bool "Enable PL330 DMA Controller"
        default n

    config RT_USING_DMA0
        bool "Enable PL330 DMA0 Controller"
        default n
endif

menu "Enable DSP"
    config RT_USING_DSP
        bool "Enable DSP"
        default n

    if RT_USING_DSP
    config RT_USING_DSPFW_LOADER
        bool "Enable firmware loader to dsp"
        default n

    choice
        prompt "Dsp firmware path"
        default RT_USING_DSPFW_FILE
        depends on RT_USING_DSPFW_LOADER

        config RT_USING_DSPFW_BUILTIN
            bool "Store firmware data in builtin"

        config RT_USING_DSPFW_FILE
            bool "Store firmware data in file"
    endchoice

    config RT_PATH_DSPFW
        string "Dsp firmware path"
        default "/rkdsp.bin"
        depends on RT_USING_DSPFW_FILE

    config RT_USING_DSP_TRACE
        bool "Enable dsp send trace to cm4"
        default n

    config RT_DSP_UART_PORT
        int "Config dsp debug uart port"
        range -1 1
        default -1
        help
            set -1, will not set uart port to dsp
    endif
endmenu

menu "Enable UART"
    config RT_USING_UART
        bool "Enable UART"
        default n

    if RT_USING_UART
    config RT_USING_UART0
        bool "Enable UART0"
        default n

    config RT_USING_UART1
        bool "Enable UART1"
        default n
    endif
endmenu

if RT_USING_I2C
menu "Enable I2C"
    config RT_USING_I2C0
        bool "Enable I2C0"
        default n

    config RT_USING_I2C1
        bool "Enable I2C1"
        default n

    config RT_USING_I2C2
        bool "Enable I2C2"
        default n
endmenu
endif

if RT_USING_SPI
menu "Enable SPI"
    config RT_USING_SPI1
        bool "Enable SPI1"
        default n
endmenu
endif

if RT_USING_AUDIO
menu "Enable Audio"
    config RT_USING_PCM
        bool "Enable PCM"
        select RT_USING_DMA
        default y

    config RT_USING_I2STDM
        bool "Enable I2STDM"
        default n

    config RT_USING_I2STDM0
        bool "Enable I2STDM0"
        depends on RT_USING_I2STDM
        default n

    config RT_USING_PDM
        bool "Enable PDM"
        default n

    config RT_USING_PDM0
        bool "Enable PDM0"
        depends on RT_USING_PDM
        default n

    menu "Enable Audio Card"

    config RT_USING_AUDIO_CARD
        bool "Audio Cards"
        select RT_USING_CODEC
        default n

    config RT_USING_AUDIO_CARD_PDM_MIC
        depends on RT_USING_AUDIO_CARD
        select RT_USING_PDM
        bool "Enable pdm mics audio card"
        default n

    endmenu

    source "$BSP_DIR/../common/drivers/audio/codecs/Kconfig"
endmenu
endif

if RT_USING_PWM
menu "Enable PWM"
    config RT_USING_PWM0
        bool "Enable PWM0"
        default n
endmenu
endif

endmenu
```

## rtos/bsp/rockchip/koala/tests/Kconfig
```kconfig
menu "RT-Thread bsp test case"

config RT_USING_TC
    bool "Enable Kernel TEST"
    default n

config RT_USING_PRIVATE_TEST
    bool "Enable BSP Private TEST"
    default n

    if RT_USING_PRIVATE_TEST
    config RT_DSP_DECODE_TEST
        bool "Enable Dsp Decode Test"
        depends on RT_USING_DSP
        default n
    endif

source "$BSP_DIR/../common/tests/Kconfig"

endmenu
```

## rtos/bsp/rockchip/rk1808/board/Kconfig
```kconfig
menu "RT-Thread board config"

choice
    prompt "Board Type"
    default RT_USING_BOARD_RK1808_EVB

    config RT_USING_BOARD_RK1808_EVB
        bool "Enable RK1808_EVB board"

endchoice

endmenu
```

## rtos/bsp/rockchip/rk1808/board/evb/defconfig
```kconfig
CONFIG_RT_USING_CORE_RTTHREAD=y
CONFIG_ARCH_ARM=y
CONFIG_ARCH_ARM_CORTEX_A7=y
CONFIG_ARCH_ARM_CORTEX_A=y
CONFIG_DFS_FD_MAX=16
CONFIG_DFS_FILESYSTEMS_MAX=2
CONFIG_DFS_FILESYSTEM_TYPES_MAX=2
CONFIG_DFS_USING_WORKDIR=y
CONFIG_FINSH_ARG_MAX=10
CONFIG_FINSH_CMD_SIZE=80
CONFIG_FINSH_HISTORY_LINES=5
CONFIG_FINSH_THREAD_NAME="tshell"
CONFIG_FINSH_THREAD_PRIORITY=20
CONFIG_FINSH_THREAD_STACK_SIZE=4096
CONFIG_FINSH_USING_DESCRIPTION=y
CONFIG_FINSH_USING_HISTORY=y
CONFIG_FINSH_USING_MSH=y
CONFIG_FINSH_USING_MSH_DEFAULT=y
CONFIG_FINSH_USING_SYMTAB=y
CONFIG_IDLE_THREAD_STACK_SIZE=256
CONFIG_RT_ALIGN_SIZE=4
CONFIG_RT_CONFIG_H__=y
CONFIG_RT_CONSOLEBUF_SIZE=128
CONFIG_RT_CONSOLE_DEVICE_NAME="uart2"
CONFIG_RT_DEBUG=y
CONFIG_RT_DEBUG_COLOR=y
CONFIG_RT_DEBUG_USING_IO=y
CONFIG_RT_IDEL_HOOK_LIST_SIZE=4
CONFIG_RT_NAME_MAX=8
CONFIG_RT_PIPE_BUFSZ=64
CONFIG_RT_SERIAL_RB_BUFSZ=64
CONFIG_RT_SERIAL_USING_DMA=y
CONFIG_RT_THREAD_PRIORITY_32=y
CONFIG_RT_THREAD_PRIORITY_MAX=32
CONFIG_RT_TICK_PER_SECOND=1000
CONFIG_RT_USING_BOARD_RK1808_EVB=y
CONFIG_RT_USING_COMMON_TEST=y
CONFIG_RT_USING_COMPONENTS_INIT=y
CONFIG_RT_USING_CONSOLE=y
CONFIG_RT_USING_CRU=y
CONFIG_RT_USING_DEVICE=y
CONFIG_RT_USING_DEVICE_IPC=y
CONFIG_RT_USING_DFS=y
CONFIG_RT_USING_DFS_DEVFS=y
CONFIG_RT_USING_DFS_MNTTABLE=y
CONFIG_RT_USING_DMA=y
CONFIG_RT_USING_DMA_PL330=y
CONFIG_RT_USING_DMA0=y
CONFIG_RT_USING_EVENT=y
CONFIG_RT_USING_FINSH=y
CONFIG_RT_USING_GICV3=y
CONFIG_RT_USING_HEAP=y
CONFIG_RT_USING_HOOK=y
CONFIG_RT_USING_IDLE_HOOK=y
CONFIG_RT_USING_LIBC=y
CONFIG_RT_USING_MAILBOX=y
CONFIG_RT_USING_MEMHEAP=y
CONFIG_RT_USING_MEMPOOL=y
CONFIG_RT_USING_MESSAGEQUEUE=y
CONFIG_RT_USING_MUTEX=y
CONFIG_RT_USING_OVERFLOW_CHECK=y
CONFIG_RT_USING_PIN=y
CONFIG_RT_USING_POSIX=y
CONFIG_RT_USING_SEMAPHORE=y
CONFIG_RT_USING_SERIAL=y
CONFIG_RT_USING_SMALL_MEM=y
CONFIG_RT_USING_TC=y
CONFIG_RT_USING_UART2=y
CONFIG_RT_USING_UART=y
CONFIG_RT_VER_NUM=0x30103
CONFIG_SOC_RK1808=y
```

## rtos/bsp/rockchip/rk1808/drivers/Kconfig
```kconfig
source "$BSP_DIR/../common/drivers/Kconfig"

menu "RT-Thread rockchip rk1808 drivers"

config RT_USING_CRU
    bool "Enable CRU"
    default n

config RT_USING_DMA
    bool "Enable General DMA Framework"
    default n

if RT_USING_DMA
    config RT_USING_DMA_PL330
        bool "Enable PL330 DMA Controller"
        default n

    config RT_USING_DMA0
        bool "Enable PL330 DMA0 Controller"
        default n
endif

config RT_USING_RGB
    bool "Enable RGB"
    default n

config RT_USING_VOP
    bool "Enable VOP"
    default n

config RT_USING_DSI
     bool "Enable MIPI DSI"
     default n

menu "Enable UART"
    config RT_USING_UART
        bool "Enable UART"
        default n

    if RT_USING_UART
    config RT_USING_UART0
        bool "Enable UART0"
        default n

    config RT_USING_UART1
        bool "Enable UART1"
        default n

    config RT_USING_UART2
        bool "Enable UART2"
        default n

    config RT_USING_UART3
        bool "Enable UART3"
        default n

    config RT_USING_UART4
        bool "Enable UART4"
        default n

    config RT_USING_UART5
        bool "Enable UART5"
        default n

    config RT_USING_UART6
        bool "Enable UART6"
        default n

    config RT_USING_UART7
        bool "Enable UART7"
        default n
    endif
endmenu

if RT_USING_I2C
menu "Enable I2C"
    config RT_USING_I2C0
        bool "Enable I2C0"
        default n

    config RT_USING_I2C1
        bool "Enable I2C1"
        default n

    config RT_USING_I2C2
        bool "Enable I2C2"
        default n

    config RT_USING_I2C3
        bool "Enable I2C3"
        default n

    config RT_USING_I2C4
        bool "Enable I2C4"
        default n

    config RT_USING_I2C5
        bool "Enable I2C5"
        default n
endmenu
endif

if RT_USING_SPI
menu "Enable SPI"
    config RT_USING_SPI2APB
        bool "Enable SPI0 (SPI2APB)"
        default n

    config RT_USING_SPI1
        bool "Enable SPI1"
        default n

    config RT_USING_SPI2
        bool "Enable SPI2"
        default n
endmenu
endif

if RT_USING_AUDIO
menu "Enable Audio"
    config RT_USING_PCM
        bool "Enable PCM"
        select RT_USING_DMA
        default y

    config RT_USING_I2S
        bool "Enable I2S"
        default n

    if RT_USING_I2S
    config RT_USING_I2S0
        bool "Enable I2S0"
        default n
    endif

    config RT_USING_I2STDM
        bool "Enable I2STDM"
        default n

    config RT_USING_I2STDM0
        bool "Enable I2STDM0"
        depends on RT_USING_I2STDM
        default n

    config RT_USING_PDM
        bool "Enable PDM"
        default n

    config RT_USING_PDM0
        bool "Enable PDM0"
        depends on RT_USING_PDM
        default n

    config RT_USING_VAD
        bool "Enable VAD"
        default n
endmenu
endif

config RT_USING_GICV3
    bool "Enable Gic-v3"
    default n

config RT_USING_SARADC
    bool "Enable SARADC"
    default n

if RT_USING_SDIO
menu "Enable SDIO/SDMMC/eMMC"
    config RT_USING_SDIO0
        bool "Enable SDIO controller"
        default n
    config RT_USING_SDIO1
        bool "Enable SDMMC controller"
        default n
endmenu
endif
endmenu
```
