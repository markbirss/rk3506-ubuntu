## buildroot/package/rockchip/recovery/Config.in
```kconfig
config BR2_PACKAGE_RECOVERY
	bool "Rockchip recovery for linux"
	depends on BR2_TOOLCHAIN_HAS_THREADS # libpthread-stubs
	select BR2_PACKAGE_LIBDRM if !BR2_PACKAGE_RECOVERY_NO_UI
	select BR2_PACKAGE_LIBPNG if !BR2_PACKAGE_RECOVERY_NO_UI
	select BR2_PACKAGE_LIBPTHREAD_STUBS
	select BR2_PACKAGE_LIBZ
	select BR2_PACKAGE_E2FSPROGS if !BR2_PACKAGE_MTD
	select BR2_PACKAGE_E2FSPROGS_RESIZE2FS if !BR2_PACKAGE_MTD
	select BR2_PACKAGE_LIBCURL
	select BR2_PACKAGE_BZIP2
	help
	  Rockchip recovery for linux.

if BR2_PACKAGE_RECOVERY

config BR2_PACKAGE_RECOVERY_NO_UI
	bool "No UI for recovery"
	help
	  No UI for recovery

config BR2_PACKAGE_RECOVERY_BOOTCONTROL
	bool "Linux AB bool control"

choice
	default BR2_PACKAGE_RECOVERY_SUCCESSFUL_BOOT
	prompt "Linux A/B bringup features."
config BR2_PACKAGE_RECOVERY_SUCCESSFUL_BOOT
	bool "successful_boot"
config BR2_PACKAGE_RECOVERY_RETRY
	bool "retry time"
endchoice

choice
	default BR2_PACKAGE_RECOVERY_USE_RKUPDATE
	prompt "choice the update bin of recovery."

config BR2_PACKAGE_RECOVERY_USE_RKUPDATE
	bool "rkupdate"
	select BR2_PACKAGE_RECOVERY_RECOVERYBIN

config BR2_PACKAGE_RECOVERY_USE_UPDATEENGINE
	bool "updateEngine"
	select BR2_PACKAGE_RECOVERY_UPDATEENGINEBIN

endchoice

config BR2_PACKAGE_RECOVERY_RECOVERYBIN
	bool "recovery bin"

config BR2_PACKAGE_RECOVERY_UPDATEENGINEBIN
	bool "updateEngine bin"

config BR2_PACKAGE_RECOVERY_STATIC
	bool "Enable static"
	default y if BR2_STATIC_LIBS
	select BR2_PACKAGE_LIBCURL_STATIC
	select BR2_PACKAGE_LIBDRM_STATIC
	select BR2_PACKAGE_LIBPNG_STATIC

endif
```

## buildroot/package/rockchip/rkadk/Config.in
```kconfig
config BR2_PACKAGE_RKADK
	bool "rkadk"
	select BR2_PACKAGE_ROCKIT
	select BR2_PACKAGE_COMMON_ALGORITHM
	default n
	help
		rkadk

if BR2_PACKAGE_RKADK
config BR2_PACKAGE_RKADK_USE_AIQ
	bool "camera capture with rkaiq api"
	select BR2_PACKAGE_CAMERA_ENGINE_RKAIQ
	default n
	help
		camera capture with rkaiq api

config BR2_PACKAGE_RKADK_COMMON_FUNCTIONS
	bool "common functions(record photo stream live)"
	default n
	help
		wrapped function of rkadk common functions

if BR2_PACKAGE_RKADK_COMMON_FUNCTIONS
config BR2_PACKAGE_RKADK_AOV
	bool "always on video"
	default n
	help
		enable rkadk aov

config BR2_PACKAGE_RKADK_FILE_CACHE
	bool "file cache"
	default n
	help
		enable rkadk file cache

config BR2_PACKAGE_RKADK_EIS
	bool "eis"
	select BR2_PACKAGE_CAMERA_ENGINE_RKAIQ
	default n
	help
		enable rkadk eis

config BR2_PACKAGE_RKADK_JPEG_SLICE
	bool "jpeg slice"
	default n
	help
		wrapped function of jpeg slice
endif #BR2_PACKAGE_RKADK_COMMON_FUNCTIONS

config BR2_PACKAGE_RKADK_DISPLAY
	bool "display"
	default n
	help
		wrapped function of rkadk display

config BR2_PACKAGE_RKADK_PLAYER
	bool "player"
	default n
	help
		wrapped function of rkadk player

config BR2_PACKAGE_RKADK_STORAGE
	bool "storage"
	select BR2_PACKAGE_RKFSMK
	default n
	help
		wrapped function of rkadk storage

config BR2_PACKAGE_RKADK_STATIC_LIBRARY
	bool "static library"
	default n
	help
		build rkadk static library and example

config BR2_PACKAGE_RKADK_EXAMPLES
	bool "examples"
	default n
	help
		build rkadk examples
endif #BR2_PACKAGE_RKADK
```

## buildroot/package/rockchip/rknpu2/Config.in
```kconfig
config BR2_PACKAGE_RKNPU2
	bool "rknpu2"
	help
	  "rknpu runtime lib and server"

config BR2_PACKAGE_RKNPU2_ARCH
	string
	depends on BR2_ARCH = "arm" || BR2_ARCH = "aarch64"
	default "armhf" if BR2_ARCH="arm"
	default BR2_ARCH

if BR2_PACKAGE_RKNPU2

config BR2_PACKAGE_RKNPU2_EXAMPLE
	bool "rknpu2 example"
	default y

endif
```

## buildroot/package/rockchip/rkpartybox/Config.in
```kconfig
config BR2_PACKAGE_RKPARTYBOX
	bool "RKPARTYBOX demo"
	depends on BR2_aarch64
	depends on BR2_PACKAGE_HAS_UDEV
	depends on BR2_PACKAGE_WPA_SUPPLICANT
	help
	  rkpartybox demo

config BR2_PACKAGE_RK3308_RKPARTYBOX_BTMCU
	bool "RKPARTYBOX use BTMCU"
	depends on BR2_PACKAGE_RKPARTYBOX
	help
	  partybox use external BT soc

config BR2_PACKAGE_PBOX_LCD_DISPLAY
	bool "RKPARTYBOX LCD display"
	depends on BR2_PACKAGE_RKPARTYBOX
	depends on BR2_PACKAGE_LVGL
	depends on BR2_PACKAGE_LV_DRIVERS
	default y
	help
	  partybox lcd display

config BR2_PACKAGE_PBOX_LED_EFFECT
	bool "RKPARTYBOX led effect"
	depends on BR2_PACKAGE_RKPARTYBOX
	default y
	help
	  partybox led effect demo
```

## buildroot/package/rockchip/rktoolkit/Config.in
```kconfig
config BR2_PACKAGE_RKTOOLKIT
	bool "rockchip toolkit"
	help
	  rockchip toolkit for linux

config BR2_PACKAGE_RKTOOLKIT_STATIC
	bool "static tools"
	depends on BR2_PACKAGE_RKTOOLKIT
```

## buildroot/package/rockchip/rkupdate/Config.in
```kconfig
config BR2_PACKAGE_RKUPDATE
	bool "Rockchip rkupdate for linux"
	depends on BR2_TOOLCHAIN_HAS_THREADS # libpthread-stubs
	select BR2_PACKAGE_LIBPTHREAD_STUBS
	select BR2_PACKAGE_UTIL_LINUX
	select BR2_PACKAGE_UTIL_LINUX_LIBUUID
	help
	  Rockchip rkupdate for linux.

if BR2_PACKAGE_RKUPDATE

config BR2_PACKAGE_RKUPDATE_SINGNATURE_FW
	bool "update signature firmware"
	help
		update signature firmware.

config BR2_PACKAGE_RKUPDATE_SIMULATE_ABNORMAL_POWER_OFF
	bool "simulate abnormal power off during updating fw"
	help
		simulate abnormal power off during updating fw.

config BR2_PACKAGE_RKUPDATE_STATIC
	bool "Enable static"
	default y if BR2_STATIC_LIBS
	select BR2_PACKAGE_UTIL_LINUX_STATIC

endif
```

## buildroot/package/rockchip/rkwifibt/Config.in
```kconfig
config BR2_PACKAGE_RKWIFIBT
	bool "rkwifibt"

if BR2_PACKAGE_RKWIFIBT

config BR2_PACKAGE_RKWIFIBT_STATIC
	bool "Enable static"
	default y if BR2_STATIC_LIBS

endif
```

## buildroot/package/rockchip/rockchip-alsa-config/Config.in
```kconfig
config BR2_PACKAGE_ROCKCHIP_ALSA_CONFIG
	bool "rockchip-alsa-config"
	depends on BR2_PACKAGE_ALSA_LIB
	help
	  Rockchip sound cards' alsa configs.

	config BR2_ROCKCHIP_ALSA_CONFIG_INSTALL_INIT_SCRIPT
		bool "Install init script"
		depends on BR2_PACKAGE_ROCKCHIP_ALSA_CONFIG
		default n
		help
		  Install init script.
```

## buildroot/package/rockchip/rockchip-erpc/Config.in
```kconfig
config BR2_PACKAGE_ROCKCHIP_ERPC
	bool "rockchip-erpc"
	help
	  eRPC (Embedded RPC) is an open source
	  Remote Procedure Call (RPC) system for multichip embedded systems
	  and heterogeneous multicore SoCs.
	  Rockchip support this for Rockchip's chips.
```
