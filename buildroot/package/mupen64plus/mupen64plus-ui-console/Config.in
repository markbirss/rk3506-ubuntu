## buildroot/package/mupen64plus/mupen64plus-ui-console/Config.in
```kconfig
config BR2_PACKAGE_MUPEN64PLUS_UI_CONSOLE
        bool "mupen64plus-ui-console"
	depends on BR2_PACKAGE_MUPEN64PLUS_CORE
	depends on BR2_PACKAGE_SDL2
	default y
        help
          mupen64plus ui console.

	  https://mupen64plus.org/
```

## buildroot/package/mupen64plus/mupen64plus-video-gles2n64/Config.in
```kconfig
config BR2_PACKAGE_MUPEN64PLUS_VIDEO_GLES2N64
        bool "mupen64plus-video-gles2n64"
	depends on BR2_PACKAGE_HAS_LIBGLES
	depends on BR2_PACKAGE_MUPEN64PLUS_CORE
	depends on BR2_PACKAGE_LIBPNG
	depends on BR2_PACKAGE_SDL2
	depends on BR2_PACKAGE_SDL2_OPENGLES
	depends on BR2_PACKAGE_ZLIB
        help
          mupen64plus video gles2n64.

	  https://github.com/ricrpi/mupen64plus-video-gles2n64
```

## buildroot/package/mupen64plus/mupen64plus-video-glide64mk2/Config.in
```kconfig
config BR2_PACKAGE_MUPEN64PLUS_VIDEO_GLIDE64MK2
        bool "mupen64plus-video-glide64mk2"
	depends on BR2_PACKAGE_MUPEN64PLUS_CORE
	depends on BR2_PACKAGE_SDL2
        help
          mupen64plus video glide64mk2.

	  https://mupen64plus.org/
```

## buildroot/package/mupen64plus/mupen64plus-video-gliden64/Config.in
```kconfig
config BR2_PACKAGE_MUPEN64PLUS_VIDEO_GLIDEN64
        bool "mupen64plus-video-gliden64"
	depends on BR2_PACKAGE_LIBPNG
	depends on BR2_PACKAGE_ZLIB
        help
          mupen64plus video gliden64.

	  https://github.com/gonetz/GLideN64
```

## buildroot/package/mupen64plus/mupen64plus-video-rice/Config.in
```kconfig
config BR2_PACKAGE_MUPEN64PLUS_VIDEO_RICE
        bool "mupen64plus-video-rice"
	depends on BR2_PACKAGE_MUPEN64PLUS_CORE
	depends on BR2_PACKAGE_LIBPNG
	depends on BR2_PACKAGE_SDL2
        help
          mupen64plus video rice.

	  https://mupen64plus.org/
```

## buildroot/package/play/Config.in
```kconfig
config BR2_PACKAGE_PLAY
	bool "Play!"
	depends on BR2_PACKAGE_HAS_LIBGLES
	depends on BR2_PACKAGE_OPENAL
	depends on BR2_PACKAGE_QT5BASE
	depends on BR2_INSTALL_LIBSTDCPP
	help
	  Play! - PlayStation2 Emulator.

	  https://github.com/jpd002/Play-

comment "Play! needs a toolchain w/ C++"
	depends on !BR2_INSTALL_LIBSTDCPP
```

## buildroot/package/retroarch/libretro-mupen64plus-nx/Config.in
```kconfig
config BR2_PACKAGE_LIBRETRO_MUPEN64PLUS_NX
        bool "libretro-mupen64plus-next"
	depends on BR2_PACKAGE_RETROARCH
	depends on BR2_INSTALL_LIBSTDCPP
        help
          libretro mupen64plus-next core.

	  http://www.libretro.com

comment "LIBRETRO_MUPEN64PLUS_NX needs a toolchain w/ C++"
	depends on !BR2_INSTALL_LIBSTDCPP
```

## buildroot/package/retroarch/libretro-stella2023/Config.in
```kconfig
config BR2_PACKAGE_LIBRETRO_STELLA2023
        bool "libretro-stella2023"
	depends on BR2_INSTALL_LIBSTDCPP
        help
          libretro stella2023 core.

	  http://www.libretro.com

comment "LIBRETRO_STELLA2023 needs a toolchain w/ C++"
	depends on !BR2_INSTALL_LIBSTDCPP
```

## buildroot/package/rockchip/Config.in
```kconfig
menuconfig BR2_PACKAGE_ROCKCHIP
	bool "Rockchip Platform"

if BR2_PACKAGE_ROCKCHIP

config BR2_PACKAGE_ROCKCHIP_HAS_ISP1
	bool
	help
	  Has Rockchip ISP1

config BR2_PACKAGE_ROCKCHIP_HAS_ISP2
	bool
	help
	  Has Rockchip ISP2

config BR2_PACKAGE_ROCKCHIP_HAS_ISP3
	bool
	help
	  Has Rockchip ISP3

choice
	default BR2_PACKAGE_RK3588
	prompt "Rockchip SoC"

config BR2_PACKAGE_RV1126_RV1109
	bool "rv1126/rv1109"
	select BR2_PACKAGE_ROCKCHIP_HAS_ISP2
	help
	  Use Rockchip's rv1126/rv1109 SoC.

config BR2_PACKAGE_RK1806
	bool "rk1806"
	select BR2_PACKAGE_ROCKCHIP_HAS_ISP1
	help
	  Use Rockchip's rk1806 SoC.

config BR2_PACKAGE_RK1808
	bool "rk1808"
	select BR2_PACKAGE_ROCKCHIP_HAS_ISP1
	help
	  Use Rockchip's rk1808 SoC.

config BR2_PACKAGE_RK3032
	bool "rk3032"
	help
	  Use Rockchip's rk3032 SoC.

config BR2_PACKAGE_RK3036
	bool "rk3036"
	help
	  Use Rockchip's rk3036 SoC.

config BR2_PACKAGE_PX3SE
	bool "px3se"
	help
	  Use Rockchip's px3se SoC.

config BR2_PACKAGE_RK312X
	bool "rk312X"
	select BR2_PACKAGE_ROCKCHIP_HAS_ISP1
	help
	  Use Rockchip's rk312X SoC.

config BR2_PACKAGE_RK3128H
	bool "rk3128H"
	help
	  Use Rockchip's rk3128H box SoC.

config BR2_PACKAGE_RK3229
	bool "rk3229"
	help
	  Use Rockchip's rk3229 SoC.

config BR2_PACKAGE_RK3288
	bool "rk3288"
	select BR2_PACKAGE_ROCKCHIP_HAS_ISP1
	help
	  Use Rockchip's rk3288 SoC.

config BR2_PACKAGE_RK3308
	bool "rk3308"
	help
	  Use Rockchip's rk3308 SoC.


config BR2_PACKAGE_RK3506
    bool "rk3506"
	help
	  Use Rockchip's rk3506 SoC.

config BR2_PACKAGE_RK3326
	bool "rk3326"
	select BR2_PACKAGE_ROCKCHIP_HAS_ISP1
	help
	  Use Rockchip's rk3326 SoC.

config BR2_PACKAGE_PX30
	bool "px30"
	select BR2_PACKAGE_ROCKCHIP_HAS_ISP1
	help
	  Use Rockchip's px30 SoC.

config BR2_PACKAGE_RK3328
	bool "rk3328"
	help
	  Use Rockchip's rk3328 SoC.

config BR2_PACKAGE_RK3358
	bool "rk3358"
	select BR2_PACKAGE_ROCKCHIP_HAS_ISP1
	help
	  Use Rockchip's rk3358 SoC.

config BR2_PACKAGE_RK3399
	bool "rk3399"
	select BR2_PACKAGE_ROCKCHIP_HAS_ISP1
	help
	  Use Rockchip's rk3399 SoC.

config BR2_PACKAGE_RK3399PRO
	bool "rk3399pro"
	select BR2_PACKAGE_ROCKCHIP_HAS_ISP1
	help
	  Use Rockchip's rk3399pro SoC.

config BR2_PACKAGE_RK3399PRO_NPU
	bool "rk3399pro npu"
	select BR2_PACKAGE_ROCKCHIP_HAS_ISP1
	help
	  Use Rockchip's rk3399pro npu SoC.

config BR2_PACKAGE_RK3528
	bool "rk3528"
	help
	  Use Rockchip's rk3528 SoC.

config BR2_PACKAGE_RK3562
	bool "rk3562"
	select BR2_PACKAGE_ROCKCHIP_HAS_ISP2
	help
	  Use Rockchip's rk3562 SoC.

config BR2_PACKAGE_RK3566_RK3568
	bool "rk3566/rk3568"
	select BR2_PACKAGE_ROCKCHIP_HAS_ISP2
	help
	  Use Rockchip's rk3566/rk3568 SoC.

config BR2_PACKAGE_RK3576
	bool "rk3576 chip"
	select BR2_PACKAGE_ROCKCHIP_HAS_ISP3
	help
	  Use Rockchip's rk3576 SoC

config BR2_PACKAGE_RK3588
	bool "rk3588"
	select BR2_PACKAGE_ROCKCHIP_HAS_ISP3
	help
	  Use Rockchip's rk3588 SoC.

endchoice

# Camera Engine packages
config BR2_PACKAGE_CAMERA_ENGINE
	bool "Rockchip Camera Engine For ISP"
	depends on BR2_PACKAGE_ROCKCHIP_HAS_ISP1 || BR2_PACKAGE_ROCKCHIP_HAS_ISP2 || BR2_PACKAGE_ROCKCHIP_HAS_ISP3
	select BR2_PACKAGE_CAMERA_ENGINE_RKISP if BR2_PACKAGE_ROCKCHIP_HAS_ISP1
	select BR2_PACKAGE_CAMERA_ENGINE_RKAIQ if BR2_PACKAGE_ROCKCHIP_HAS_ISP2
	select BR2_PACKAGE_CAMERA_ENGINE_RKAIQ if BR2_PACKAGE_ROCKCHIP_HAS_ISP3
	help
	  Depend on Chip Type, there are different camera_engine packages.
	  Enable this config to choose camera_engine package by chip automatically.

menu "Rockchip BSP packages"
	source "package/rockchip/camera-engine-rkaiq/Config.in"
	source "package/rockchip/camera-engine-rkisp/Config.in"
	source "package/rockchip/common_algorithm/Config.in"
	source "package/rockchip/gstreamer1-rockchip/Config.in"
	source "package/rockchip/libv4l-rkmpp/Config.in"
	source "package/rockchip/lvgl_demo/Config.in"
	source "package/rockchip/n4/Config.in"
	source "package/rockchip/npu_powerctrl/Config.in"
	source "package/rockchip/npu_powerctrl_combine/Config.in"
	source "package/rockchip/recovery/Config.in"
	source "package/rockchip/rkadk/Config.in"
	source "package/rockchip/rknpu/Config.in"
	source "package/rockchip/rknpu2/Config.in"
	source "package/rockchip/rknpu-fw/Config.in"
	source "package/rockchip/rkpartybox/Config.in"
	source "package/rockchip/rkscript/Config.in"
	source "package/rockchip/rktoolkit/Config.in"
	source "package/rockchip/rkupdate/Config.in"
	source "package/rockchip/rkwifibt/Config.in"
	source "package/rockchip/rkwifibt-app/Config.in"
	source "package/rockchip/rockchip-alsa-config/Config.in"
	source "package/rockchip/rockchip-erpc/Config.in"
	source "package/rockchip/rockchip-mali/Config.in"
	source "package/rockchip/rockchip-mpp/Config.in"
	source "package/rockchip/rockchip-rga/Config.in"
	source "package/rockchip/rockchip-test/Config.in"
	source "package/rockchip/rockchip-uac-app/Config.in"
	source "package/rockchip/rockchip-uvc-app/Config.in"
	source "package/rockchip/rockit/Config.in"
	source "package/rockchip/rockit-uvc/Config.in"
	source "package/rockchip/slt_gpu_light/Config.in"
	source "package/rockchip/tee-user-app/Config.in"
endmenu

menu "Rockchip IPC"
	source "package/rockchip/ipc/Config.in"
endmenu

endif
```

## buildroot/package/rockchip/common_algorithm/Config.in
```kconfig
config BR2_PACKAGE_COMMON_ALGORITHM
	bool "rockchip common algorithm"
	help
	  rockchip common algorithm library

if BR2_PACKAGE_COMMON_ALGORITHM

choice
	prompt "target platform(32bit/64bit)"
	default BR2_PACKAGE_COMMON_ALGORITHM_64 if BR2_ARCH_IS_64
	default BR2_PACKAGE_COMMON_ALGORITHM_32 if !BR2_ARCH_IS_64

config BR2_PACKAGE_COMMON_ALGORITHM_32
	bool "32bit"
	help
	  Use algorithm for 32bit system.

config BR2_PACKAGE_COMMON_ALGORITHM_64
	bool "64bit"
	help
	  Use algorithm for 64bit system.
endchoice

config BR2_PACKAGE_COMMON_ALGORITHM_AEC_ANR_AGC
	bool "RKAP-3A"
	default n
	help
	  Echo cancellation algorithm, applied to voice call scenarios

config BR2_PACKAGE_COMMON_ALGORITHM_ANR
	bool "RKAP-ANR"
	default n
	help
	  Automatic noise reduction algorithm, applied to recording scene

config BR2_PACKAGE_COMMON_ALGORITHM_RKAPPLUS
	bool "RKAP-PLUS"
	default y
	help
	  Audio 3A Algorithm Plus by Rockchip, applied talking scene

config BR2_PACKAGE_COMMON_ALGORITHM_RKAPPLUS_EFFECT_EQDRC
	bool "RKAP-PLUS-EFFECT-EQDRC"
	default n
	help
	  Audio Effect EQ/DRC Algorithm Plus by Rockchip, applied playback scene

config BR2_PACKAGE_COMMON_ALGORITHM_TWO_MIC_BEAMFORM
	bool "beamforming of two mic"
	default n
	help
	  Beamforming algorithm of two mic

config BR2_PACKAGE_COMMON_ALGORITHM_MOVE_DETECT
	bool "move detection"
	default n
	help
	  Move detection algorithm

config BR2_PACKAGE_COMMON_ALGORITHM_OCCLUSION_DETECT
	bool "occlusion detection"
	default n
	help
	  Occlusion detection algorithm

config BR2_PACKAGE_COMMON_ALGORITHM_ROCKAA
	bool "RockAA"
	default n
	help
	  Rockchip Audio Algorithm Utils
endif
```

## buildroot/package/rockchip/ipc/Config.in
```kconfig
source "package/rockchip/ipc/avs/Config.in"
source "package/rockchip/ipc/ipcweb-backend/Config.in"
source "package/rockchip/ipc/iva/Config.in"
source "package/rockchip/ipc/minilogger/Config.in"
source "package/rockchip/ipc/rkfsmk/Config.in"
source "package/rockchip/ipc/rkipc/Config.in"
source "package/rockchip/ipc/samples/Config.in"
```

## buildroot/package/rockchip/ipc/avs/Config.in
```kconfig
config BR2_PACKAGE_AVS
	bool "rockchip avs algorithm"
	default n
	help
	  rockchip avs(any view stitching algorithm) library
```

## buildroot/package/rockchip/ipc/iva/Config.in
```kconfig
config BR2_PACKAGE_IVA
	bool "rockiva algorithm"
	help
	  rockiva library

if BR2_PACKAGE_IVA

choice
	default BR2_PACKAGE_IVA_RK3588
	prompt "target platform(32bit/64bit)"

config BR2_PACKAGE_IVA_RK3576
	bool "rockiva rk3576"
	help
	  Use rockiva for rk3576.

config BR2_PACKAGE_IVA_RK3588
	bool "rockiva rk3588"
	help
	  Use rockiva for rk3588.

config BR2_PACKAGE_IVA_RV1106
	bool "rockiva rv1106"
	help
	  Use rockiva for rv1106.
endchoice

endif
```

## buildroot/package/rockchip/ipc/rkipc/Config.in
```kconfig
config BR2_PACKAGE_RKIPC
	bool "rockchip rkipc"
	select BR2_PACKAGE_CAMERA_ENGINE_RKAIQ
	select BR2_PACKAGE_WPA_SUPPLICANT
	select BR2_PACKAGE_FREETYPE
	help
	  rockchip rkipc

choice
prompt "Platform type"
	default BR2_PACKAGE_RKIPC_RK3588
	help
	  Select a platform type.

config BR2_PACKAGE_RKIPC_RK3576
	bool "Compile for rk3576 ipc"
	select BR2_PACKAGE_ROCKIT
	select BR2_PACKAGE_ROCKCHIP_RGA
	depends on BR2_PACKAGE_RKIPC

config BR2_PACKAGE_RKIPC_RK3576_MULTI_IPC
	bool "Compile for rk3576 multi ipc"
	select BR2_PACKAGE_ROCKIT
	select BR2_PACKAGE_ROCKCHIP_RGA
	depends on BR2_PACKAGE_RKIPC

config BR2_PACKAGE_RKIPC_RK3588
	bool "Compile for rk3588 ipc"
	select BR2_PACKAGE_ROCKIT
	select BR2_PACKAGE_ROCKCHIP_RGA
	depends on BR2_PACKAGE_RKIPC

config BR2_PACKAGE_RKIPC_RK3588_MULTI_IPC
	bool "Compile for rk3588 multi ipc"
	select BR2_PACKAGE_ROCKIT
	select BR2_PACKAGE_ROCKCHIP_RGA
	depends on BR2_PACKAGE_RKIPC

config BR2_PACKAGE_RKIPC_RV1126
	bool "Compile for rv1126 ipc"
	select BR2_PACKAGE_RKMEDIA
	depends on BR2_PACKAGE_RKIPC

config BR2_PACKAGE_RKIPC_RV1126_BATTERY_IPC
	bool "Compile for rv1126 battery ipc"
	select BR2_PACKAGE_ROCKIT
	select BR2_PACKAGE_VENDOR_STORAGE
	depends on BR2_PACKAGE_RKIPC
endchoice
```

## buildroot/package/rockchip/ipc/samples/Config.in
```kconfig
config BR2_PACKAGE_SAMPLES
	bool "rockchip samples"
	select BR2_PACKAGE_CAMERA_ENGINE_RKAIQ
	select BR2_PACKAGE_WPA_SUPPLICANT
	select BR2_PACKAGE_FREETYPE
	help
	  rockchip samples

choice
prompt "Platform type"
	default BR2_PACKAGE_SAMPLES_RK3576
	help
	  Select a platform type.

config BR2_PACKAGE_SAMPLES_RK3588
	bool "Compile for rk3588 samples"
	select BR2_PACKAGE_ROCKIT
	select BR2_PACKAGE_ROCKCHIP_RGA
	depends on BR2_PACKAGE_SAMPLES

config BR2_PACKAGE_SAMPLES_RK3576
	bool "Compile for rk3576 samples"
	select BR2_PACKAGE_ROCKIT
	select BR2_PACKAGE_ROCKCHIP_RGA
	depends on BR2_PACKAGE_SAMPLES
endchoice
```

## buildroot/package/rockchip/lvgl_demo/Config.in
```kconfig
config BR2_PACKAGE_LVGL_DEMO
	bool "LVGL DEMO"
	default n
	help
	  lvgl demos in app/lvgl_demo

if BR2_PACKAGE_LVGL_DEMO
	config BR2_LVGL_DEMO_BACKEND_SDL
		bool
		default y if BR2_LV_DRIVERS_USE_SDL_GPU
		default y if BR2_LV_USE_SDL && BR2_PACKAGE_LVGL_VERSION_9

	config BR2_LVGL_DEMO_BACKEND_DRM
		bool
		default y if BR2_LV_DRIVERS_USE_DRM
		default y if BR2_LV_USE_LINUX_DRM && BR2_PACKAGE_LVGL_VERSION_9
		select BR2_PACKAGE_LIBEVDEV

	config BR2_LVGL_DEMO_BACKEND_RKADK
		bool
		default y if BR2_LV_DRIVERS_USE_RKADK
		default y if BR2_LV_USE_RKADK && BR2_PACKAGE_LVGL_VERSION_9
		select BR2_PACKAGE_LIBEVDEV

	config BR2_LVGL_DEMO_OFFICIAL_DEMOS
		bool "Enable demos from LVGL team"
		default n
		help
			LVGL official demos from lvgl team.

	choice
		prompt "LVGL APP select"
		depends on BR2_LVGL_DEMO_OFFICIAL_DEMOS
		config BR2_LVGL_DEMO_WIDGETS
			bool "lvgl demo widgets"
			select BR2_LV_USE_DEMO_WIDGETS
			help
			  Enbale lvgl demo widgets

		config BR2_LVGL_DEMO_BENCHMARK
			bool "lvgl demo benchmark"
			select BR2_LV_USE_DEMO_BENCHMARK
			help
			  Enbale lvgl demo benchmark

		config BR2_LVGL_DEMO_MUSIC
			bool "lvgl demo music"
			select BR2_LV_USE_DEMO_MUSIC
			help
			  Enbale lvgl demo music
	endchoice

	config BR2_LVGL_DEMO_RK_DEMO
		bool "Enable demos from Rockchip"
		help
		  Rockchip LVGL demo

	if BR2_LVGL_DEMO_RK_DEMO
		config BR2_RK_DEMO_ENABLE_MULTIMEDIA
			default n
			bool "RK demo enable multimedia"
			select BR2_PACKAGE_RKWIFIBT_APP
			select BR2_PACKAGE_RKADK
			select BR2_PACKAGE_RKADK_PLAYER
			select BR2_PACKAGE_COMMON_ALGORITHM
			help
			  Rockchip LVGL demo enable all multimedia functions,
			  e.g. RKADK Rockit.

		config BR2_RK_DEMO_ENABLE_SENSOR
			bool "RK demo enable sensor"
			default n
			help
			  Rockchip LVGL demo enable sensor functions,
			  e.g. lsensor, psensor.

		config BR2_RK_DEMO_ENABLE_WIFIBT
			bool "RK demo enable WiFi and BT"
			default n
			help
			  Rockchip LVGL demo enable wifibt functions.

		config BR2_RK_DEMO_ENABLE_ASR
			bool "RK demo enable ASR"
			default n
			help
			  Rockchip LVGL demo enable ASR functions.
	endif

endif
```
