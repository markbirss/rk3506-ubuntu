## app/rkadk/Kconfig
```kconfig
menuconfig RT_USING_RKADK
    bool "rkadk"
    select RT_USING_POSIX_FS
    select RT_USING_POSIX_DEVIO
    select RT_USING_POSIX_POLL
    select RT_USING_POSIX_DELAY
    select RT_USING_POSIX_CLOCK
    select RT_USING_POSIX_PIPE
    select RT_USING_POSIX_MMAN
    select RT_USING_POSIX_MESSAGE_SEMAPHORE
    select RT_USING_PTHREADS
    select RT_USING_LWIP
    select RT_USING_LWIP212
    select RT_USING_ROCKIT
    default n
    help
        rkadk: light-weight multimedia api

if RT_USING_RKADK
    config RT_RKADK_ENABLE_COMMON_FUNCTIONS
        bool "common"
        default n
        help
            rkadk common module

    config RT_RKADK_ENABLE_AOV
        bool "aov"
        default n
        help
            rkadk aov module

    config RT_RKADK_ENABLE_STORAGE
        bool "storage"
        default n
        help
            rkadk storage module

    config RT_RKADK_ENABLE_DISPLAY
        bool "display"
        default n
        help
            rkadk display module

    config RT_RKADK_ENABLE_PLAYER
        bool "player"
        default y
        help
            rkadk player module

    config RT_RKADK_BUILD_EXAMPLES
        bool "examples"
        default y
        help
            rkadk examples module

endif
```

## buildroot/configs/rockchip_rk3036_defconfig
```kconfig
#include "base/base.config"
#include "chips/rk3036_arm.config"
#include "font/chinese.config"
#include "fs/ntfs.config"
#include "gpu/gpu.config"
#include "multimedia/audio.config"
#include "multimedia/gst/audio.config"
#include "multimedia/gst/rtsp.config"
#include "multimedia/gst/video.config"
#include "multimedia/mpp.config"
#include "wifibt/bt.config"
#include "wifibt/wireless.config"
#include "tools/benchmark.config"
#include "tools/common.config"
#include "powermanager.config"
#include "weston.config"
# BR2_PREFER_ROCKCHIP_RGA is not set
```

## buildroot/configs/rockchip_rk3308_b_rkpartybox_defconfig
```kconfig
#include "base/base.config"
#include "chips/rk3308_aarch64.config"
#include "fs/vfat.config"
#include "multimedia/audio.config"
#include "wifibt/bt.config"
#include "wifibt/wireless.config"
#include "lvgl.config"
BR2_PACKAGE_BLUEZ_ALSA=y
BR2_PACKAGE_COREUTILS=y
BR2_PACKAGE_EVTEST=y
BR2_PACKAGE_HOST_LINUX_HEADERS_CUSTOM_5_10=y
BR2_PACKAGE_I2C_TOOLS=y
BR2_PACKAGE_IW=y
# BR2_PACKAGE_LVGL_DEMO is reset to default
# BR2_PACKAGE_PULSEAUDIO is reset to default
BR2_PACKAGE_RKPARTYBOX=y
# BR2_PACKAGE_RKWIFIBT_APP is reset to default
# BR2_PACKAGE_ROCKCHIP_ALSA_CONFIG is reset to default
BR2_PACKAGE_SPEEX=y
BR2_PACKAGE_STRACE=y
BR2_STRIP_EXCLUDE_FILES="rkpartybox librockit.so"
BR2_TARGET_GENERIC_HOSTNAME="rk3308_64"
```

## buildroot/configs/rockchip_rk3308_b_rkpartybox_nodisp_defconfig
```kconfig
#include "base/base.config"
#include "chips/rk3308_aarch64.config"
#include "fs/vfat.config"
#include "wifibt/wireless.config"
#include "multimedia/audio.config"
BR2_PACKAGE_COREUTILS=y
BR2_PACKAGE_EVTEST=y
BR2_PACKAGE_HOST_LINUX_HEADERS_CUSTOM_5_10=y
BR2_PACKAGE_I2C_TOOLS=y
BR2_PACKAGE_IW=y
# BR2_PACKAGE_PULSEAUDIO is reset to default
BR2_PACKAGE_RK3308_RKPARTYBOX_BTMCU=y
BR2_PACKAGE_RKPARTYBOX=y
# BR2_PACKAGE_ROCKCHIP_ALSA_CONFIG is reset to default
BR2_PACKAGE_SPEEX=y
BR2_PACKAGE_STRACE=y
BR2_STRIP_EXCLUDE_FILES="rkpartybox librockit.so"
BR2_TARGET_GENERIC_HOSTNAME="rk3308_64"
```

## buildroot/configs/rockchip_rk3308_bs_32_ia_release_defconfig
```kconfig
#include "base/base.config"
#include "chips/rk3308_arm.config"
#include "fs/vfat.config"
#include "multimedia/audio.config"
#include "wifibt/bt.config"
#include "wifibt/wireless.config"
#include "lvgl/lvgl_drm.config"
#include "lvgl/rk_demo.config"
# BR2_PACKAGE_ANDROID_ADBD is reset to default
# BR2_PACKAGE_EUDEV_ENABLE_HWDB is not set
BR2_PACKAGE_HOST_LINUX_HEADERS_CUSTOM_5_10=y
# BR2_PACKAGE_INPUT_EVENT_DAEMON is reset to default
BR2_PACKAGE_LOCKFILE_PROGS=y
# BR2_PACKAGE_PM_UTILS is reset to default
# BR2_PACKAGE_RKSCRIPT is reset to default
# BR2_PACKAGE_ROCKCHIP_ALSA_CONFIG is reset to default
# BR2_PACKAGE_USBMOUNT is reset to default
BR2_STRIP_EXCLUDE_FILES="rk_demo librkadk.so libgraphic_lsf.so librockit.so librkaudio.so librkdemuxer.so librkmuxer.so"
BR2_TARGET_GENERIC_HOSTNAME="rk3308_32"
```

## buildroot/configs/rockchip_rk3308_tiny_recovery_defconfig
```kconfig
#include "chips/rk3308_arm.config"
#include "base/tiny.config"
BR2_PACKAGE_HOST_LINUX_HEADERS_CUSTOM_5_10=y
BR2_PACKAGE_TAR=y
BR2_ROOTFS_POST_BUILD_SCRIPT+="board/rockchip/common/tinyrecovery/post-build-tinyrecovery.sh"
```

## buildroot/configs/rockchip_rk3328_recovery_defconfig
```kconfig
#include "base/base.config"
#include "base/recovery.config"
#include "chips/rk3328_aarch64.config"
BR2_PACKAGE_RECOVERY_NO_UI=y
```

## buildroot/configs/rockchip_rk3502_recovery_defconfig
```kconfig
BR2_arm=y
BR2_cortex_a7=y
BR2_ARM_INSTRUCTIONS_THUMB2=y
BR2_TOOLCHAIN_BUILDROOT_CXX=y
BR2_PRIMARY_SITE="http://sources.buildroot.net"
BR2_BACKUP_SITE=""
BR2_GNU_MIRROR="http://mirrors.kernel.org/gnu"
BR2_OPTIMIZE_S=y
BR2_FORCE_HOST_BUILD=y
BR2_TIME_BITS_64=y
BR2_SSP_REGULAR=y
BR2_TARGET_GENERIC_HOSTNAME="rk3506"
BR2_TARGET_GENERIC_ISSUE="Welcome to RK3502 Buildroot"
BR2_ROOTFS_MERGED_USR=y
BR2_TARGET_GENERIC_ROOT_PASSWD="rockchip"
BR2_SYSTEM_BIN_SH_BUSYBOX=y
# BR2_TARGET_GENERIC_REMOUNT_ROOTFS_RW is not set
BR2_ROOTFS_OVERLAY="board/rockchip/common/base board/rockchip/rk3506/fs-overlay/ board/rockchip/rk3506/fs-robot-overlay/"
BR2_LINUX_KERNEL_CUSTOM_LOCAL=y
BR2_LINUX_KERNEL_CUSTOM_LOCAL_LOCATION="$(TOPDIR)/../kernel"
BR2_PACKAGE_ROCKCHIP=y
BR2_PACKAGE_RK3506=y
BR2_PACKAGE_RECOVERY=y
BR2_PACKAGE_RECOVERY_NO_UI=y
BR2_PACKAGE_RECOVERY_USE_UPDATEENGINE=y
BR2_PACKAGE_RECOVERY_RECOVERYBIN=y
BR2_PACKAGE_RKSCRIPT=y
BR2_PACKAGE_RKTOOLKIT=y
BR2_PACKAGE_BUSYBOX_CONFIG="package/busybox/busybox-minimal.config"
BR2_PACKAGE_BUSYBOX_CONFIG_FRAGMENT_FILES="board/rockchip/common/tinyrootfs/busybox.fragment"
BR2_PACKAGE_BUSYBOX_SHOW_OTHERS=y
BR2_PACKAGE_MTD=y
BR2_PACKAGE_MTD_MKFSUBIFS=y
BR2_PACKAGE_UTIL_LINUX_LIBBLKID=y
BR2_TARGET_ROOTFS_CPIO=y
BR2_TARGET_ROOTFS_CPIO_XZ=y
BR2_TARGET_ROOTFS_SQUASHFS=y
BR2_TARGET_ROOTFS_SQUASHFS4_XZ=y
BR2_PACKAGE_HOST_E2FSPROGS=y
BR2_PACKAGE_HOST_ENVIRONMENT_SETUP=y
BR2_PACKAGE_HOST_NTFS_3G=y
BR2_PACKAGE_HOST_PYTHON3=y
BR2_PACKAGE_HOST_PYTHON3_SSL=y
```

## buildroot/configs/rockchip_rk3502_robot_defconfig
```kconfig
BR2_arm=y
BR2_cortex_a7=y
BR2_TOOLCHAIN_BUILDROOT_CXX=y
BR2_PRIMARY_SITE="http://sources.buildroot.net"
BR2_BACKUP_SITE=""
BR2_GNU_MIRROR="http://mirrors.kernel.org/gnu"
BR2_OPTIMIZE_S=y
BR2_FORCE_HOST_BUILD=y
BR2_TIME_BITS_64=y
BR2_SSP_REGULAR=y
BR2_TARGET_GENERIC_HOSTNAME="rk3506"
BR2_TARGET_GENERIC_ISSUE="Welcome to RK3502 Buildroot"
BR2_ROOTFS_DEVICE_CREATION_DYNAMIC_EUDEV=y
BR2_ROOTFS_MERGED_USR=y
BR2_TARGET_GENERIC_ROOT_PASSWD="rockchip"
BR2_SYSTEM_BIN_SH_BUSYBOX=y
# BR2_TARGET_GENERIC_REMOUNT_ROOTFS_RW is not set
BR2_ROOTFS_OVERLAY="board/rockchip/common/base board/rockchip/rk3506/fs-overlay/ board/rockchip/rk3506/fs-robot-overlay/"
BR2_ROOTFS_POST_BUILD_SCRIPT="board/rockchip/common/post-build.sh"
BR2_LINUX_KERNEL_CUSTOM_LOCAL=y
BR2_LINUX_KERNEL_CUSTOM_LOCAL_LOCATION="$(TOPDIR)/../kernel"
BR2_PACKAGE_ROCKCHIP=y
BR2_PACKAGE_RK3506=y
BR2_PACKAGE_RKSCRIPT=y
BR2_PACKAGE_RKTOOLKIT=y
BR2_PACKAGE_RKWIFIBT=y
BR2_PACKAGE_BUSYBOX_CONFIG_FRAGMENT_FILES="board/rockchip/common/base/busybox.fragment"
BR2_PACKAGE_BUSYBOX_SHOW_OTHERS=y
BR2_PACKAGE_ALSA_UTILS=y
# BR2_PACKAGE_ALSA_UTILS_ALSACTL is not set
# BR2_PACKAGE_ALSA_UTILS_ALSAMIXER is not set
BR2_PACKAGE_ALSA_UTILS_AMIXER=y
BR2_PACKAGE_ALSA_UTILS_APLAY=y
BR2_PACKAGE_STRESS_NG=y
BR2_PACKAGE_STRESSAPPTEST=y
BR2_PACKAGE_MTD=y
# BR2_PACKAGE_EUDEV_ENABLE_HWDB is not set
BR2_PACKAGE_I2C_TOOLS=y
BR2_PACKAGE_INPUT_EVENT_DAEMON=y
BR2_PACKAGE_MEMTESTER=y
# BR2_PACKAGE_ALSA_LIB_RAWMIDI is not set
# BR2_PACKAGE_ALSA_LIB_HWDEP is not set
BR2_PACKAGE_READLINE=y
BR2_PACKAGE_WPA_SUPPLICANT=y
BR2_PACKAGE_WPA_SUPPLICANT_EAP=y
BR2_PACKAGE_WPA_SUPPLICANT_PASSPHRASE=y
BR2_PACKAGE_LOCKFILE_PROGS=y
BR2_PACKAGE_ANDROID_ADBD=y
BR2_PACKAGE_PROCPS_NG=y
BR2_PACKAGE_PROCRANK_LINUX=y
BR2_PACKAGE_UTIL_LINUX_MOUNT=y
BR2_TARGET_ROOTFS_CPIO=y
BR2_TARGET_ROOTFS_CPIO_GZIP=y
BR2_TARGET_ROOTFS_SQUASHFS4_XZ=y
BR2_TARGET_ROOTFS_UBI=y
BR2_TARGET_ROOTFS_UBI_SQUASHFS=y
BR2_TARGET_ROOTFS_UBI_SUBSIZE=2048
BR2_TARGET_ROOTFS_UBIFS=y
BR2_TARGET_ROOTFS_UBIFS_LEBSIZE=0x1f000
BR2_PACKAGE_HOST_E2FSPROGS=y
BR2_PACKAGE_HOST_ENVIRONMENT_SETUP=y
BR2_PACKAGE_HOST_NTFS_3G=y
BR2_PACKAGE_HOST_PYTHON3=y
BR2_PACKAGE_HOST_PYTHON3_SSL=y
BR2_PACKAGE_HOST_RUSTC=y
```

## buildroot/configs/rockchip_rk3506_defconfig
```kconfig
#include "base/base.config"
#include "chips/rk3506_arm.config"
#include "fs/vfat.config"
#include "wifibt/bt.config"
#include "wifibt/wireless.config"
#include "multimedia/audio.config"
#include "wifibt/bt.config"
#include "wifibt/wireless.config"
#include "lvgl/lvgl_rkadk.config"
#include "lvgl/rk_demo.config"
# BR2_PACKAGE_CHRONY is reset to default
# BR2_PACKAGE_DNSMASQ is reset to default
# BR2_PACKAGE_DROPBEAR is reset to default
BR2_PACKAGE_EVTEST=y
BR2_PACKAGE_HOST_LINUX_HEADERS_CUSTOM_6_1=y
BR2_PACKAGE_LIBCAP=y
BR2_PACKAGE_MHZ=y
BR2_PACKAGE_MTD=y
# BR2_PACKAGE_PULSEAUDIO is reset to default
BR2_PACKAGE_RIPGREP=y
BR2_PACKAGE_RKADK_EXAMPLES=y
BR2_PACKAGE_ROCKCHIP_RGA=y
BR2_PACKAGE_ROCKCHIP_TEST=y
BR2_RK_DEMO_ENABLE_ASR=y
BR2_ROCKCHIP_ALSA_CONFIG_INSTALL_INIT_SCRIPT=y
BR2_ROOTFS_OVERLAY+="board/rockchip/rk3506/fast-display-overlay/"
BR2_ROOTFS_POST_BUILD_SCRIPT+="board/rockchip/rk3506/post-build-fast-display.sh"
# BR2_TARGET_GENERIC_REMOUNT_ROOTFS_RW is not set
BR2_TARGET_ROOTFS_SQUASHFS4_ZSTD=y
BR2_TARGET_ROOTFS_UBI=y
BR2_TARGET_ROOTFS_UBI_SQUASHFS=y
# BR2_TARGET_ROOTFS_UBI_SQUASHFS_STATIC is not set
BR2_TARGET_ROOTFS_UBI_SUBSIZE=2048
BR2_TIME_BITS_64=y
BR2_PACKAGE_RECOVERY=y
BR2_PACKAGE_RECOVERY_NO_UI=y
BR2_PACKAGE_RECOVERY_USE_UPDATEENGINE=y
BR2_PACKAGE_RECOVERY_UPDATEENGINEBIN=y
```

## buildroot/configs/rockchip_rk3506_luckfox_defconfig
```kconfig
#include "base/base.config"
#include "fs/vfat.config"
#include "multimedia/audio.config"
#include "lvgl/lvgl_rkadk.config"
#include "fs/ubifs.config"
BR2_PACKAGE_CAN_UTILS=y
BR2_PACKAGE_DIALOG=y
BR2_PACKAGE_DNSMASQ=y
BR2_PACKAGE_DTC=y
BR2_PACKAGE_DTC_PROGRAMS=y
BR2_PACKAGE_EVTEST=y
BR2_PACKAGE_FREETYPE=y
BR2_PACKAGE_HOSTAPD=y
BR2_PACKAGE_HOSTAPD_EAP=y
BR2_PACKAGE_HOST_DTC=y
BR2_PACKAGE_HOST_LINUX_HEADERS_CUSTOM_6_1=y
BR2_PACKAGE_IPERF3=y
BR2_PACKAGE_IPROUTE2=y
BR2_PACKAGE_LIBCAP=y
BR2_PACKAGE_LIBCURL=y
BR2_PACKAGE_LIBEVDEV=y
BR2_PACKAGE_LIBJPEG=y
BR2_PACKAGE_LIBOPENSSL_BIN=y
# BR2_PACKAGE_LVGL is reset to default
BR2_PACKAGE_MHZ=y
BR2_PACKAGE_NANO=y
BR2_PACKAGE_OPENSSH=y
BR2_PACKAGE_OPENSSH_GEN_KEYS=y
BR2_PACKAGE_PCRE2_16=y
BR2_PACKAGE_PCRE2_32=y
BR2_PACKAGE_PHYTOOL=y
# BR2_PACKAGE_PULSEAUDIO is reset to default
BR2_PACKAGE_PYTHON3=y
BR2_PACKAGE_PYTHON3_SSL=y
BR2_PACKAGE_PYTHON_AIOHTTP=y
BR2_PACKAGE_PYTHON_CANOPEN=y
BR2_PACKAGE_PYTHON_CLICK=y
BR2_PACKAGE_PYTHON_ITSDANGEROUS=y
BR2_PACKAGE_PYTHON_JINJA2=y
BR2_PACKAGE_PYTHON_PERIPHERY=y
BR2_PACKAGE_PYTHON_PILLOW=y
BR2_PACKAGE_PYTHON_SERIAL=y
BR2_PACKAGE_PYTHON_SETUPTOOLS=y
BR2_PACKAGE_PYTHON_SMBUS_CFFI=y
BR2_PACKAGE_PYTHON_SPIDEV=y
BR2_PACKAGE_PYTHON_WERKZEUG=y
BR2_PACKAGE_RIPGREP=y
BR2_PACKAGE_RK3506=y
BR2_PACKAGE_RKADK=y
BR2_PACKAGE_RKADK_DISPLAY=y
BR2_PACKAGE_RKADK_EXAMPLES=y
BR2_PACKAGE_RKADK_PLAYER=y
BR2_PACKAGE_RKWIFIBT_APP=y
BR2_PACKAGE_ROCKCHIP_RGA=y
BR2_PACKAGE_ROCKCHIP_TEST=y
BR2_PACKAGE_UTIL_LINUX_AGETTY=y
BR2_PACKAGE_VIM=y
# BR2_PREFER_ROCKCHIP_RGA is not set
BR2_ROCKCHIP_ALSA_CONFIG_INSTALL_INIT_SCRIPT=y
BR2_ROOTFS_OVERLAY+="board/rockchip/rk3506/fast-display-overlay/ board/rockchip/rk3506/luckfox-overlay/"
BR2_ROOTFS_POST_BUILD_SCRIPT+="board/rockchip/rk3506/post-build-fast-display.sh"
BR2_TARGET_GENERIC_HOSTNAME="luckfox"
BR2_TARGET_GENERIC_ISSUE="Welcome to Luckfox Lyra [root:luckfox]"
# BR2_TARGET_GENERIC_REMOUNT_ROOTFS_RW is not set
BR2_TARGET_GENERIC_ROOT_PASSWD="luckfox"
BR2_TARGET_ROOTFS_SQUASHFS4_ZSTD=y
BR2_TARGET_SERIAL_SHELL_GETTY=y
BR2_TIME_BITS_64=y
BR2_arm=y
BR2_cortex_a7=y
```

## buildroot/configs/rockchip_rk3506_recovery_defconfig
```kconfig
#include "base/base.config"
#include "base/recovery.config"
#include "chips/rk3506_arm.config"
BR2_PACKAGE_MTD=y
BR2_PACKAGE_RECOVERY=y
BR2_PACKAGE_RECOVERY_USE_UPDATEENGINE=y
BR2_PACKAGE_RECOVERY_RECOVERYBIN=y
BR2_PACKAGE_RECOVERY_UPDATEENGINEBIN=y
BR2_PACKAGE_RECOVERY_NO_UI=y
```

## buildroot/configs/rockchip_rk3506_tiny_defconfig
```kconfig
#include "base/base.config"
#include "chips/rk3506_arm.config"
#include "fs/vfat.config"
#include "wifibt/bt.config"
#include "wifibt/wireless.config"
#include "multimedia/audio.config"
#include "wifibt/bt.config"
#include "wifibt/wireless.config"
BR2_PACKAGE_HOST_LINUX_HEADERS_CUSTOM_6_1=y
BR2_PACKAGE_MHZ=y
BR2_PACKAGE_MTD=y
# BR2_PACKAGE_PULSEAUDIO is reset to default
BR2_PACKAGE_RIPGREP=y
BR2_ROCKCHIP_ALSA_CONFIG_INSTALL_INIT_SCRIPT=y
BR2_TARGET_ROOTFS_SQUASHFS4_XZ=y
BR2_TARGET_ROOTFS_UBI=y
BR2_TARGET_ROOTFS_UBI_SQUASHFS=y
# BR2_TARGET_ROOTFS_UBI_SQUASHFS_STATIC is not set
BR2_TARGET_ROOTFS_UBI_SUBSIZE=2048
```

## buildroot/configs/rockchip_rk3576_cluster_defconfig
```kconfig
#include "base/base.config"
#include "bus/can.config"
#include "bus/pci.config"
#include "chips/rk3576_aarch64.config"
#include "font/chinese.config"
#include "fs/exfat.config"
#include "fs/ntfs.config"
#include "fs/vfat.config"
#include "base/base.config"
#include "gpu/gpu.config"
#include "weston.config"
#include "network/network.config"
#include "tools/benchmark.config"
#include "tools/common.config"
#include "tools/test.config"
#include "network/chromium.config"
BR2_GDB_VERSION_12=y
BR2_PACKAGE_ALSA_PLUGINS=y
BR2_PACKAGE_ALSA_UCM_CONF=y
BR2_PACKAGE_ALSA_UTILS=y
BR2_PACKAGE_ALSA_UTILS_ALSACONF=y
BR2_PACKAGE_ALSA_UTILS_AMIXER=y
BR2_PACKAGE_ALSA_UTILS_APLAY=y
BR2_PACKAGE_BRIDGE_UTILS=y
BR2_PACKAGE_ETHTOOL=y
BR2_PACKAGE_GDB=y
BR2_PACKAGE_GDB_DEBUGGER=y
BR2_PACKAGE_HOST_GDB=y
BR2_PACKAGE_HOST_LINUX_HEADERS_CUSTOM_6_1=y
BR2_PACKAGE_IPERF3=y
BR2_PACKAGE_LIBV4L=y
BR2_PACKAGE_LIBV4L_UTILS=y
BR2_PACKAGE_WESTON_DEFAULT_PIXMAN=y
BR2_PACKAGE_WESTON_WAYLAND=y
BR2_ROOTFS_OVERLAY+="board/rockchip/rk3576/fs-overlay-cluster/"
BR2_SYSTEM_BIN_SH_BUSYBOX=y
```

## buildroot/configs/rockchip_rk3576_ipc_defconfig
```kconfig
#include "base/base.config"
#include "chips/rk3576_aarch64.config"
#include "fs/exfat.config"
#include "fs/ntfs.config"
#include "fs/vfat.config"
#include "gpu/gpu.config"
#include "multimedia/audio.config"
#include "multimedia/camera.config"
#include "multimedia/mpp.config"
#include "products/ipc.config"
#include "npu2.config"
BR2_PACKAGE_CAMERA_ENGINE_RKAIQ_INSTALL_AIISP=y
BR2_PACKAGE_IVA_RK3576=y
BR2_PACKAGE_RKIPC_RK3576=y
BR2_ROOTFS_OVERLAY="board/rockchip/common/base board/rockchip/rk3576/fs-overlay-ipc/"
```

## buildroot/configs/rockchip_rk3576_multi_ipc_defconfig
```kconfig
#include "rockchip_rk3576_ipc_defconfig"
BR2_PACKAGE_AVS=y
BR2_PACKAGE_RKIPC_RK3576_MULTI_IPC=y
```

## buildroot/configs/rockchip_rk3576_ramboot_defconfig
```kconfig
#include "chips/rk3576_aarch64.config"
#include "base/kernel.config"
BR2_TARGET_ROOTFS_CPIO=y
BR2_TARGET_ROOTFS_CPIO_GZIP=y
BR2_PACKAGE_LUKSMETA=y
BR2_ROOTFS_OVERLAY+="board/rockchip/common/security-ramdisk-overlay/"
```

## buildroot/configs/rockchip_rk3588_ipc_defconfig
```kconfig
#include "rockchip_rk3588_defconfig"
#include "gpu/gpu.config"
#include "multimedia/audio.config"
#include "multimedia/camera.config"
#include "multimedia/mpp.config"
#include "products/ipc.config"
#include "npu2.config"
# BR2_PACKAGE_PULSEAUDIO_DAEMON is reset to default
# BR2_PACKAGE_ROCKCHIP_MALI_HAS_GBM is reset to default
# BR2_PACKAGE_STRESS_NG is reset to default
# BR2_PACKAGE_WESTON is reset to default
BR2_ROOTFS_OVERLAY="board/rockchip/rk3588/fs-overlay-ipc/"
# BR2_PACKAGE_WAYLAND is reset to default
```
