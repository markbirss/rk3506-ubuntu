/* Automatically generated file; DO NOT EDIT. */
/* RT-Thread Configuration */
/* HAL_NPU_MCU_CORE is not set */
/* HAL_DDR_MCU_CORE is not set */
/* RT-Thread Kernel */
/* RT_USING_CORE_FREERTOS is not set */
/* RT_THREAD_PRIORITY_8 is not set */
/* RT_THREAD_PRIORITY_256 is not set */
/* RT_USING_TIMER_SOFT is not set */
/* RT_DEBUG_INIT_CONFIG is not set */
/* RT_DEBUG_USING_GPIO is not set */
/* RT_DEBUG_THREAD_CONFIG is not set */
/* RT_DEBUG_SCHEDULER_CONFIG is not set */
/* RT_DEBUG_IPC_CONFIG is not set */
/* RT_DEBUG_TIMER_CONFIG is not set */
/* RT_DEBUG_IRQ_CONFIG is not set */
/* RT_DEBUG_MEM_CONFIG is not set */
/* RT_DEBUG_SLAB_CONFIG is not set */
/* RT_DEBUG_MEMHEAP_CONFIG is not set */
/* RT_DEBUG_MODULE_CONFIG is not set */
/* Inter-Thread communication */
/* RT_USING_SIGNALS is not set */
/* Memory Management */
/* RT_USING_MEMHEAP is not set */
/* RT_USING_NOHEAP is not set */
/* RT_USING_SLAB is not set */
/* RT_USING_MEMTRACE is not set */
/* Kernel Device Object */
/* RT_USING_DEVICE_OPS is not set */
/* RT_USING_INTERRUPT_INFO is not set */
/* ARCH_CPU_STACK_GROWS_UPWARD is not set */
/* RT-Thread Components */
/* C++ features */
/* RT_USING_CPLUSPLUS is not set */
/* Command shell */
/* FINSH_ECHO_DISABLE_DEFAULT is not set */
/* FINSH_USING_AUTH is not set */
/* Device virtual file system */
/* RT_USING_DFS is not set */
/* Device Drivers */
/* RT_USING_CAN is not set */
/* RT_USING_HWTIMER is not set */
/* RT_USING_CPUTIME is not set */
/* RT_USING_I2C is not set */
/* RT_USING_PIN is not set */
/* RT_USING_ADC is not set */
/* RT_USING_PWM is not set */
/* RT_USING_MTD_NOR is not set */
/* RT_USING_MTD_NAND is not set */
/* RT_USING_MTD is not set */
/* RT_USING_PM is not set */
/* RT_USING_RTC is not set */
/* RT_USING_SDIO is not set */
/* RT_USING_SPI is not set */
/* RT_USING_WDT is not set */
/* RT_USING_AUDIO is not set */
/* RT_USING_SENSOR is not set */
/* RT_USING_TOUCH is not set */
/* Using WiFi */
/* RT_USING_WIFI is not set */
/* Using USB */
/* RT_USING_USB_HOST is not set */
/* RT_USING_USB_DEVICE is not set */
/* POSIX layer and C standard library */
/* RT_USING_PTHREADS is not set */
/* RT_USING_MODULE is not set */
/* Network */
/* Socket abstraction layer */
/* RT_USING_SAL is not set */
/* light weight TCP/IP stack */
/* RT_USING_LWIP is not set */
/* Modbus master and slave stack */
/* RT_USING_MODBUS is not set */
/* AT commands */
/* RT_USING_AT is not set */
/* System */
/* RT_USING_LITTLEVGL2RTT is not set */
/* VBUS(Virtual Software BUS) */
/* RT_USING_VBUS is not set */
/* Utilities */
/* RT_USING_CMBACKTRACE is not set */
/* RT_USING_LOGTRACE is not set */
/* RT_USING_RYM is not set */
/* RT_USING_ULOG is not set */
/* RT_USING_UTEST is not set */
/* ARM CMSIS */
/* RT_USING_CMSIS_OS is not set */
/* RT_USING_RTT_CMSIS is not set */
/* RT-Thread Benchmarks */
/* RT_USING_BENCHMARK is not set */
/* RT_USING_NET_HTTP is not set */
/* RT_USING_OTA is not set */
/* RT-Thread rockchip common drivers */
/* HAL_DBG_ON is not set */
/* RT_USING_SND_GLB_RST is not set */
/* RT_USING_RESET is not set */
/* RT_USING_REGULATOR_DUMP is not set */
/* RT_USING_PROF_IRQ is not set */
/* RT_USING_PMIC is not set */
/* RT_USING_UNCACHE_HEAP is not set */
/* RT_USING_LARGE_HEAP is not set */
/* RT_USING_DTCM_HEAP is not set */
/* RT_USING_PSRAM_HEAP is not set */
/* Enable Fault Dump Hook */
/* RT_USING_SNOR is not set */
/* RT-Thread rockchip jpeg enc driver */
/* RT_USING_JPEG_ENC is not set */
/* RT-Thread rockchip pm drivers */
/* RT_USING_PM_DVFS is not set */
/* RT_USING_PM_REQ_PWR is not set */
/* RT_USING_PM_REQ_CLK is not set */
/* RT_USING_DVFS_DBG is not set */
/* RT_USING_PM_RUNTIME is not set */
/* RT_USING_PM_TIMER is not set */
/* RT-Thread rockchip mipi-dphy driver */
/* RT_USING_MIPI_DPHY is not set */
/* RT-Thread rockchip isp driver */
/* RT_USING_ISP is not set */
/* RT-Thread rockchip vcm driver */
/* RT_USING_VCM is not set */
/* RT-Thread rockchip vicap driver */
/* RT_USING_VICAP is not set */
/* RT-Thread rockchip camera driver */
/* RT_USING_CAMERA is not set */
/* RT-Thread rockchip vicap_lite driver */
/* RT_USING_VICAP_LITE is not set */
/* RT-Thread rockchip csi2host driver */
/* RT_USING_CSI2HOST is not set */
/* RT-Thread rockchip buffer_manage driver */
/* RT_USING_BUFFER_MANAGE is not set */
/* RT_USING_SENSOR_HUB is not set */
/* RT_USING_QPIPSRAM is not set */
/* RT-Thread rockchip coredump driver */
/* RT_USING_COREDUMP is not set */
/* RT_USING_SPINAND is not set */
/* Enable PSTORE */
/* RT_USING_PSTORE is not set */
/* RT-Thread rockchip rk3588_mcu drivers */
/* RT_USING_CRU is not set */
/* Enable UART */
/* RT_USING_UART0 is not set */
/* RT-Thread board config */
/* RT_USING_JTAG is not set */
/* RT-Thread Common Test case */
/* RT_USING_TC is not set */
/* RT_USING_FILE_TEST is not set */
/* RT_USING_AUTO_TEST is not set */
/* RT_USING_COMMON_TEST_SUSPEND is not set */
/* RT_USING_COMMON_TEST_CPU_USAGE is not set */
/* RT_USING_COMMON_TEST_DCACHE is not set */
/* RT_USING_COMMON_TEST_ICACHE is not set */
/* RT_USING_COMMON_TEST_INTC is not set */
/* RT_USING_COMMON_MEMTESTER is not set */
/* RT_USING_COMMON_TEST_MPU is not set */
/* RT_USING_COMMON_TEST_PM is not set */
/* RT_USING_COMMON_TEST_SNOR is not set */
/* RT_USING_COMMON_STRESS_TEST is not set */
/* RT_USING_COMMON_TEST_PERFORMANCE is not set */
/* RT_USING_COMMON_TEST_TIMER is not set */
MEMORY
{
    DDR (rxw) : ORIGIN = 0x00000000, LENGTH = 512K
    TCM (rxw) : ORIGIN = 0x20000000, LENGTH = 16K
}
MAIN_STACK_SIZE = 0x400;
ENTRY(Reset_Handler)
SECTIONS
{
    DDR_VECTOR_DEST = ORIGIN(DDR);
    DDR_VECTOR_SRC = DDR_VECTOR_DEST;
    .ddr.vectors DDR_VECTOR_DEST : AT (DDR_VECTOR_SRC)
    {
        . = ALIGN(4);
        KEEP(*(.vectors))
        *start_m0.o(.text .text.* .rodata .rodata*)
        . = ALIGN(4);
    }
    TCM_TEXT_DEST = ORIGIN(TCM);
    TCM_TEXT_SRC = LOADADDR(.ddr.vectors) + SIZEOF(.ddr.vectors);
    .tcm.text TCM_TEXT_DEST : AT (TCM_TEXT_SRC)
    {
        . = ALIGN(4);
        KEEP(*(.tcm.text))
        . = ALIGN(4);
    }
    TCM_BSS_DEST = ADDR(.tcm.text) + SIZEOF(.tcm.text);
    TCM_BSS_SRC = LOADADDR(.tcm.text) + SIZEOF(.tcm.text);
    .tcm.bss TCM_BSS_DEST : AT(TCM_BSS_SRC)
    {
        . = ALIGN(4);
        KEEP(*(.tcm.bss))
        . = ALIGN(4);
    }
    DDR_TEXT_SRC = LOADADDR(.tcm.bss) + SIZEOF(.tcm.bss);
    DDR_TEXT_DEST = DDR_TEXT_SRC;
    .ddr.text DDR_TEXT_DEST : AT (DDR_TEXT_SRC)
    {
        KEEP(*(.init))
        KEEP(*(.fini))
        *(.text) /* remaining code */
        *(.text.*) /* remaining code */
        *(.rodata) /* read-only data (constants) */
        *(.rodata*)
        *(.glue_7)
        *(.glue_7t)
        *(.gnu.linkonce.t*)
        . = ALIGN(4);
        PROVIDE(__ctors_start__ = .);
        /* old GCC version uses .ctors */
        KEEP(*(SORT(.ctors.*)))
        KEEP(*(.ctors))
        /* new GCC version uses .init_array */
        KEEP (*(SORT(.init_array.*)))
        KEEP (*(.init_array))
        PROVIDE(__ctors_end__ = .);
        /* section information for finsh shell */
        . = ALIGN(4);
        __fsymtab_start = .;
        KEEP(*(FSymTab))
        __fsymtab_end = .;
        . = ALIGN(4);
        __vsymtab_start = .;
        KEEP(*(VSymTab))
        __vsymtab_end = .;
        . = ALIGN(4);
        /* section information for initial. */
        . = ALIGN(4);
        __rt_init_start = .;
        KEEP(*(SORT(.rti_fn*)))
        __rt_init_end = .;
        . = ALIGN(4);
        /* section information for modules */
        . = ALIGN(4);
        __rtmsymtab_start = .;
        KEEP(*(RTMSymTab))
        __rtmsymtab_end = .;
        . = ALIGN(4);
        . = ALIGN(32);
    }
    DDR_DATA_SRC = LOADADDR(.ddr.text) + SIZEOF(.ddr.text);
    DDR_DATA_DEST = DDR_DATA_SRC;
    .ddr.data DDR_DATA_DEST : AT (DDR_DATA_SRC)
    {
        . = ALIGN(32);
        __data_start__ = .;
        KEEP(*(.sram.data))
        *(vtable)
        *(.data*)
        . = ALIGN(4);
        PROVIDE(__dtors_start__ = .);
        KEEP(*(SORT(.dtors.*)))
        KEEP(*(.dtors))
        PROVIDE(__dtors_end__ = .);
        . = ALIGN(4);
        /* preinit data */
        PROVIDE_HIDDEN (__preinit_array_start = .);
        KEEP(*(.preinit_array))
        PROVIDE_HIDDEN (__preinit_array_end = .);
        . = ALIGN(4);
        /* init data */
        PROVIDE_HIDDEN (__init_array_start = .);
        KEEP(*(SORT(.init_array.*)))
        KEEP(*(.init_array))
        PROVIDE_HIDDEN (__init_array_end = .);
        . = ALIGN(4);
        /* finit data */
        PROVIDE_HIDDEN (__fini_array_start = .);
        KEEP(*(SORT(.fini_array.*)))
        KEEP(*(.fini_array))
        PROVIDE_HIDDEN (__fini_array_end = .);
        KEEP(*(.jcr*))
        . = ALIGN(4);
        /* All data end */
        __data_end__ = .;
    }
    COPY_TABLE_DEST = LOADADDR(.ddr.data) + SIZEOF(.ddr.data);
    COPY_TABLE_SRC = COPY_TABLE_DEST;
    .copy.table COPY_TABLE_DEST : AT (COPY_TABLE_SRC)
    {
        . = ALIGN(4);
        __copy_table_start__ = .;
        LONG (LOADADDR(.tcm.text))
        LONG (ADDR(.tcm.text))
        LONG (SIZEOF(.tcm.text))
        __copy_table_end__ = .;
    }
    ZERO_TABLE_DEST = LOADADDR(.copy.table) + SIZEOF(.copy.table);
    ZERO_TABLE_SRC = ZERO_TABLE_DEST;
    .zero.table ZERO_TABLE_DEST : AT (ZERO_TABLE_SRC)
    {
        . = ALIGN(4);
        __zero_table_start__ = .;
        LONG (ADDR(.ddr.bss))
        LONG (SIZEOF(.ddr.bss))
        LONG (ADDR(.tcm.bss))
        LONG (SIZEOF(.tcm.bss))
        __zero_table_end__ = .;
    }
    .ARM.exidx (ADDR(.zero.table) + SIZEOF(.zero.table)) : AT (LOADADDR(.zero.table) + SIZEOF(.zero.table))
    {
        __exidx_start = .;
        *(.ARM.exidx* .gnu.linkonce.armexidx.*)
        /* This is used by the startup in order to initialize the .data secion */
        _sidata = .;
        __exidx_end = .;
    }
    .ARM.extab (ADDR(.ARM.exidx) + SIZEOF(.ARM.exidx)) : AT (LOADADDR(.ARM.exidx) + SIZEOF(.ARM.exidx))
    {
        *(.ARM.extab* .gnu.linkonce.armextab.*)
    }
    SRAM_BSS_DEST = ADDR(.ARM.extab) + SIZEOF(.ARM.extab);
    .ddr.bss SRAM_BSS_DEST (NOLOAD) :
    {
        . = ALIGN(4);
        __bss_start__ = .;
        *(.bss*)
        *(COMMON)
        __bss_end__ = .;
        . = ALIGN(4);
    }
    PROVIDE( __sram_heap_start__ = ADDR(.ddr.bss) + SIZEOF(.ddr.bss) );
    MAIN_STACK_DEST = ORIGIN(DDR) + LENGTH(DDR) - MAIN_STACK_SIZE;
    .stack MAIN_STACK_DEST (NOLOAD) :
    {
        PROVIDE( __sram_heap_end__ = . );
        . = ALIGN(4);
        _sstack = .;
        . = . + MAIN_STACK_SIZE;
        _estack = .;
        . = ALIGN(4);
        PROVIDE(__StackTop = .);
    }
}
