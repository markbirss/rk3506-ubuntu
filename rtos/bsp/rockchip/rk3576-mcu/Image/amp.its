## rtos/components/system/lvgl/Kconfig
```kconfig
# Kconfig file for LVGL v8.0

menu "LVGL configuration"

    # Define CONFIG_RT_LV_CONF_SKIP so we can use LVGL
    # without lv_conf.h file, the lv_conf_internal.h and
    # lv_conf_kconfig.h files are used instead.
    config RT_LV_CONF_SKIP
        bool "Uncheck this to use custom lv_conf.h"
        default n

    config RT_LV_CONF_MINIMAL
        bool "LVGL minimal configuration."
        default n

    config RT_LV_DISP_DOUBLE_BUF
        bool "Display double buffer enable"
	default y

    menu "Color settings"
        choice LV_COLOR_DEPTH
            prompt "Color depth."
            default RT_LV_COLOR_DEPTH_16
            help
                Color depth to be used.

            config RT_LV_COLOR_DEPTH_32
                bool "32: ARGB8888"
            config RT_LV_COLOR_DEPTH_16
                bool "16: RGB565"
            config RT_LV_COLOR_DEPTH_8
                bool "8: RGB232"
            config RT_LV_COLOR_DEPTH_1
                bool "1: 1 byte per pixel"
        endchoice

        config LV_COLOR_DEPTH
            int
            default 1 if RT_LV_COLOR_DEPTH_1
            default 8 if RT_LV_COLOR_DEPTH_8
            default 16 if RT_LV_COLOR_DEPTH_16
            default 32 if RT_LV_COLOR_DEPTH_32

        config RT_LV_COLOR_16_SWAP
            bool "Swap the 2 bytes of RGB565 color. Useful if the display has an 8-bit interface (e.g. SPI)."
            depends on RT_LV_COLOR_DEPTH_16

        config RT_LV_COLOR_SCREEN_TRANSP
            bool "Enable more complex drawing routines to manage screens transparency."
            help
                Can be used if the UI is above another layer, e.g. an OSD menu or video player.
                The screen's `bg_opa` should be set to non LV_OPA_COVER value

        config LV_COLOR_MIX_ROUND_OFS
            int "Adjust color mix functions rounding"
            default 128 if !RT_LV_COLOR_DEPTH_32
            default 0 if RT_LV_COLOR_DEPTH_32
            range 0 254
            help
                0: no adjustment, get the integer part of the result (round down)
                64: round up from x.75
                128: round up from half
                192: round up from x.25
                254: round up

        config LV_COLOR_CHROMA_KEY_HEX
            hex "Images pixels with this color will not be drawn (if they are chroma keyed)."
            range 0x000000 0xFFFFFF
            default 0x00FF00
            help
                See misc/lv_color.h for some color values examples.
    endmenu

    menu "HAL Settings"
        config LV_DISP_DEF_REFR_PERIOD
            int "Default display refresh period (ms)."
            default 30
            help
                Can be changed in the display driver (`lv_disp_drv_t`).

        config LV_INDEV_DEF_READ_PERIOD
            int "Input device read period [ms]."
            default 30

        config LV_DPI_DEF
            int "Default Dots Per Inch (in px)."
            default 130
            help
                Used to initialize default sizes such as widgets sized, style paddings.
                (Not so important, you can adjust it to modify default sizes and spaces)
    endmenu

    menu "Feature configuration"

        menu "Drawing"
            config RT_LV_DRAW_COMPLEX
                bool "Enable complex draw engine"
                default y
                help
                    Required to draw shadow, gradient, rounded corners, circles, arc, skew lines,
                    image transformations or any masks.

            config LV_SHADOW_CACHE_SIZE
                int "Allow buffering some shadow calculation"
                depends on RT_LV_DRAW_COMPLEX
                default 0
                help
                    LV_SHADOW_CACHE_SIZE is the max shadow size to buffer, where
                    shadow size is `shadow_width + radius`.
                    Caching has LV_SHADOW_CACHE_SIZE^2 RAM cost.

            config LV_CIRCLE_CACHE_SIZE
                int "Set number of maximally cached circle data"
                depends on RT_LV_DRAW_COMPLEX
                default 4
                help
                    The circumference of 1/4 circle are saved for anti-aliasing
                    radius * 4 bytes are used per circle (the most often used
                    radiuses are saved).
                    Set to 0 to disable caching.

            config LV_LAYER_SIMPLE_BUF_SIZE
                int "Optimal size to buffer the widget with opacity"
                default 24576
                help
                    "Simple layers" are used when a widget has `style_opa < 255`
                    to buffer the widget into a layer and blend it as an image
                    with the given opacity. Note that `bg_opa`, `text_opa` etc
                    don't require buffering into layer.

            config LV_IMG_CACHE_DEF_SIZE
                int "Default image cache size. 0 to disable caching."
                default 0
                help
                    If only the built-in image formats are used there is no real advantage of caching.
                    (I.e. no new image decoder is added).

                    With complex image decoders (e.g. PNG or JPG) caching can
                    save the continuous open/decode of images.
                    However the opened images might consume additional RAM.

            config LV_GRADIENT_MAX_STOPS
                int "Number of stops allowed per gradient."
                default 2
                help
                    Increase this to allow more stops.
                    This adds (sizeof(lv_color_t) + 1) bytes per additional stop

            config LV_GRAD_CACHE_DEF_SIZE
                int "Default gradient buffer size."
                default 0
                help
                    When LVGL calculates the gradient "maps" it can save them into a cache to avoid calculating them again.
                    LV_GRAD_CACHE_DEF_SIZE sets the size of this cache in bytes.
                    If the cache is too small the map will be allocated only while it's required for the drawing.
                    0 mean no caching.

            config RT_LV_DITHER_GRADIENT
                bool "Allow dithering the gradients"
                help
                    Allow dithering the gradients (to achieve visual smooth color gradients on limited color depth display)
                    RT_LV_DITHER_GRADIENT implies allocating one or two more lines of the object's rendering surface
                    The increase in memory consumption is (32 bits * object width) plus 24 bits * object width if using error diffusion

            config RT_LV_DITHER_ERROR_DIFFUSION
                bool "Add support for error diffusion dithering"
                depends on RT_LV_DITHER_GRADIENT
                help
                    Error diffusion dithering gets a much better visual result, but implies more CPU consumption and memory when drawing.
                    The increase in memory consumption is (24 bits * object's width)

            config LV_DISP_ROT_MAX_BUF
                int "Maximum buffer size to allocate for rotation"
                default 10240
                help
                    Only used if software rotation is enabled in the display driver.
        endmenu

        menu "Logging"
            config RT_LV_USE_LOG
                bool "Enable the log module"

            choice
                bool "Default log verbosity" if RT_LV_USE_LOG
                default RT_LV_LOG_LEVEL_WARN
                help
                    Specify how important log should be added.

                config RT_LV_LOG_LEVEL_TRACE
                    bool "[Trace] A lot of logs to give detailed information"
                config RT_LV_LOG_LEVEL_INFO
                    bool "[Info]  Log important events"
                config RT_LV_LOG_LEVEL_WARN
                    bool "[Warn]  Log if something unwanted happened but didn't cause a problem"
                config RT_LV_LOG_LEVEL_ERROR
                    bool "[Error] Only critical issues, when the system may fail"
                config RT_LV_LOG_LEVEL_USER
                    bool "[User]  Only logs added by the user"
                config RT_LV_LOG_LEVEL_NONE
                    bool "[None]  Do not log anything"
            endchoice

            config LV_LOG_LEVEL
                int
                default 0 if RT_LV_LOG_LEVEL_TRACE
                default 1 if RT_LV_LOG_LEVEL_INFO
                default 2 if RT_LV_LOG_LEVEL_WARN
                default 3 if RT_LV_LOG_LEVEL_ERROR
                default 4 if RT_LV_LOG_LEVEL_USER
                default 5 if RT_LV_LOG_LEVEL_NONE

            config RT_LV_LOG_PRINTF
                bool "Print the log with 'printf'" if RT_LV_USE_LOG
                help
                    Use printf for log output.
                    If not set the user needs to register a callback with `lv_log_register_print_cb`.

            config RT_LV_LOG_TRACE_MEM
                bool "Enable/Disable LV_LOG_TRACE in mem module"
                default y
                depends on RT_LV_USE_LOG

            config RT_LV_LOG_TRACE_TIMER
                bool "Enable/Disable LV_LOG_TRACE in timer module"
                default y
                depends on RT_LV_USE_LOG

            config RT_LV_LOG_TRACE_INDEV
                bool "Enable/Disable LV_LOG_TRACE in indev module"
                default y
                depends on RT_LV_USE_LOG

            config RT_LV_LOG_TRACE_DISP_REFR
                bool "Enable/Disable LV_LOG_TRACE in disp refr module"
                default y
                depends on RT_LV_USE_LOG

            config RT_LV_LOG_TRACE_EVENT
                bool "Enable/Disable LV_LOG_TRACE in event module"
                default y
                depends on RT_LV_USE_LOG

            config RT_LV_LOG_TRACE_OBJ_CREATE
                bool "Enable/Disable LV_LOG_TRACE in obj create module"
                default y
                depends on RT_LV_USE_LOG

            config RT_LV_LOG_TRACE_LAYOUT
                bool "Enable/Disable LV_LOG_TRACE in layout module"
                default y
                depends on RT_LV_USE_LOG

            config RT_LV_LOG_TRACE_ANIM
                bool "Enable/Disable LV_LOG_TRACE in anim module"
                default y
                depends on RT_LV_USE_LOG
        endmenu

        menu "Asserts"
            config RT_LV_USE_ASSERT_NULL
                bool "Check if the parameter is NULL. (Very fast, recommended)"
                default y if !RT_LV_CONF_MINIMAL

            config RT_LV_USE_ASSERT_MALLOC
                bool "Checks if the memory is successfully allocated or no. (Very fast, recommended)"
                default y if !RT_LV_CONF_MINIMAL

            config RT_LV_USE_ASSERT_STYLE
                bool "Check if the styles are properly initialized. (Very fast, recommended)"

            config RT_LV_USE_ASSERT_MEM_INTEGRITY
                bool "Check the integrity of `lv_mem` after critical operations. (Slow)"

            config RT_LV_USE_ASSERT_OBJ
                bool "Check NULL, the object's type and existence (e.g. not deleted). (Slow)."
        endmenu

        menu "Others"
            config RT_LV_USE_PERF_MONITOR
                bool "Show CPU usage and FPS count."

            choice
                prompt "Performance monitor position."
                depends on RT_LV_USE_PERF_MONITOR
                default LV_PERF_MONITOR_ALIGN_BOTTOM_RIGHT

                config LV_PERF_MONITOR_ALIGN_TOP_LEFT
                    bool "Top left"
                config LV_PERF_MONITOR_ALIGN_TOP_MID
                    bool "Top middle"
                config LV_PERF_MONITOR_ALIGN_TOP_RIGHT
                    bool "Top right"
                config LV_PERF_MONITOR_ALIGN_BOTTOM_LEFT
                    bool "Bottom left"
                config LV_PERF_MONITOR_ALIGN_BOTTOM_MID
                    bool "Bottom middle"
                config LV_PERF_MONITOR_ALIGN_BOTTOM_RIGHT
                    bool "Bottom right"
                config LV_PERF_MONITOR_ALIGN_LEFT_MID
                    bool "Left middle"
                config LV_PERF_MONITOR_ALIGN_RIGHT_MID
                    bool "Right middle"
                config LV_PERF_MONITOR_ALIGN_CENTER
                    bool "Center"
            endchoice

            config RT_LV_USE_MEM_MONITOR
                bool "Show the used memory and the memory fragmentation."
                depends on !RT_LV_MEM_CUSTOM

            choice
                prompt "Memory monitor position."
                depends on RT_LV_USE_MEM_MONITOR
                default LV_MEM_MONITOR_ALIGN_BOTTOM_LEFT

                config LV_MEM_MONITOR_ALIGN_TOP_LEFT
                    bool "Top left"
                config LV_MEM_MONITOR_ALIGN_TOP_MID
                    bool "Top middle"
                config LV_MEM_MONITOR_ALIGN_TOP_RIGHT
                    bool "Top right"
                config LV_MEM_MONITOR_ALIGN_BOTTOM_LEFT
                    bool "Bottom left"
                config LV_MEM_MONITOR_ALIGN_BOTTOM_MID
                    bool "Bottom middle"
                config LV_MEM_MONITOR_ALIGN_BOTTOM_RIGHT
                    bool "Bottom right"
                config LV_MEM_MONITOR_ALIGN_LEFT_MID
                    bool "Left middle"
                config LV_MEM_MONITOR_ALIGN_RIGHT_MID
                    bool "Right middle"
                config LV_MEM_MONITOR_ALIGN_CENTER
                    bool "Center"
            endchoice

            config RT_LV_USE_REFR_DEBUG
                bool "Draw random colored rectangles over the redrawn areas."

            config RT_LV_USE_USER_DATA
                bool "Add a 'user_data' to drivers and objects."
                default y

            config RT_LV_ENABLE_GC
                bool "Enable garbage collector"

            config LV_GC_INCLUDE
                string "Header to include for the garbage collector related things"
                depends on RT_LV_ENABLE_GC
                default "gc.h"
        endmenu

        menu "Compiler settings"
            config RT_LV_BIG_ENDIAN_SYSTEM
                bool "For big endian systems set to 1"

            config LV_ATTRIBUTE_MEM_ALIGN_SIZE
                int "Required alignment size for buffers"
                default 1

            config RT_LV_USE_LARGE_COORD
                bool "Extend the default -32k..32k coordinate range to -4M..4M by using int32_t for coordinates instead of int16_t"
        endmenu
    endmenu

    menu "Font usage"
        menu "Enable built-in fonts"
            config RT_LV_FONT_MONTSERRAT_8
                bool "Enable Montserrat 8"
            config RT_LV_FONT_MONTSERRAT_10
                bool "Enable Montserrat 10"
            config RT_LV_FONT_MONTSERRAT_12
                bool "Enable Montserrat 12"
            config RT_LV_FONT_MONTSERRAT_14
                bool "Enable Montserrat 14"
                default y if !RT_LV_CONF_MINIMAL
            config RT_LV_FONT_MONTSERRAT_16
                bool "Enable Montserrat 16"
            config RT_LV_FONT_MONTSERRAT_18
                bool "Enable Montserrat 18"
            config RT_LV_FONT_MONTSERRAT_20
                bool "Enable Montserrat 20"
            config RT_LV_FONT_MONTSERRAT_22
                bool "Enable Montserrat 22"
            config RT_LV_FONT_MONTSERRAT_24
                bool "Enable Montserrat 24"
            config RT_LV_FONT_MONTSERRAT_26
                bool "Enable Montserrat 26"
            config RT_LV_FONT_MONTSERRAT_28
                bool "Enable Montserrat 28"
            config RT_LV_FONT_MONTSERRAT_30
                bool "Enable Montserrat 30"
            config RT_LV_FONT_MONTSERRAT_32
                bool "Enable Montserrat 32"
            config RT_LV_FONT_MONTSERRAT_34
                bool "Enable Montserrat 34"
            config RT_LV_FONT_MONTSERRAT_36
                bool "Enable Montserrat 36"
            config RT_LV_FONT_MONTSERRAT_38
                bool "Enable Montserrat 38"
            config RT_LV_FONT_MONTSERRAT_40
                bool "Enable Montserrat 40"
            config RT_LV_FONT_MONTSERRAT_42
                bool "Enable Montserrat 42"
            config RT_LV_FONT_MONTSERRAT_44
                bool "Enable Montserrat 44"
            config RT_LV_FONT_MONTSERRAT_46
                bool "Enable Montserrat 46"
            config RT_LV_FONT_MONTSERRAT_48
                bool "Enable Montserrat 48"

            config RT_LV_FONT_MONTSERRAT_12_SUBPX
                bool "Enable Montserrat 12 sub-pixel"
            config RT_LV_FONT_MONTSERRAT_28_COMPRESSED
                bool "Enable Montserrat 28 compressed"
            config RT_LV_FONT_DEJAVU_16_PERSIAN_HEBREW
                bool "Enable Dejavu 16 Persian, Hebrew, Arabic letters"
            config RT_LV_FONT_SIMSUN_16_CJK
                bool "Enable Simsun 16 CJK"

            config RT_LV_FONT_UNSCII_8
                bool "Enable UNSCII 8 (Perfect monospace font)"
                default y if RT_LV_CONF_MINIMAL
            config RT_LV_FONT_UNSCII_16
                bool "Enable UNSCII 16 (Perfect monospace font)"
        endmenu

        choice LV_FONT_DEFAULT
            prompt "Select theme default title font"
            default RT_LV_FONT_DEFAULT_MONTSERRAT_14 if !RT_LV_CONF_MINIMAL
            default RT_LV_FONT_DEFAULT_UNSCII_8 if RT_LV_CONF_MINIMAL
            help
                Select theme default title font

            config RT_LV_FONT_DEFAULT_MONTSERRAT_8
                bool "Montserrat 8"
                select RT_LV_FONT_MONTSERRAT_8
            config RT_LV_FONT_DEFAULT_MONTSERRAT_12
                bool "Montserrat 12"
                select RT_LV_FONT_MONTSERRAT_12
            config RT_LV_FONT_DEFAULT_MONTSERRAT_14
                bool "Montserrat 14"
                select RT_LV_FONT_MONTSERRAT_14
            config RT_LV_FONT_DEFAULT_MONTSERRAT_16
                bool "Montserrat 16"
                select RT_LV_FONT_MONTSERRAT_16
            config RT_LV_FONT_DEFAULT_MONTSERRAT_18
                bool "Montserrat 18"
                select RT_LV_FONT_MONTSERRAT_18
            config RT_LV_FONT_DEFAULT_MONTSERRAT_20
                bool "Montserrat 20"
                select RT_LV_FONT_MONTSERRAT_20
            config RT_LV_FONT_DEFAULT_MONTSERRAT_22
                bool "Montserrat 22"
                select RT_LV_FONT_MONTSERRAT_22
            config RT_LV_FONT_DEFAULT_MONTSERRAT_24
                bool "Montserrat 24"
                select RT_LV_FONT_MONTSERRAT_24
            config RT_LV_FONT_DEFAULT_MONTSERRAT_26
                bool "Montserrat 26"
                select RT_LV_FONT_MONTSERRAT_26
            config RT_LV_FONT_DEFAULT_MONTSERRAT_28
                bool "Montserrat 28"
                select RT_LV_FONT_MONTSERRAT_28
            config RT_LV_FONT_DEFAULT_MONTSERRAT_30
                bool "Montserrat 30"
                select RT_LV_FONT_MONTSERRAT_30
            config RT_LV_FONT_DEFAULT_MONTSERRAT_32
                bool "Montserrat 32"
                select RT_LV_FONT_MONTSERRAT_32
            config RT_LV_FONT_DEFAULT_MONTSERRAT_34
                bool "Montserrat 34"
                select RT_LV_FONT_MONTSERRAT_34
            config RT_LV_FONT_DEFAULT_MONTSERRAT_36
                bool "Montserrat 36"
                select RT_LV_FONT_MONTSERRAT_36
            config RT_LV_FONT_DEFAULT_MONTSERRAT_38
                bool "Montserrat 38"
                select RT_LV_FONT_MONTSERRAT_38
            config RT_LV_FONT_DEFAULT_MONTSERRAT_40
                bool "Montserrat 40"
                select RT_LV_FONT_MONTSERRAT_40
            config RT_LV_FONT_DEFAULT_MONTSERRAT_42
                bool "Montserrat 42"
                select RT_LV_FONT_MONTSERRAT_42
            config RT_LV_FONT_DEFAULT_MONTSERRAT_44
                bool "Montserrat 44"
                select RT_LV_FONT_MONTSERRAT_44
            config RT_LV_FONT_DEFAULT_MONTSERRAT_46
                bool "Montserrat 46"
                select RT_LV_FONT_MONTSERRAT_46
            config RT_LV_FONT_DEFAULT_MONTSERRAT_48
                bool "Montserrat 48"
                select RT_LV_FONT_MONTSERRAT_48
            config RT_LV_FONT_DEFAULT_MONTSERRAT_12_SUBPX
                bool "Montserrat 12 sub-pixel"
                select RT_LV_FONT_MONTSERRAT_12_SUBPX
            config RT_LV_FONT_DEFAULT_MONTSERRAT_28_COMPRESSED
                bool "Montserrat 28 compressed"
                select RT_LV_FONT_MONTSERRAT_28_COMPRESSED
            config RT_LV_FONT_DEFAULT_DEJAVU_16_PERSIAN_HEBREW
                bool "Dejavu 16 Persian, Hebrew, Arabic letters"
                select RT_LV_FONT_DEJAVU_16_PERSIAN_HEBREW
            config RT_LV_FONT_DEFAULT_SIMSUN_16_CJK
                bool "Simsun 16 CJK"
                select RT_LV_FONT_SIMSUN_16_CJK
            config RT_LV_FONT_DEFAULT_UNSCII_8
                bool "UNSCII 8 (Perfect monospace font)"
                select RT_LV_FONT_UNSCII_8
            config RT_LV_FONT_DEFAULT_UNSCII_16
                bool "UNSCII 16 (Perfect monospace font)"
                select RT_LV_FONT_UNSCII_16
        endchoice

        config RT_LV_FONT_FMT_TXT_LARGE
            bool "Enable it if you have fonts with a lot of characters."
            help
                The limit depends on the font size, font face and bpp
                but with > 10,000 characters if you see issues probably you
                need to enable it.

        config RT_LV_USE_FONT_COMPRESSED
            bool "Sets support for compressed fonts."

        config RT_LV_USE_FONT_SUBPX
            bool "Enable subpixel rendering."

        config RT_LV_FONT_SUBPX_BGR
            bool "Use BGR instead RGB for sub-pixel rendering."
            depends on RT_LV_USE_FONT_SUBPX
            help
                Set the pixel order of the display.
                Important only if "subpx fonts" are used.
                With "normal" font it doesn't matter.

        config RT_LV_USE_FONT_PLACEHOLDER
            bool "Enable drawing placeholders when glyph dsc is not found."
            default y
    endmenu

    menu "Text Settings"
        choice LV_TXT_ENC
            prompt "Select a character encoding for strings"
            help
                Select a character encoding for strings. Your IDE or editor should have the same character encoding.
            default RT_LV_TXT_ENC_UTF8 if !RT_LV_CONF_MINIMAL
            default RT_LV_TXT_ENC_ASCII if RT_LV_CONF_MINIMAL

            config RT_LV_TXT_ENC_UTF8
                bool "UTF8"
            config RT_LV_TXT_ENC_ASCII
                bool "ASCII"
        endchoice

        config LV_TXT_BREAK_CHARS
            string "Can break (wrap) texts on these chars"
            default " ,.;:-_"

        config LV_TXT_LINE_BREAK_LONG_LEN
            int "Line break long length"
            default 0
            help
                If a word is at least this long, will break wherever 'prettiest'.
                To disable, set to a value <= 0.

        config LV_TXT_LINE_BREAK_LONG_PRE_MIN_LEN
            int "Min num chars before break"
            default 3
            depends on LV_TXT_LINE_BREAK_LONG_LEN > 0
            help
                Minimum number of characters in a long word to put on a line before a break.

        config LV_TXT_LINE_BREAK_LONG_POST_MIN_LEN
            int "Min num chars after break"
            default 3
            depends on LV_TXT_LINE_BREAK_LONG_LEN > 0
            help
                Minimum number of characters in a long word to put on a line after a break.

        config LV_TXT_COLOR_CMD
            string "The control character to use for signalling text recoloring"
            default "#"

        config RT_LV_USE_ARABIC_PERSIAN_CHARS
            bool "Enable Arabic/Persian processing"
            help
                In these languages characters should be replaced with
                an other form based on their position in the text.
    endmenu

    menu "Widget usage"
        config RT_LV_USE_ARC
            bool "Arc."
            default y if !RT_LV_CONF_MINIMAL
        config RT_LV_USE_BAR
            bool "Bar."
            default y if !RT_LV_CONF_MINIMAL
        config RT_LV_USE_BTN
            bool "Button."
            default y if !RT_LV_CONF_MINIMAL
        config RT_LV_USE_BTNMATRIX
            bool "Button matrix."
            default y if !RT_LV_CONF_MINIMAL
        config RT_LV_USE_CANVAS
            bool "Canvas. Dependencies: lv_img."
            select RT_LV_USE_IMG
            default y if !RT_LV_CONF_MINIMAL
        config RT_LV_USE_CHECKBOX
            bool "Check Box"
            default y if !RT_LV_CONF_MINIMAL
        config RT_LV_USE_DROPDOWN
            bool "Drop down list. Requires: lv_label."
            select RT_LV_USE_LABEL
            default y if !RT_LV_CONF_MINIMAL
        config RT_LV_USE_IMG
            bool "Image. Requires: lv_label."
            select RT_LV_USE_LABEL
            default y if !RT_LV_CONF_MINIMAL
        config RT_LV_USE_LABEL
            bool "Label."
            default y if !RT_LV_CONF_MINIMAL
        config RT_LV_LABEL_TEXT_SELECTION
            bool "Enable selecting text of the label."
            depends on RT_LV_USE_LABEL
            default y
        config RT_LV_LABEL_LONG_TXT_HINT
            bool "Store extra some info in labels (12 bytes) to speed up drawing of very long texts."
            depends on RT_LV_USE_LABEL
            default y
        config RT_LV_USE_LINE
            bool "Line."
            default y if !RT_LV_CONF_MINIMAL
        config RT_LV_USE_ROLLER
            bool "Roller. Requires: lv_label."
            select RT_LV_USE_LABEL
            default y if !RT_LV_CONF_MINIMAL
        config LV_ROLLER_INF_PAGES
            int "Number of extra 'pages' when the controller is infinite."
            default 7
            depends on RT_LV_USE_ROLLER
        config RT_LV_USE_SLIDER
            bool "Slider. Requires: lv_bar."
            select RT_LV_USE_BAR
            default y if !RT_LV_CONF_MINIMAL
        config RT_LV_USE_SWITCH
            bool "Switch."
            default y if !RT_LV_CONF_MINIMAL
        config RT_LV_USE_TEXTAREA
            bool "Text area. Requires: lv_label."
            select RT_LV_USE_LABEL
            default y if !RT_LV_CONF_MINIMAL
        config LV_TEXTAREA_DEF_PWD_SHOW_TIME
            int "Text area def. pwd show time [ms]."
            default 1500
            depends on RT_LV_USE_TEXTAREA
        config RT_LV_USE_TABLE
            bool "Table."
            default y if !RT_LV_CONF_MINIMAL
    endmenu

    menu "Extra Widgets"
        config RT_LV_USE_ANIMIMG
            bool "Anim image."
            default y if !RT_LV_CONF_MINIMAL
        config RT_LV_USE_CALENDAR
            bool "Calendar."
            default y if !RT_LV_CONF_MINIMAL
        config RT_LV_CALENDAR_WEEK_STARTS_MONDAY
            bool "Calendar week starts monday."
            depends on RT_LV_USE_CALENDAR
        config RT_LV_USE_CALENDAR_HEADER_ARROW
            bool "Use calendar header arrow"
            depends on RT_LV_USE_CALENDAR
            default y
        config RT_LV_USE_CALENDAR_HEADER_DROPDOWN
            bool "Use calendar header dropdown"
            depends on RT_LV_USE_CALENDAR
            default y
        config RT_LV_USE_CHART
            bool "Chart."
            default y if !RT_LV_CONF_MINIMAL
        config RT_LV_USE_COLORWHEEL
            bool "Colorwheel."
            default y if !RT_LV_CONF_MINIMAL
        config RT_LV_USE_IMGBTN
            bool "Imgbtn."
            default y if !RT_LV_CONF_MINIMAL
        config RT_LV_USE_KEYBOARD
            bool "Keyboard."
            default y if !RT_LV_CONF_MINIMAL
        config RT_LV_USE_LED
            bool "LED."
            default y if !RT_LV_CONF_MINIMAL
        config RT_LV_USE_LIST
            bool "List."
            default y if !RT_LV_CONF_MINIMAL
        config RT_LV_USE_MENU
            bool "Menu."
            default y if !RT_LV_CONF_MINIMAL
        config RT_LV_USE_METER
            bool "Meter."
            default y if !RT_LV_CONF_MINIMAL
        config RT_LV_USE_MSGBOX
            bool "Msgbox."
            default y if !RT_LV_CONF_MINIMAL
        config RT_LV_USE_SPAN
            bool "span"
            default y if !RT_LV_CONF_MINIMAL
        config LV_SPAN_SNIPPET_STACK_SIZE
            int "Maximum number of span descriptor"
            default 64
            depends on RT_LV_USE_SPAN
        config RT_LV_USE_SPINBOX
            bool "Spinbox."
            default y if !RT_LV_CONF_MINIMAL
        config RT_LV_USE_SPINNER
            bool "Spinner."
            default y if !RT_LV_CONF_MINIMAL
        config RT_LV_USE_TABVIEW
            bool "Tabview."
            default y if !RT_LV_CONF_MINIMAL
        config RT_LV_USE_TILEVIEW
            bool "Tileview"
            default y if !RT_LV_CONF_MINIMAL
        config RT_LV_USE_WIN
            bool "Win"
            default y if !RT_LV_CONF_MINIMAL
    endmenu

    menu "Themes"
        config RT_LV_USE_THEME_DEFAULT
            bool "A simple, impressive and very complete theme"
            default y if !RT_LV_COLOR_DEPTH_1 && !RT_LV_CONF_MINIMAL
        config RT_LV_THEME_DEFAULT_DARK
            bool "Yes to set dark mode, No to set light mode"
            depends on RT_LV_USE_THEME_DEFAULT
        config RT_LV_THEME_DEFAULT_GROW
            bool "Enable grow on press"
            default y
            depends on RT_LV_USE_THEME_DEFAULT
        config LV_THEME_DEFAULT_TRANSITION_TIME
            int "Default transition time in [ms]"
            default 80
            depends on RT_LV_USE_THEME_DEFAULT
        config RT_LV_USE_THEME_BASIC
            bool "A very simple theme that is a good starting point for a custom theme"
            default y if !RT_LV_COLOR_DEPTH_1 && !RT_LV_CONF_MINIMAL
        config RT_LV_USE_THEME_MONO
            bool "Monochrome theme, suitable for some E-paper & dot matrix displays"
            default y if RT_LV_COLOR_DEPTH_1 && !RT_LV_CONF_MINIMAL
    endmenu

    menu "Layouts"
        config RT_LV_USE_FLEX
            bool "A layout similar to Flexbox in CSS."
            default y if !RT_LV_CONF_MINIMAL
        config RT_LV_USE_GRID
            bool "A layout similar to Grid in CSS."
            default y if !RT_LV_CONF_MINIMAL
    endmenu

    menu "3rd Party Libraries"
        config RT_LV_USE_FS_STDIO
            bool "File system on top of stdio API"
        config LV_FS_STDIO_LETTER
            int "Set an upper cased letter on which the drive will accessible (e.g. 'A' i.e. 65 )"
            default 0
            depends on RT_LV_USE_FS_STDIO
        config LV_FS_STDIO_PATH
            string "Set the working directory"
            depends on RT_LV_USE_FS_STDIO
        config LV_FS_STDIO_CACHE_SIZE
            string ">0 to cache this number of bytes in lv_fs_read()"
            depends on RT_LV_USE_FS_STDIO

        config RT_LV_USE_FS_POSIX
            bool "File system on top of posix API"
        config LV_FS_POSIX_LETTER
            int "Set an upper cased letter on which the drive will accessible (e.g. 'A' i.e. 65)"
            default 0
            depends on RT_LV_USE_FS_POSIX
        config LV_FS_POSIX_PATH
            string "Set the working directory"
            depends on RT_LV_USE_FS_POSIX
        config LV_FS_POSIX_CACHE_SIZE
            int ">0 to cache this number of bytes in lv_fs_read()"
            default 0
            depends on RT_LV_USE_FS_POSIX

        config RT_LV_USE_FS_WIN32
            bool "File system on top of Win32 API"
        config LV_FS_WIN32_LETTER
            int "Set an upper cased letter on which the drive will accessible (e.g. 'A' i.e. 65)"
            default 0
            depends on RT_LV_USE_FS_WIN32
        config LV_FS_WIN32_PATH
            string "Set the working directory"
            depends on RT_LV_USE_FS_WIN32
        config LV_FS_WIN32_CACHE_SIZE
            int ">0 to cache this number of bytes in lv_fs_read()"
            default 0
            depends on RT_LV_USE_FS_WIN32

        config RT_LV_USE_FS_FATFS
            bool "File system on top of FatFS"
        config LV_FS_FATFS_LETTER
            int "Set an upper cased letter on which the drive will accessible (e.g. 'A' i.e. 65)"
            default 0
            depends on RT_LV_USE_FS_FATFS
        config LV_FS_FATFS_CACHE_SIZE
            int ">0 to cache this number of bytes in lv_fs_read()"
            default 0
            depends on RT_LV_USE_FS_FATFS

        config RT_LV_USE_PNG
            bool "PNG decoder library"

        config RT_LV_USE_BMP
            bool "BMP decoder library"

        config RT_LV_USE_SJPG
            bool "JPG + split JPG decoder library"

        config RT_LV_USE_GIF
            bool "GIF decoder library"

        config RT_LV_USE_QRCODE
            bool "QR code library"

        config RT_LV_USE_FREETYPE
            bool "FreeType library"
        if RT_LV_USE_FREETYPE
            menu "FreeType cache config"
                config LV_FREETYPE_CACHE_SIZE
                int "Memory used by FreeType to cache characters [bytes] (-1: no caching)"
                default 16384
                if LV_FREETYPE_CACHE_SIZE >= 0
                    config RT_LV_FREETYPE_SBIT_CACHE
                        bool "enable sbit cache"
                        default n
                    config LV_FREETYPE_CACHE_FT_FACES
                        int "The maximum number of FT_Face(0: use defaults)"
                        default 0
                    config LV_FREETYPE_CACHE_FT_SIZES
                        int "The maximum number of FT_Size(0: use defaults)"
                        default 0
                endif
            endmenu
        endif

        config RT_LV_USE_RLOTTIE
            bool "Lottie library"
    endmenu

    menu "Others"
        config RT_LV_USE_SNAPSHOT
            bool "Enable API to take snapshot"
            default y if !RT_LV_CONF_MINIMAL

        config RT_LV_USE_MONKEY
            bool "Enable Monkey test"
            default n

        config RT_LV_USE_GRIDNAV
            bool "Enable grid navigation"
            default n

        config RT_LV_USE_FRAGMENT
            bool "Enable lv_obj fragment"
            default n

        config RT_LV_USE_IMGFONT
            bool "draw img in label or span obj"
            default n

        config RT_LV_USE_MSG
            bool "Enable a published subscriber based messaging system"
            default n

        config RT_LV_USE_IME_PINYIN
            bool "Enable Pinyin input method"
            default n
        config RT_LV_IME_PINYIN_USE_K9_MODE
            bool "Enable Pinyin input method 9 key input mode"
            depends on RT_LV_USE_IME_PINYIN
            default n
        config LV_IME_PINYIN_K9_CAND_TEXT_NUM
            int "Maximum number of candidate panels for 9-key input mode"
            depends on RT_LV_IME_PINYIN_USE_K9_MODE
            default 3
        config RT_LV_IME_PINYIN_USE_DEFAULT_DICT
            bool "Use built-in Thesaurus"
            depends on RT_LV_USE_IME_PINYIN
            default y
            help
                If you do not use the default thesaurus, be sure to use lv_ime_pinyin after setting the thesauruss
        config LV_IME_PINYIN_CAND_TEXT_NUM
            int "Maximum number of candidate panels"
            depends on RT_LV_USE_IME_PINYIN
            default 6
            help
                Set the maximum number of candidate panels that can be displayed.
                This needs to be adjusted according to the size of the screen.
    endmenu

    menu "Examples"
        config RT_LV_BUILD_EXAMPLES
            bool "Enable the examples to be built"
            default n
    endmenu

    menuconfig RT_LVGL_USING_DEMOS
        bool "Demos"
        default n

        if RT_LVGL_USING_DEMOS
            config RT_LV_USE_DEMO_WIDGETS
                bool "Show some widget"
                default n
            config RT_LV_DEMO_WIDGETS_SLIDESHOW
                bool "Enable slide show"
                depends on RT_LV_USE_DEMO_WIDGETS
                default n

            config RT_LV_USE_DEMO_KEYPAD_AND_ENCODER
                bool "Demonstrate the usage of encoder and keyboard"
                default n

            config RT_LV_USE_DEMO_BENCHMARK
                bool "Benchmark your system"
                default n
            config RT_LV_DEMO_BENCHMARK_RGB565A8
                bool "Use RGB565A8 images with 16 bit color depth instead of ARGB8565"
                depends on RT_LV_USE_DEMO_BENCHMARK
                default n

            config RT_LV_USE_DEMO_STRESS
                bool "Stress test for LVGL"
                default n

            config RT_LV_USE_DEMO_MUSIC
                bool "Music player demo"
                default n
            config RT_LV_DEMO_MUSIC_SQUARE
                bool "Enable Square"
                depends on RT_LV_USE_DEMO_MUSIC
                default n
            config RT_LV_DEMO_MUSIC_LANDSCAPE
                bool "Enable Landscape"
                depends on RT_LV_USE_DEMO_MUSIC
                default n
            config RT_LV_DEMO_MUSIC_ROUND
                bool "Enable Round"
                depends on RT_LV_USE_DEMO_MUSIC
                default n
            config RT_LV_DEMO_MUSIC_LARGE
                bool "Enable Large"
                depends on RT_LV_USE_DEMO_MUSIC
                select RT_LV_FONT_MONTSERRAT_16
                select RT_LV_FONT_MONTSERRAT_22
                select RT_LV_FONT_MONTSERRAT_32
                default n
            config RT_LV_DEMO_MUSIC_SMALL
                bool
                depends on RT_LV_USE_DEMO_MUSIC
                select RT_LV_FONT_MONTSERRAT_12
                select RT_LV_FONT_MONTSERRAT_16
                default y if !RT_LV_DEMO_MUSIC_LARGE
            config RT_LV_DEMO_MUSIC_AUTO_PLAY
                bool "Enable Auto play"
                depends on RT_LV_USE_DEMO_MUSIC
                default n
        endif
endmenu
```
