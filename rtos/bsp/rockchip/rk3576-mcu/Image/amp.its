## rtos/bsp/rockchip/rk3576-mcu/Image/amp.its
```
/*
 * Copyright (C) 2023 Rockchip Electronics Co., Ltd
 *
 * SPDX-License-Identifier: GPL-2.0
 */

/dts-v1/;
/ {
	description = "Rockchip AMP FIT Image";
	#address-cells = <1>;

	images {
		mcu {
			description  = "bus_mcu";       // bus_mcu or pmu_mcu
			data         = /incbin/("./rtt.bin");
			type         = "standalone";	// must be "standalone"
			compression  = "none";
			arch         = "arm";		// "arm64" or "arm", the same as U-Boot state
			load         = <0x48200000>;
			udelay       = <1000000>;
			hash {
				algo = "sha256";
			};
		};
	};

	configurations {
		default = "conf";
		conf {
			description = "Rockchip AMP images";
			rollback-index = <0x0>;
			loadables = "mcu";

			signature {
				algo = "sha256,rsa2048";
				padding = "pss";
				key-name-hint = "dev";
				sign-images = "loadables";
			};
		};
	};
};
```

## rtos/bsp/rockchip/rk3576-mcu/Kconfig
```kconfig
mainmenu "RT-Thread Configuration"

config BSP_DIR
    string
    option env="BSP_ROOT"
    default "."

config RTT_DIR
    string
    option env="RTT_ROOT"
    default "../../.."

config PKGS_DIR
    string
    option env="PKGS_ROOT"
    default "packages"

config BSP_RK3576
    select ARCH_ARM_CORTEX_M0
    bool
    default y

source "$RTT_DIR/Kconfig"
source "$BSP_DIR/drivers/Kconfig"
source "$BSP_DIR/board/Kconfig"
#source "$PKGS_DIR/Kconfig"
source "$BSP_DIR/../common/tests/Kconfig"
```

## rtos/bsp/rockchip/rk3588-64/Image/smp.its
```
/* SPDX-License-Identifier: BSD-3-Clause */
/*
 * Copyright (c) 2023 Rockchip Electronics Co., Ltd.
 */

/dts-v1/;
/ {
	description = "FIT source file for rockchip AMP";
	#address-cells = <1>;

	images {

		amp0 {
			description  = "bare-mental-core0";
			data         = /incbin/("rtt0.bin");
			type         = "firmware";
			compression  = "none";
			arch         = "arm64";	 // "arm64" or "arm"
			cpu          = <0x000>;  // mpidr
			thumb        = <0>;      // 0: arm or thumb2; 1: thumb
			hyp          = <0>;      // 0: el1/svc; 1: el2/hyp
			load         = <0x04000000>;
			size         = <0x00800000>;
			srambase     = <0xff000000>;
			sramsize     = <0x00100000>;
			udelay       = <10000>;
			hash {
				algo = "sha256";
			};
		};

	};

	share_memory {
		base         = <0x07800000>;
		size         = <0x00400000>;
	};

	configurations {
		default = "conf";
		conf {
			description = "Rockchip AMP images";
			rollback-index = <0x0>;
			loadables = "amp0";

			signature {
				algo = "sha256,rsa2048";
				padding = "pss";
				key-name-hint = "dev";
				sign-images = "loadables";
			};
		};
	};
};
```

## rtos/bsp/rockchip/rk3588-64/board/Kconfig
```kconfig
menu "RT-Thread board config"

config BSP_USING_GIC
    bool
    default y

config BSP_USING_GICV3
    bool
    default y

config RT_BOARD_NAME
    string "the board name that you use"
    default "rk3588_evb1"

source "$BSP_DIR/board/$RT_BOARD_NAME/Kconfig"

endmenu
```

## rtos/bsp/rockchip/rk3588-mcu/Kconfig
```kconfig
mainmenu "RT-Thread Configuration"

config BSP_DIR
    string
    option env="BSP_ROOT"
    default "."

config RTT_DIR
    string
    option env="RTT_ROOT"
    default "../../.."

config PKGS_DIR
    string
    option env="PKGS_ROOT"
    default "packages"

config BSP_RK3588
    bool
    default y

choice
    prompt "RK3588 MCU"
    default HAL_PMU_MCU_CORE

    config HAL_PMU_MCU_CORE
        select ARCH_ARM_CORTEX_M0
        bool "RK3588 MCU of PMU"

    config HAL_NPU_MCU_CORE
        select ARCH_ARM_CORTEX_M0
        bool "RK3588 MCU of NPU"

    config HAL_DDR_MCU_CORE
        select ARCH_ARM_CORTEX_M0
        bool "RK3588 MCU of DDR(no cache)"
endchoice

source "$RTT_DIR/Kconfig"
source "$BSP_DIR/drivers/Kconfig"
source "$BSP_DIR/board/Kconfig"
#source "$PKGS_DIR/Kconfig"
source "$BSP_DIR/../common/tests/Kconfig"
```

## rtos/bsp/rockchip/rk3588-mcu/board/Kconfig
```kconfig
menu "RT-Thread board config"

config RT_BOARD_NAME
    string "the board name of you use"
    default "evb"

config RT_USING_JTAG
    bool "Enable JTAG for debug"
    default n

config RT_USING_32K_TICK_SRC
    bool "Enable 32K SYSTICK source"
    default y

endmenu
```

## rtos/bsp/rockchip/rk3588-mcu/drivers/Kconfig
```kconfig
source "$BSP_DIR/../common/drivers/Kconfig"

menu "RT-Thread rockchip rk3588_mcu drivers"

config RT_USING_CRU
    bool "Enable CRU"
    default n

menu "Enable UART"
    config RT_USING_UART
        bool "Enable UART"
        default n

    if RT_USING_UART
    config RT_USING_UART0
        bool "Enable UART0"
        default n
    config RT_USING_UART2
        bool "Enable UART2"
        default n
    config RT_USING_UART5
        bool "Enable UART5"
        default n
    endif
endmenu

if RT_USING_SPI
menu "Enable SPI"
    config RT_USING_SPI0
        bool "Enable SPI0"
        default n

    config RT_USING_SPI1
        bool "Enable SPI1"
        default n

    config RT_USING_SPI2
        bool "Enable SPI2"
        default n

    config RT_USING_SPI3
        bool "Enable SPI3"
        default n

    config RT_USING_SPI4
        bool "Enable SPI4"
        default n
endmenu
endif

if RT_USING_PWM
menu "Enable PWM"
    config RT_USING_PWM0
        bool "Enable PWM0"
        default n

    config RT_USING_PWM1
        bool "Enable PWM1"
        default n

    config RT_USING_PWM2
        bool "Enable PWM2"
        default n

    config RT_USING_PWM3
        bool "Enable PWM3"
        default n
endmenu
endif

config RT_USING_SARADC
    bool "Enable Saradc"
    depends on RT_USING_ADC
    default n

config RT_USING_I2C6
    bool "Enable I2C6"
    depends on RT_USING_I2C
    default n

endmenu
```

## rtos/bsp/rockchip/rv1103/board/Kconfig
```kconfig
menu "RT-Thread board config"

config RT_BOARD_NAME
    string "the board name that you use"
    default "rv1103_evb1"

source "$BSP_DIR/board/$RT_BOARD_NAME/Kconfig"

endmenu
```

## rtos/bsp/rockchip/rv1103/driver/Kconfig
```kconfig
source "$BSP_DIR/../common/drivers/Kconfig"

menu "RT-Thread rockchip RV1103 drivers"

source "$BSP_DIR/driver/Kconfig.audio"

config RT_USING_CRU
    bool "Enable CRU"
    default n

config RT_USING_DMA
    bool "Enable General DMA Framework"
    default n

if RT_USING_DMA
config RT_USING_DMA_PL330
    bool "Enable PL330 DMA Controller"
    default n

config RT_USING_DMA0
    bool "Enable PL330 DMA0 Controller"
    default n

config RT_USING_DMA1
    bool "Enable PL330 DMA1 Controller"
    default n
endif

if RT_USING_I2C
menu "Enable I2C"
    config RT_USING_I2C0
        bool "Enable I2C0"
        default n

    config RT_USING_I2C1
        bool "Enable I2C1"
        default n

    config RT_USING_I2C2
        bool "Enable I2C2"
        default n
endmenu
endif

if RT_USING_PWM
config RT_USING_PWM0
    bool "Enable PWM0"
    default n
endif

config RT_USING_SARADC
    select RT_USING_ADC
    bool "Enable SARADC"
    default n

if RT_USING_SPI
menu "Enable SPI"
    config RT_USING_SPI0
        bool "Enable SPI0"
        default n

    config RT_USING_SPI1
        bool "Enable SPI1"
        default n

    config RT_USING_SPI2
        bool "Enable SPI2"
        default n
endmenu
endif

config RT_USING_SYSTICK
    bool "Enable SYSTICK"
    default y

config RT_USING_TSADC
    bool "Enable TSADC"
    default n

menu "Enable UART"
    config RT_USING_UART
        bool "Enable UART"
        default y

    if RT_USING_UART
    config RT_USING_UART0
        bool "Enable UART0"
        default n

    config RT_USING_UART2
        bool "Enable UART2"
        default n

    endif
endmenu

config RT_USING_DISPLAY
    bool "Enable Display"
    default n

choice
    prompt "Display Controller"
    depends on RT_USING_DISPLAY

    config RT_USING_VOP
        bool "Enable VOP Composite"
        depends on RT_USING_DISPLAY
        default n
endchoice

choice
    prompt "Display Interface"
    depends on RT_USING_VOP

    config RT_USING_VOP_RGB
        bool "Enable RGB Display Interface"
        default n

    config RT_USING_VOP_MCU
        bool "Enable MCU Display Interface"
        default n
endchoice

endmenu
```

## rtos/bsp/rockchip/rv1106-mcu/board/Kconfig
```kconfig
menu "RT-Thread board config"

config RT_BOARD_NAME
    string "the board name of you use"
    default "rv1106_evb"

source "$BSP_DIR/board/$RT_BOARD_NAME/Kconfig"

endmenu
```

## rtos/bsp/rockchip/rv1106-mcu/board/rv1106_evb/Kconfig
```kconfig
menu "RT-Thread rv1106_evb board config"

config RT_USING_SPL_RTT_SHARE_DDR_ADRESS
    hex "SPL and RTThread share ddr address"
    default 0x1e00000

endmenu
```

## rtos/bsp/rockchip/rv1108/Kconfig
```kconfig
mainmenu "RT-Thread Configuration"

config $BSP_DIR
    string
    option env="BSP_ROOT"
    default "."

config $RTT_DIR
    string
    option env="RTT_ROOT"
    default "../../.."

config $PKGS_DIR
    string
    option env="PKGS_ROOT"
    default "packages"

config SOC_RV1108
    bool
    select ARCH_ARM_CORTEX_A7
    default y

config PM_HAS_CUSTOM_CONFIG
    bool
    depends on RT_USING_PM
    default y

source "$RTT_DIR/Kconfig"
source "$RTT_DIR/applications/Kconfig"
source "$PKGS_DIR/Kconfig"

source "$BSP_DIR/board/Kconfig"
source "$BSP_DIR/drivers/Kconfig"
source "$BSP_DIR/tests/Kconfig"
```

## rtos/bsp/rockchip/rv1108/board/Kconfig
```kconfig
menu "RT-Thread board config"

choice
    prompt "Board Type"
    default RT_USING_BOARD_RV1108_EVB

    config RT_USING_BOARD_RV1108_EVB
        bool "Enable RV1108_EVB board"

endchoice

endmenu
```

## rtos/bsp/rockchip/rv1108/drivers/Kconfig
```kconfig
source "$BSP_DIR/../common/drivers/Kconfig"

menu "RT-Thread rockchip rv1108 drivers"

config RT_USING_CRU
    bool "Enable CRU"
    default n

config RT_USING_DMA
    bool "Enable General DMA Framework"
    default n

choice
    prompt "DMA Type"
    depends on RT_USING_DMA

    config RT_USING_DMA_PL330
        bool "Enable PL330 DMA Controller"
        default n
endchoice

config RT_USING_VOP
    bool "Enable VOP"
    default n

config RT_USING_DSI
     bool "Enable MIPI DSI"
     default n

config RT_USING_DSP
    bool "Enable DSP"
    default n

    if RT_USING_DSP
    config RT_USING_DSPFW_LOADER
        bool "Enable firmware loader to dsp"
        default n

        if RT_USING_DSPFW_LOADER
        config RT_USING_DSPFW_BUILTIN
            bool "Store firmware data in builtin"
            default y
        endif

    config RT_USING_DSP_TRACE
        bool "Enable dsp send trace to cm4"
        default n
    endif

menu "Enable UART"
    config RT_USING_UART
        bool "Enable UART"
        default n

    if RT_USING_UART
    config RT_USING_UART0
        bool "Enable UART0"
        default n

    config RT_USING_UART1
        bool "Enable UART1"
        default n

    config RT_USING_UART2
        bool "Enable UART2"
        default n
    endif
endmenu

if RT_USING_I2C
menu "Enable I2C"
    config RT_USING_I2C0
        bool "Enable I2C0"
        default n

    config RT_USING_I2C1
        bool "Enable I2C1"
        default n

    config RT_USING_I2C2
        bool "Enable I2C2"
        default n
endmenu
endif

if RT_USING_SPI
menu "Enable SPI"
    config RT_USING_SPI0
        bool "Enable SPI0"
        default n

    config RT_USING_SPI1
        bool "Enable SPI1"
        default n

    config RT_USING_SPI2
        bool "Enable SPI2"
        default n
endmenu
endif

if RT_USING_AUDIO
menu "Enable Audio"
    config RT_USING_PCM
        bool "Enable PCM"
        select RT_USING_DMA
        default y

    config RT_USING_I2S
        bool "Enable I2S"
        default n

    config RT_USING_I2S0
        bool "Enable I2S0"
        depends on RT_USING_I2S
        default n

    config RT_USING_I2S1
        bool "Enable I2S1"
        depends on RT_USING_I2S
        default n

    config RT_USING_I2S2
        bool "Enable I2S2"
        depends on RT_USING_I2S
        default n

    config RT_USING_PDM
        bool "Enable PDM"
        default n

    config RT_USING_PDM0
        bool "Enable PDM0"
        depends on RT_USING_PDM
        default n

    config RT_USING_VAD
        bool "Enable VAD"
        default n
endmenu
endif

endmenu
```

## rtos/bsp/rockchip/rv1108/tests/Kconfig
```kconfig
menu "RT-Thread bsp test case"

config RT_USING_TC
    bool "Enable Kernel TEST"
    default n

config RT_USING_FILE_TEST
    bool "Enable File TEST"
    depends on RT_USING_DFS
    default n

config RT_USING_PRIVATE_TEST
    bool "Enable BSP Private TEST"
    default n

source "$BSP_DIR/../common/tests/Kconfig"

endmenu
```

## rtos/bsp/rockchip/rv1126-mcu/Kconfig
```kconfig
mainmenu "RT-Thread Configuration"

config BSP_DIR
    string
    option env="BSP_ROOT"
    default "."

config RTT_DIR
    string
    option env="RTT_ROOT"
    default "../../.."

config PKGS_DIR
    string
    option env="PKGS_ROOT"
    default "packages"

config SOC_RV1126
    bool

config BOARD_RV1126_RISCV_EVB
    bool
    select ARCH_RISCV
    select SOC_RV1126
    default y

source "$RTT_DIR/Kconfig"
source "$BSP_DIR/board/Kconfig"
source "$BSP_DIR/drivers/Kconfig"
source "$BSP_DIR/../common/tests/Kconfig"
```

## rtos/bsp/rockchip/rv1126-mcu/board/Kconfig
```kconfig
menu "RT-Thread board config"

config RT_BOARD_NAME
    string "the board name of you use"
    default "rv1126_evb"

source "$BSP_DIR/board/$RT_BOARD_NAME/Kconfig"

endmenu
```

## rtos/bsp/rockchip/rv1126-mcu/drivers/Kconfig
```kconfig
menu "RT-Thread rockchip rv1126 drivers"

menu "Enable UART"
    config RT_USING_UART
        bool "Enable UART"
        default y

    if RT_USING_UART
    config RT_USING_UART2
        bool "Enable UART2"
        default y
    endif
endmenu

endmenu
```

## rtos/components/aupipe/Kconfig
```kconfig
menuconfig RT_USING_AUPIPE
    bool "Enable Audio Pipeline for rt-thread"
    default n

if RT_USING_AUPIPE

    config RT_USING_AUPIPE_AUDIOSRC
        bool "Enable audiosrc"
        depends on RT_USING_AUPIPE
        default n

    config RT_USING_AUPIPE_AUDIOSINK
        bool "Enable audiosink"
        depends on RT_USING_AUPIPE
        default n

    config RT_USING_AUPIPE_QUEUE
        bool "Enable queue"
        depends on RT_USING_AUPIPE
        default n

endif
```

## rtos/components/fsck_fat/Kconfig
```kconfig
config RT_USING_FSCK_FAT
    bool "Enable fsck for fat"
    default n
    depends on RT_USING_DFS_ELMFAT
```
