## rtos/components/system/lvgl/Kconfig.rtt
```kconfig
# Kconfig.rtt, convert bool to int

config LV_CONF_SKIP
	int
	default 0 if !RT_LV_CONF_SKIP
	default 1 if RT_LV_CONF_SKIP

config LV_CONF_MINIMAL
	int
	default 0 if !RT_LV_CONF_MINIMAL
	default 1 if RT_LV_CONF_MINIMAL

config LV_COLOR_16_SWAP
	int
	default 0 if !RT_LV_COLOR_16_SWAP
	default 1 if RT_LV_COLOR_16_SWAP

config LV_COLOR_SCREEN_TRANSP
	int
	default 0 if !RT_LV_COLOR_SCREEN_TRANSP
	default 1 if RT_LV_COLOR_SCREEN_TRANSP

config LV_DRAW_COMPLEX
	int
	default 0 if !RT_LV_DRAW_COMPLEX
	default 1 if RT_LV_DRAW_COMPLEX

config LV_DITHER_GRADIENT
	int
	default 0 if !RT_LV_DITHER_GRADIENT
	default 1 if RT_LV_DITHER_GRADIENT

config LV_DITHER_ERROR_DIFFUSION
	int
	default 0 if !RT_LV_DITHER_ERROR_DIFFUSION
	default 1 if RT_LV_DITHER_ERROR_DIFFUSION

config LV_USE_LOG
	int
	default 0 if !RT_LV_USE_LOG
	default 1 if RT_LV_USE_LOG

config LV_LOG_PRINTF
	int
	default 0 if !RT_LV_LOG_PRINTF
	default 1 if RT_LV_LOG_PRINTF

config LV_LOG_TRACE_MEM
	int
	default 0 if !RT_LV_LOG_TRACE_MEM
	default 1 if RT_LV_LOG_TRACE_MEM

config LV_LOG_TRACE_TIMER
	int
	default 0 if !RT_LV_LOG_TRACE_TIMER
	default 1 if RT_LV_LOG_TRACE_TIMER

config LV_LOG_TRACE_INDEV
	int
	default 0 if !RT_LV_LOG_TRACE_INDEV
	default 1 if RT_LV_LOG_TRACE_INDEV

config LV_LOG_TRACE_DISP_REFR
	int
	default 0 if !RT_LV_LOG_TRACE_DISP_REFR
	default 1 if RT_LV_LOG_TRACE_DISP_REFR

config LV_LOG_TRACE_EVENT
	int
	default 0 if !RT_LV_LOG_TRACE_EVENT
	default 1 if RT_LV_LOG_TRACE_EVENT

config LV_LOG_TRACE_OBJ_CREATE
	int
	default 0 if !RT_LV_LOG_TRACE_OBJ_CREATE
	default 1 if RT_LV_LOG_TRACE_OBJ_CREATE

config LV_LOG_TRACE_LAYOUT
	int
	default 0 if !RT_LV_LOG_TRACE_LAYOUT
	default 1 if RT_LV_LOG_TRACE_LAYOUT

config LV_LOG_TRACE_ANIM
	int
	default 0 if !RT_LV_LOG_TRACE_ANIM
	default 1 if RT_LV_LOG_TRACE_ANIM

config LV_USE_ASSERT_NULL
	int
	default 0 if !RT_LV_USE_ASSERT_NULL
	default 1 if RT_LV_USE_ASSERT_NULL

config LV_USE_ASSERT_MALLOC
	int
	default 0 if !RT_LV_USE_ASSERT_MALLOC
	default 1 if RT_LV_USE_ASSERT_MALLOC

config LV_USE_ASSERT_STYLE
	int
	default 0 if !RT_LV_USE_ASSERT_STYLE
	default 1 if RT_LV_USE_ASSERT_STYLE

config LV_USE_ASSERT_MEM_INTEGRITY
	int
	default 0 if !RT_LV_USE_ASSERT_MEM_INTEGRITY
	default 1 if RT_LV_USE_ASSERT_MEM_INTEGRITY

config LV_USE_ASSERT_OBJ
	int
	default 0 if !RT_LV_USE_ASSERT_OBJ
	default 1 if RT_LV_USE_ASSERT_OBJ

config LV_USE_PERF_MONITOR
	int
	default 0 if !RT_LV_USE_PERF_MONITOR
	default 1 if RT_LV_USE_PERF_MONITOR

config LV_USE_PERF_MONITOR_POS
	int
	default 1 if LV_PERF_MONITOR_ALIGN_TOP_LEFT
	default 2 if LV_PERF_MONITOR_ALIGN_TOP_MID
	default 3 if LV_PERF_MONITOR_ALIGN_TOP_RIGHT
	default 4 if LV_PERF_MONITOR_ALIGN_BOTTOM_LEFT
	default 5 if LV_PERF_MONITOR_ALIGN_BOTTOM_MID
	default 6 if LV_PERF_MONITOR_ALIGN_BOTTOM_RIGHT
	default 7 if LV_PERF_MONITOR_ALIGN_LEFT_MID
	default 8 if LV_PERF_MONITOR_ALIGN_RIGHT_MID
	default 9 if LV_PERF_MONITOR_ALIGN_CENTER

config LV_USE_MEM_MONITOR
	int
	default 0 if !RT_LV_USE_MEM_MONITOR
	default 1 if RT_LV_USE_MEM_MONITOR

config LV_USE_MEM_MONITOR_POS
	int
	default 1 if LV_MEM_MONITOR_ALIGN_TOP_LEFT
	default 2 if LV_MEM_MONITOR_ALIGN_TOP_MID
	default 3 if LV_MEM_MONITOR_ALIGN_TOP_RIGHT
	default 4 if LV_MEM_MONITOR_ALIGN_BOTTOM_LEFT
	default 5 if LV_MEM_MONITOR_ALIGN_BOTTOM_MID
	default 6 if LV_MEM_MONITOR_ALIGN_BOTTOM_RIGHT
	default 7 if LV_MEM_MONITOR_ALIGN_LEFT_MID
	default 8 if LV_MEM_MONITOR_ALIGN_RIGHT_MID
	default 9 if LV_MEM_MONITOR_ALIGN_CENTER

config LV_USE_REFR_DEBUG
	int
	default 0 if !RT_LV_USE_REFR_DEBUG
	default 1 if RT_LV_USE_REFR_DEBUG

config LV_USE_USER_DATA
	int
	default 0 if !RT_LV_USE_USER_DATA
	default 1 if RT_LV_USE_USER_DATA

config LV_ENABLE_GC
	int
	default 0 if !RT_LV_ENABLE_GC
	default 1 if RT_LV_ENABLE_GC

config LV_BIG_ENDIAN_SYSTEM
	int
	default 0 if !RT_LV_BIG_ENDIAN_SYSTEM
	default 1 if RT_LV_BIG_ENDIAN_SYSTEM

config LV_USE_LARGE_COORD
	int
	default 0 if !RT_LV_USE_LARGE_COORD
	default 1 if RT_LV_USE_LARGE_COORD

config LV_FONT_MONTSERRAT_8
	int
	default 0 if !RT_LV_FONT_MONTSERRAT_8
	default 1 if RT_LV_FONT_MONTSERRAT_8

config LV_FONT_MONTSERRAT_10
	int
	default 0 if !RT_LV_FONT_MONTSERRAT_10
	default 1 if RT_LV_FONT_MONTSERRAT_10

config LV_FONT_MONTSERRAT_12
	int
	default 0 if !RT_LV_FONT_MONTSERRAT_12
	default 1 if RT_LV_FONT_MONTSERRAT_12

config LV_FONT_MONTSERRAT_14
	int
	default 0 if !RT_LV_FONT_MONTSERRAT_14
	default 1 if RT_LV_FONT_MONTSERRAT_14

config LV_FONT_MONTSERRAT_16
	int
	default 0 if !RT_LV_FONT_MONTSERRAT_16
	default 1 if RT_LV_FONT_MONTSERRAT_16

config LV_FONT_MONTSERRAT_18
	int
	default 0 if !RT_LV_FONT_MONTSERRAT_18
	default 1 if RT_LV_FONT_MONTSERRAT_18

config LV_FONT_MONTSERRAT_20
	int
	default 0 if !RT_LV_FONT_MONTSERRAT_20
	default 1 if RT_LV_FONT_MONTSERRAT_20

config LV_FONT_MONTSERRAT_22
	int
	default 0 if !RT_LV_FONT_MONTSERRAT_22
	default 1 if RT_LV_FONT_MONTSERRAT_22

config LV_FONT_MONTSERRAT_24
	int
	default 0 if !RT_LV_FONT_MONTSERRAT_24
	default 1 if RT_LV_FONT_MONTSERRAT_24

config LV_FONT_MONTSERRAT_26
	int
	default 0 if !RT_LV_FONT_MONTSERRAT_26
	default 1 if RT_LV_FONT_MONTSERRAT_26

config LV_FONT_MONTSERRAT_28
	int
	default 0 if !RT_LV_FONT_MONTSERRAT_28
	default 1 if RT_LV_FONT_MONTSERRAT_28

config LV_FONT_MONTSERRAT_30
	int
	default 0 if !RT_LV_FONT_MONTSERRAT_30
	default 1 if RT_LV_FONT_MONTSERRAT_30

config LV_FONT_MONTSERRAT_32
	int
	default 0 if !RT_LV_FONT_MONTSERRAT_32
	default 1 if RT_LV_FONT_MONTSERRAT_32

config LV_FONT_MONTSERRAT_34
	int
	default 0 if !RT_LV_FONT_MONTSERRAT_34
	default 1 if RT_LV_FONT_MONTSERRAT_34

config LV_FONT_MONTSERRAT_36
	int
	default 0 if !RT_LV_FONT_MONTSERRAT_36
	default 1 if RT_LV_FONT_MONTSERRAT_36

config LV_FONT_MONTSERRAT_38
	int
	default 0 if !RT_LV_FONT_MONTSERRAT_38
	default 1 if RT_LV_FONT_MONTSERRAT_38

config LV_FONT_MONTSERRAT_40
	int
	default 0 if !RT_LV_FONT_MONTSERRAT_40
	default 1 if RT_LV_FONT_MONTSERRAT_40

config LV_FONT_MONTSERRAT_42
	int
	default 0 if !RT_LV_FONT_MONTSERRAT_42
	default 1 if RT_LV_FONT_MONTSERRAT_42

config LV_FONT_MONTSERRAT_44
	int
	default 0 if !RT_LV_FONT_MONTSERRAT_44
	default 1 if RT_LV_FONT_MONTSERRAT_44

config LV_FONT_MONTSERRAT_46
	int
	default 0 if !RT_LV_FONT_MONTSERRAT_46
	default 1 if RT_LV_FONT_MONTSERRAT_46

config LV_FONT_MONTSERRAT_48
	int
	default 0 if !RT_LV_FONT_MONTSERRAT_48
	default 1 if RT_LV_FONT_MONTSERRAT_48

config LV_FONT_MONTSERRAT_12_SUBPX
	int
	default 0 if !RT_LV_FONT_MONTSERRAT_12_SUBPX
	default 1 if RT_LV_FONT_MONTSERRAT_12_SUBPX

config LV_FONT_MONTSERRAT_28_COMPRESSED
	int
	default 0 if !RT_LV_FONT_MONTSERRAT_28_COMPRESSED
	default 1 if RT_LV_FONT_MONTSERRAT_28_COMPRESSED

config LV_FONT_DEJAVU_16_PERSIAN_HEBREW
	int
	default 0 if !RT_LV_FONT_DEJAVU_16_PERSIAN_HEBREW
	default 1 if RT_LV_FONT_DEJAVU_16_PERSIAN_HEBREW

config LV_FONT_SIMSUN_16_CJK
	int
	default 0 if !RT_LV_FONT_SIMSUN_16_CJK
	default 1 if RT_LV_FONT_SIMSUN_16_CJK

config LV_FONT_UNSCII_8
	int
	default 0 if !RT_LV_FONT_UNSCII_8
	default 1 if RT_LV_FONT_UNSCII_8

config LV_FONT_UNSCII_16
	int
	default 0 if !RT_LV_FONT_UNSCII_16
	default 1 if RT_LV_FONT_UNSCII_16

config LV_FONT_CUSTOM
	int
	default 0 if !RT_LV_FONT_CUSTOM
	default 1 if RT_LV_FONT_CUSTOM

config LV_FONT_DEFAULT_MONTSERRAT_8
	int
	default 0 if !RT_LV_FONT_DEFAULT_MONTSERRAT_8
	default 1 if RT_LV_FONT_DEFAULT_MONTSERRAT_8

config LV_FONT_DEFAULT_MONTSERRAT_12
	int
	default 0 if !RT_LV_FONT_DEFAULT_MONTSERRAT_12
	default 1 if RT_LV_FONT_DEFAULT_MONTSERRAT_12

config LV_FONT_DEFAULT_MONTSERRAT_14
	int
	default 0 if !RT_LV_FONT_DEFAULT_MONTSERRAT_14
	default 1 if RT_LV_FONT_DEFAULT_MONTSERRAT_14

config LV_FONT_DEFAULT_MONTSERRAT_16
	int
	default 0 if !RT_LV_FONT_DEFAULT_MONTSERRAT_16
	default 1 if RT_LV_FONT_DEFAULT_MONTSERRAT_16

config LV_FONT_DEFAULT_MONTSERRAT_18
	int
	default 0 if !RT_LV_FONT_DEFAULT_MONTSERRAT_18
	default 1 if RT_LV_FONT_DEFAULT_MONTSERRAT_18

config LV_FONT_DEFAULT_MONTSERRAT_20
	int
	default 0 if !RT_LV_FONT_DEFAULT_MONTSERRAT_20
	default 1 if RT_LV_FONT_DEFAULT_MONTSERRAT_20

config LV_FONT_DEFAULT_MONTSERRAT_22
	int
	default 0 if !RT_LV_FONT_DEFAULT_MONTSERRAT_22
	default 1 if RT_LV_FONT_DEFAULT_MONTSERRAT_22

config LV_FONT_DEFAULT_MONTSERRAT_24
	int
	default 0 if !RT_LV_FONT_DEFAULT_MONTSERRAT_24
	default 1 if RT_LV_FONT_DEFAULT_MONTSERRAT_24

config LV_FONT_DEFAULT_MONTSERRAT_26
	int
	default 0 if !RT_LV_FONT_DEFAULT_MONTSERRAT_26
	default 1 if RT_LV_FONT_DEFAULT_MONTSERRAT_26

config LV_FONT_DEFAULT_MONTSERRAT_28
	int
	default 0 if !RT_LV_FONT_DEFAULT_MONTSERRAT_28
	default 1 if RT_LV_FONT_DEFAULT_MONTSERRAT_28

config LV_FONT_DEFAULT_MONTSERRAT_30
	int
	default 0 if !RT_LV_FONT_DEFAULT_MONTSERRAT_30
	default 1 if RT_LV_FONT_DEFAULT_MONTSERRAT_30

config LV_FONT_DEFAULT_MONTSERRAT_32
	int
	default 0 if !RT_LV_FONT_DEFAULT_MONTSERRAT_32
	default 1 if RT_LV_FONT_DEFAULT_MONTSERRAT_32

config LV_FONT_DEFAULT_MONTSERRAT_34
	int
	default 0 if !RT_LV_FONT_DEFAULT_MONTSERRAT_34
	default 1 if RT_LV_FONT_DEFAULT_MONTSERRAT_34

config LV_FONT_DEFAULT_MONTSERRAT_36
	int
	default 0 if !RT_LV_FONT_DEFAULT_MONTSERRAT_36
	default 1 if RT_LV_FONT_DEFAULT_MONTSERRAT_36

config LV_FONT_DEFAULT_MONTSERRAT_38
	int
	default 0 if !RT_LV_FONT_DEFAULT_MONTSERRAT_38
	default 1 if RT_LV_FONT_DEFAULT_MONTSERRAT_38

config LV_FONT_DEFAULT_MONTSERRAT_40
	int
	default 0 if !RT_LV_FONT_DEFAULT_MONTSERRAT_40
	default 1 if RT_LV_FONT_DEFAULT_MONTSERRAT_40

config LV_FONT_DEFAULT_MONTSERRAT_42
	int
	default 0 if !RT_LV_FONT_DEFAULT_MONTSERRAT_42
	default 1 if RT_LV_FONT_DEFAULT_MONTSERRAT_42

config LV_FONT_DEFAULT_MONTSERRAT_44
	int
	default 0 if !RT_LV_FONT_DEFAULT_MONTSERRAT_44
	default 1 if RT_LV_FONT_DEFAULT_MONTSERRAT_44

config LV_FONT_DEFAULT_MONTSERRAT_46
	int
	default 0 if !RT_LV_FONT_DEFAULT_MONTSERRAT_46
	default 1 if RT_LV_FONT_DEFAULT_MONTSERRAT_46

config LV_FONT_DEFAULT_MONTSERRAT_48
	int
	default 0 if !RT_LV_FONT_DEFAULT_MONTSERRAT_48
	default 1 if RT_LV_FONT_DEFAULT_MONTSERRAT_48

config LV_FONT_DEFAULT_MONTSERRAT_12_SUBPX
	int
	default 0 if !RT_LV_FONT_DEFAULT_MONTSERRAT_12_SUBPX
	default 1 if RT_LV_FONT_DEFAULT_MONTSERRAT_12_SUBPX

config LV_FONT_DEFAULT_MONTSERRAT_28_COMPRESSED
	int
	default 0 if !RT_LV_FONT_DEFAULT_MONTSERRAT_28_COMPRESSED
	default 1 if RT_LV_FONT_DEFAULT_MONTSERRAT_28_COMPRESSED

config LV_FONT_DEFAULT_DEJAVU_16_PERSIAN_HEBREW
	int
	default 0 if !RT_LV_FONT_DEFAULT_DEJAVU_16_PERSIAN_HEBREW
	default 1 if RT_LV_FONT_DEFAULT_DEJAVU_16_PERSIAN_HEBREW

config LV_FONT_DEFAULT_SIMSUN_16_CJK
	int
	default 0 if !RT_LV_FONT_DEFAULT_SIMSUN_16_CJK
	default 1 if RT_LV_FONT_DEFAULT_SIMSUN_16_CJK

config LV_FONT_DEFAULT_UNSCII_8
	int
	default 0 if !RT_LV_FONT_DEFAULT_UNSCII_8
	default 1 if RT_LV_FONT_DEFAULT_UNSCII_8

config LV_FONT_DEFAULT_UNSCII_16
	int
	default 0 if !RT_LV_FONT_DEFAULT_UNSCII_16
	default 1 if RT_LV_FONT_DEFAULT_UNSCII_16

config LV_FONT_FMT_TXT_LARGE
	int
	default 0 if !RT_LV_FONT_FMT_TXT_LARGE
	default 1 if RT_LV_FONT_FMT_TXT_LARGE

config LV_USE_FONT_COMPRESSED
	int
	default 0 if !RT_LV_USE_FONT_COMPRESSED
	default 1 if RT_LV_USE_FONT_COMPRESSED

config LV_USE_FONT_SUBPX
	int
	default 0 if !RT_LV_USE_FONT_SUBPX
	default 1 if RT_LV_USE_FONT_SUBPX

config LV_FONT_SUBPX_BGR
	int
	default 0 if !RT_LV_FONT_SUBPX_BGR
	default 1 if RT_LV_FONT_SUBPX_BGR

config LV_USE_FONT_PLACEHOLDER
	int
	default 0 if !RT_LV_USE_FONT_PLACEHOLDER
	default 1 if RT_LV_USE_FONT_PLACEHOLDER

config LV_TXT_ENC
	int
	default 1 if RT_LV_TXT_ENC_UTF8
	default 2 if RT_LV_TXT_ENC_ASCII

config LV_USE_ARABIC_PERSIAN_CHARS
	int
	default 0 if !RT_LV_USE_ARABIC_PERSIAN_CHARS
	default 1 if RT_LV_USE_ARABIC_PERSIAN_CHARS

config LV_USE_ARC
	int
	default 0 if !RT_LV_USE_ARC
	default 1 if RT_LV_USE_ARC

config LV_USE_BAR
	int
	default 0 if !RT_LV_USE_BAR
	default 1 if RT_LV_USE_BAR

config LV_USE_BTN
	int
	default 0 if !RT_LV_USE_BTN
	default 1 if RT_LV_USE_BTN

config LV_USE_BTNMATRIX
	int
	default 0 if !RT_LV_USE_BTNMATRIX
	default 1 if RT_LV_USE_BTNMATRIX

config LV_USE_CANVAS
	int
	default 0 if !RT_LV_USE_CANVAS
	default 1 if RT_LV_USE_CANVAS

config LV_USE_CHECKBOX
	int
	default 0 if !RT_LV_USE_CHECKBOX
	default 1 if RT_LV_USE_CHECKBOX

config LV_USE_DROPDOWN
	int
	default 0 if !RT_LV_USE_DROPDOWN
	default 1 if RT_LV_USE_DROPDOWN

config LV_USE_IMG
	int
	default 0 if !RT_LV_USE_IMG
	default 1 if RT_LV_USE_IMG

config LV_USE_LABEL
	int
	default 0 if !RT_LV_USE_LABEL
	default 1 if RT_LV_USE_LABEL

config LV_LABEL_TEXT_SELECTION
	int
	default 0 if !RT_LV_LABEL_TEXT_SELECTION
	default 1 if RT_LV_LABEL_TEXT_SELECTION

config LV_LABEL_LONG_TXT_HINT
	int
	default 0 if !RT_LV_LABEL_LONG_TXT_HINT
	default 1 if RT_LV_LABEL_LONG_TXT_HINT

config LV_USE_LINE
	int
	default 0 if !RT_LV_USE_LINE
	default 1 if RT_LV_USE_LINE

config LV_USE_ROLLER
	int
	default 0 if !RT_LV_USE_ROLLER
	default 1 if RT_LV_USE_ROLLER

config LV_USE_SLIDER
	int
	default 0 if !RT_LV_USE_SLIDER
	default 1 if RT_LV_USE_SLIDER

config LV_USE_SWITCH
	int
	default 0 if !RT_LV_USE_SWITCH
	default 1 if RT_LV_USE_SWITCH

config LV_USE_TEXTAREA
	int
	default 0 if !RT_LV_USE_TEXTAREA
	default 1 if RT_LV_USE_TEXTAREA

config LV_USE_TABLE
	int
	default 0 if !RT_LV_USE_TABLE
	default 1 if RT_LV_USE_TABLE

config LV_USE_ANIMIMG
	int
	default 0 if !RT_LV_USE_ANIMIMG
	default 1 if RT_LV_USE_ANIMIMG

config LV_USE_CALENDAR
	int
	default 0 if !RT_LV_USE_CALENDAR
	default 1 if RT_LV_USE_CALENDAR

config LV_CALENDAR_WEEK_STARTS_MONDAY
	int
	default 0 if !RT_LV_CALENDAR_WEEK_STARTS_MONDAY
	default 1 if RT_LV_CALENDAR_WEEK_STARTS_MONDAY

config LV_USE_CALENDAR_HEADER_ARROW
	int
	default 0 if !RT_LV_USE_CALENDAR_HEADER_ARROW
	default 1 if RT_LV_USE_CALENDAR_HEADER_ARROW

config LV_USE_CALENDAR_HEADER_DROPDOWN
	int
	default 0 if !RT_LV_USE_CALENDAR_HEADER_DROPDOWN
	default 1 if RT_LV_USE_CALENDAR_HEADER_DROPDOWN

config LV_USE_CHART
	int
	default 0 if !RT_LV_USE_CHART
	default 1 if RT_LV_USE_CHART

config LV_USE_COLORWHEEL
	int
	default 0 if !RT_LV_USE_COLORWHEEL
	default 1 if RT_LV_USE_COLORWHEEL

config LV_USE_IMGBTN
	int
	default 0 if !RT_LV_USE_IMGBTN
	default 1 if RT_LV_USE_IMGBTN

config LV_USE_KEYBOARD
	int
	default 0 if !RT_LV_USE_KEYBOARD
	default 1 if RT_LV_USE_KEYBOARD

config LV_USE_LED
	int
	default 0 if !RT_LV_USE_LED
	default 1 if RT_LV_USE_LED

config LV_USE_LIST
	int
	default 0 if !RT_LV_USE_LIST
	default 1 if RT_LV_USE_LIST

config LV_USE_MENU
	int
	default 0 if !RT_LV_USE_MENU
	default 1 if RT_LV_USE_MENU

config LV_USE_METER
	int
	default 0 if !RT_LV_USE_METER
	default 1 if RT_LV_USE_METER

config LV_USE_MSGBOX
	int
	default 0 if !RT_LV_USE_MSGBOX
	default 1 if RT_LV_USE_MSGBOX

config LV_USE_SPAN
	int
	default 0 if !RT_LV_USE_SPAN
	default 1 if RT_LV_USE_SPAN

config LV_USE_SPINBOX
	int
	default 0 if !RT_LV_USE_SPINBOX
	default 1 if RT_LV_USE_SPINBOX

config LV_USE_SPINNER
	int
	default 0 if !RT_LV_USE_SPINNER
	default 1 if RT_LV_USE_SPINNER

config LV_USE_TABVIEW
	int
	default 0 if !RT_LV_USE_TABVIEW
	default 1 if RT_LV_USE_TABVIEW

config LV_USE_TILEVIEW
	int
	default 0 if !RT_LV_USE_TILEVIEW
	default 1 if RT_LV_USE_TILEVIEW

config LV_USE_WIN
	int
	default 0 if !RT_LV_USE_WIN
	default 1 if RT_LV_USE_WIN

config LV_USE_THEME_DEFAULT
	int
	default 0 if !RT_LV_USE_THEME_DEFAULT
	default 1 if RT_LV_USE_THEME_DEFAULT

config LV_THEME_DEFAULT_DARK
	int
	default 0 if !RT_LV_THEME_DEFAULT_DARK
	default 1 if RT_LV_THEME_DEFAULT_DARK

config LV_THEME_DEFAULT_GROW
	int
	default 0 if !RT_LV_THEME_DEFAULT_GROW
	default 1 if RT_LV_THEME_DEFAULT_GROW

config LV_USE_THEME_BASIC
	int
	default 0 if !RT_LV_USE_THEME_BASIC
	default 1 if RT_LV_USE_THEME_BASIC

config LV_USE_THEME_MONO
	int
	default 0 if !RT_LV_USE_THEME_MONO
	default 1 if RT_LV_USE_THEME_MONO

config LV_USE_FLEX
	int
	default 0 if !RT_LV_USE_FLEX
	default 1 if RT_LV_USE_FLEX

config LV_USE_GRID
	int
	default 0 if !RT_LV_USE_GRID
	default 1 if RT_LV_USE_GRID

config LV_USE_FS_STDIO
	int
	default 0 if !RT_LV_USE_FS_STDIO
	default 1 if RT_LV_USE_FS_STDIO

config LV_USE_FS_POSIX
	int
	default 0 if !RT_LV_USE_FS_POSIX
	default 1 if RT_LV_USE_FS_POSIX

config LV_USE_FS_WIN32
	int
	default 0 if !RT_LV_USE_FS_WIN32
	default 1 if RT_LV_USE_FS_WIN32

config LV_USE_FS_FATFS
	int
	default 0 if !RT_LV_USE_FS_FATFS
	default 1 if RT_LV_USE_FS_FATFS

config LV_USE_PNG
	int
	default 0 if !RT_LV_USE_PNG
	default 1 if RT_LV_USE_PNG

config LV_USE_BMP
	int
	default 0 if !RT_LV_USE_BMP
	default 1 if RT_LV_USE_BMP

config LV_USE_SJPG
	int
	default 0 if !RT_LV_USE_SJPG
	default 1 if RT_LV_USE_SJPG

config LV_USE_GIF
	int
	default 0 if !RT_LV_USE_GIF
	default 1 if RT_LV_USE_GIF

config LV_USE_QRCODE
	int
	default 0 if !RT_LV_USE_QRCODE
	default 1 if RT_LV_USE_QRCODE

config LV_USE_FREETYPE
	int
	default 0 if !RT_LV_USE_FREETYPE
	default 1 if RT_LV_USE_FREETYPE

config LV_FREETYPE_SBIT_CACHE
	int
	default 0 if !RT_LV_FREETYPE_SBIT_CACHE
	default 1 if RT_LV_FREETYPE_SBIT_CACHE

config LV_USE_RLOTTIE
	int
	default 0 if !RT_LV_USE_RLOTTIE
	default 1 if RT_LV_USE_RLOTTIE

config LV_USE_SNAPSHOT
	int
	default 0 if !RT_LV_USE_SNAPSHOT
	default 1 if RT_LV_USE_SNAPSHOT

config LV_USE_MONKEY
	int
	default 0 if !RT_LV_USE_MONKEY
	default 1 if RT_LV_USE_MONKEY

config LV_USE_GRIDNAV
	int
	default 0 if !RT_LV_USE_GRIDNAV
	default 1 if RT_LV_USE_GRIDNAV

config LV_USE_FRAGMENT
	int
	default 0 if !RT_LV_USE_FRAGMENT
	default 1 if RT_LV_USE_FRAGMENT

config LV_USE_IMGFONT
	int
	default 0 if !RT_LV_USE_IMGFONT
	default 1 if RT_LV_USE_IMGFONT

config LV_USE_MSG
	int
	default 0 if !RT_LV_USE_MSG
	default 1 if RT_LV_USE_MSG

config LV_USE_IME_PINYIN
	int
	default 0 if !RT_LV_USE_IME_PINYIN
	default 1 if RT_LV_USE_IME_PINYIN

config LV_IME_PINYIN_USE_K9_MODE
	int
	default 0 if !RT_LV_IME_PINYIN_USE_K9_MODE
	default 1 if RT_LV_IME_PINYIN_USE_K9_MODE

config LV_IME_PINYIN_USE_DEFAULT_DICT
	int
	default 0 if !RT_LV_IME_PINYIN_USE_DEFAULT_DICT
	default 1 if RT_LV_IME_PINYIN_USE_DEFAULT_DICT

config LV_BUILD_EXAMPLES
	int
	default 0 if !RT_LV_BUILD_EXAMPLES
	default 1 if RT_LV_BUILD_EXAMPLES

config LV_USE_DEMO_WIDGETS
	int
	default 0 if !RT_LV_USE_DEMO_WIDGETS
	default 1 if RT_LV_USE_DEMO_WIDGETS

config LV_DEMO_WIDGETS_SLIDESHOW
	int
	default 0 if !RT_LV_DEMO_WIDGETS_SLIDESHOW
	default 1 if RT_LV_DEMO_WIDGETS_SLIDESHOW

config LV_USE_DEMO_KEYPAD_AND_ENCODER
	int
	default 0 if !RT_LV_USE_DEMO_KEYPAD_AND_ENCODER
	default 1 if RT_LV_USE_DEMO_KEYPAD_AND_ENCODER

config LV_USE_DEMO_BENCHMARK
	int
	default 0 if !RT_LV_USE_DEMO_BENCHMARK
	default 1 if RT_LV_USE_DEMO_BENCHMARK

config LV_DEMO_BENCHMARK_RGB565A8
	int
	default 0 if !RT_LV_DEMO_BENCHMARK_RGB565A8
	default 1 if RT_LV_DEMO_BENCHMARK_RGB565A8

config LV_USE_DEMO_STRESS
	int
	default 0 if !RT_LV_USE_DEMO_STRESS
	default 1 if RT_LV_USE_DEMO_STRESS

config LV_USE_DEMO_MUSIC
	int
	default 0 if !RT_LV_USE_DEMO_MUSIC
	default 1 if RT_LV_USE_DEMO_MUSIC

config LV_DEMO_MUSIC_SQUARE
	int
	default 0 if !RT_LV_DEMO_MUSIC_SQUARE
	default 1 if RT_LV_DEMO_MUSIC_SQUARE

config LV_DEMO_MUSIC_LANDSCAPE
	int
	default 0 if !RT_LV_DEMO_MUSIC_LANDSCAPE
	default 1 if RT_LV_DEMO_MUSIC_LANDSCAPE

config LV_DEMO_MUSIC_ROUND
	int
	default 0 if !RT_LV_DEMO_MUSIC_ROUND
	default 1 if RT_LV_DEMO_MUSIC_ROUND

config LV_DEMO_MUSIC_LARGE
	int
	default 0 if !RT_LV_DEMO_MUSIC_LARGE
	default 1 if RT_LV_DEMO_MUSIC_LARGE

config LV_DEMO_MUSIC_AUTO_PLAY
	int
	default 0 if !RT_LV_DEMO_MUSIC_AUTO_PLAY
	default 1 if RT_LV_DEMO_MUSIC_AUTO_PLAY
```
