## rtos/bsp/rockchip/rk2206/drivers/Kconfig
```kconfig
source "$BSP_DIR/../common/drivers/Kconfig"

menu "RT-Thread rockchip rk2206 drivers"

config RT_USING_CRU
    bool "Enable CRU"
    default n

config RT_USING_DMA
    bool "Enable General DMA Framework"
    default n

choice
    prompt "DMA Type"
    depends on RT_USING_DMA

    config RT_USING_DMA_DW
        bool "Enable DesignWare DMA Controller"
        default n
endchoice

config RT_USING_PMU
    bool "Enable PMU"
    default n

config RT_USING_RGB
    bool "Enable RGB"
    default n

config RT_USING_VOP
    bool "Enable VOP"
    default n

config RT_USING_DSI
     bool "Enable MIPI DSI"
     default n

if RT_USING_PWM
config RT_USING_PWM0
    bool "Enable PWM0"
    default n
endif

menu "Enable DSP"
    config RT_USING_DSP
        bool "Enable DSP"
        default n

    if RT_USING_DSP
    config RT_USING_DSPFW_LOADER
        bool "Enable firmware loader to dsp"
        default n

    choice
        prompt "Dsp firmware path"
        default RT_USING_DSPFW_FILE
        depends on RT_USING_DSPFW_LOADER

        config RT_USING_DSPFW_BUILTIN
            bool "Store firmware data in builtin"

        config RT_USING_DSPFW_FILE
            bool "Store firmware data in file"
    endchoice

    config RT_PATH_DSPFW
        string "Dsp firmware path"
        default "/rkdsp.bin"
        depends on RT_USING_DSPFW_FILE

    config RT_USING_DSP_TRACE
        bool "Enable dsp send trace to cm4"
        default n

    config RT_DSP_UART_PORT
        int "Config dsp debug uart port"
        range -1 2
        default -1
        help
            set -1, will not set uart port to dsp
    endif
endmenu

menu "Enable UART"
    config RT_USING_UART
        bool "Enable UART"
        default n

    if RT_USING_UART
    config RT_USING_UART0
        bool "Enable UART0"
        default n

    config RT_USING_UART1
        bool "Enable UART1"
        default n

    config RT_USING_UART2
        bool "Enable UART2"
        default n
    endif
endmenu

if RT_USING_I2C
menu "Enable I2C"
    config RT_USING_I2C0
        bool "Enable I2C0"
        default n

    config RT_USING_I2C1
        bool "Enable I2C1"
        default n

    config RT_USING_I2C2
        bool "Enable I2C2"
        default n
endmenu
endif

if RT_USING_SPI
menu "Enable SPI"
    config RT_USING_SPI2APB
        bool "Enable SPI0 (SPI2APB)"
        default n

    config RT_USING_SPI1
        bool "Enable SPI1"
        default n

    config RT_USING_SPI2
        bool "Enable SPI2"
        default n
endmenu
endif

if RT_USING_SDIO
menu "Enable SDIO/SDMMC/eMMC"
    config RT_USING_SDIO0
        bool "Enable SDIO controller"
        default n
endmenu
endif

if RT_USING_AUDIO
menu "Enable Audio"
    config RT_USING_PCM
        bool "Enable PCM"
        select RT_USING_DMA
        default y

    config RT_USING_ACDCDIG
        bool "Enable ACDCDIG"
        default n

    config RT_USING_AUDIOPWM
        bool "Enable AUDIOPWM"
        default n

    config RT_USING_I2STDM
        bool "Enable I2STDM"
        default n

    config RT_USING_PDM
        bool "Enable PDM"
        default n

    config RT_USING_VAD
        bool "Enable VAD"
        default n

    source "$BSP_DIR/../common/drivers/audio/codecs/Kconfig"
endmenu
endif

config RT_USING_HYPERPSRAM
    bool "Enable HYPERPSRAM"
    default n

config RT_USING_PSRAM
    bool "Enable QPI PSRAM"
    default n

if RT_USING_USB_HOST
menu "Enable USB HOST"
    config RT_USING_DWC2_USBH
        bool "Enable USB OTG HOST"
        depends on !RT_USING_USB_DEVICE
        default n

    if RT_USING_DWC2_USBH
    config RT_USING_DWC2_USBH0
        bool "Enable USB OTG0 HOST"
        default n
    endif
endmenu
endif

endmenu
```

## rtos/bsp/rockchip/rk2208/Kconfig
```kconfig
mainmenu "RT-Thread Configuration"

config BSP_DIR
    string
    option env = "BSP_ROOT"
    default "."

config RTT_DIR
    string
    option env = "RTT_ROOT"
    default "../../.."

config PKGS_DIR
    string
    option env = "PKGS_ROOT"
    default "packages"

config ARCH_ARM_CORTEX_M33
    bool
    default y

config RKMCU_RK2208
    bool
    select ARCH_ARM_CORTEX_M33
    default y

choice
    prompt "RK2208 CM33 core select"
    default RK2208_CM33_B

    config RK2208_CM33_L
        bool "Cortex-M33 L"

    config RK2208_CM33_B
        bool "Cortex-M33 B"
endchoice

config PM_HAS_CUSTOM_CONFIG
    bool
    depends on RT_USING_PM
    default n

source "$RTT_DIR/Kconfig"

menuconfig RT_USING_PKGS
    bool "Enable RT-Thread online packages"

if RT_USING_PKGS
    source "$PKGS_DIR/Kconfig"
endif

source "$BSP_DIR/drivers/Kconfig"
source "$BSP_DIR/board/Kconfig"
```

## rtos/bsp/rockchip/rk2208/board/Kconfig
```kconfig
menu "RT-Thread board config"

    config IS_FPGA
        bool "Is FPGA Board"
        default n
choice
    prompt "Board Type"
    default RT_USING_BOARD_M1_EVB

    config RT_USING_BOARD_M1P_RK3399_EVB
        bool "Enable M1P_RK3399_EVB board"

    config RT_USING_BOARD_M1_EVB
        bool "Enable M1_EVB board"

    config RT_USING_BOARD_FPGA
        bool "Enable FPGA board"
        select IS_FPGA

endchoice

if RT_USING_BOARD_M1_EVB
    config M4_JTAG_ENABLE
        bool "Enable Cortex M4 JTAG"
        default n
        select RT_USING_UART1
        help
            you need set RT_CONSOLE_DEVICE_NAME=uart1 at the same time

    config DSP_JTAG_ENABLE
        bool "Enable DSP JTAG"
        default n
endif

endmenu
```

## rtos/bsp/rockchip/rk2208/drivers/Kconfig
```kconfig
source "$BSP_DIR/../common/drivers/Kconfig"

menu "RT-Thread rockchip RK2208 drivers"

config RT_USING_CRU
    bool "Enable CRU"
    default n

config RT_USING_DMA
    bool "Enable General DMA Framework"
    default n

if RT_USING_DMA
config RT_USING_DMA_PL330
    bool "Enable PL330 DMA Controller"
    default n

config RT_USING_DMA0
    bool "Enable PL330 DMA0 Controller"
    default n

config RT_USING_DMA1
    bool "Enable PL330 DMA1 Controller"
    default n
endif

if RT_USING_I2C
menu "Enable I2C"
    config RT_USING_I2C0
        bool "Enable I2C0"
        default n

    config RT_USING_I2C1
        bool "Enable I2C1"
        default n

    config RT_USING_I2C2
        bool "Enable I2C2"
        default n
endmenu
endif

if RT_USING_PWM
config RT_USING_PWM0
    bool "Enable PWM0"
    default n
endif

config RT_USING_SARADC
    select RT_USING_ADC
    bool "Enable SARADC"
    default n

if RT_USING_SPI
menu "Enable SPI"
    config RT_USING_SPI0
        bool "Enable SPI0"
        default n

    config RT_USING_SPI1
        bool "Enable SPI1"
        default n

    config RT_USING_SPI2
        bool "Enable SPI2"
        default n
endmenu
endif

config RT_USING_SYSTICK
    bool "Enable SYSTICK"
    default y

config RT_USING_TSADC
    bool "Enable TSADC"
    default n

menu "Enable UART"
    config RT_USING_UART
        bool "Enable UART"
        default n

    if RT_USING_UART
    config RT_USING_UART0
        bool "Enable UART0"
        default n

    config RT_USING_UART1
        bool "Enable UART1"
        default n
    endif
endmenu

endmenu
```
