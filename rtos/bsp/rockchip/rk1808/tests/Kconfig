## rtos/bsp/rockchip/rk1808/tests/Kconfig
```kconfig
menu "RT-Thread bsp test case"

config RT_USING_TC
    bool "Enable Kernel TEST"
    default n

config RT_USING_PRIVATE_TEST
    bool "Enable BSP Private TEST"
    default n

source "$BSP_DIR/../common/tests/Kconfig"

endmenu
```

## rtos/bsp/rockchip/rk2106/Kconfig
```kconfig
mainmenu "RT-Thread Configuration"

config BSP_DIR
    string
    option env="BSP_ROOT"
    default "."

config RTT_DIR
    string
    option env="RTT_ROOT"
    default "../../.."

config PKGS_DIR
    string
    option env="PKGS_ROOT"
    default "packages"

config RKMCU_RK2106
    bool
    select ARCH_ARM_CORTEX_M3
    default y

source "$RTT_DIR/Kconfig"
source "$BSP_DIR/drivers/Kconfig"
source "$BSP_DIR/board/Kconfig"
source "$BSP_DIR/../common/tests/Kconfig"
```

## rtos/bsp/rockchip/rk2106/board/Kconfig
```kconfig
menu "RT-Thread board config"

config RT_BOARD_NAME
    string "the board name of you use"
    default "evb"

config RT_USING_JTAG
    bool "Enable JTAG for debug"
    default n

endmenu
```

## rtos/bsp/rockchip/rk2106/drivers/Kconfig
```kconfig
source "$BSP_DIR/../common/drivers/Kconfig"

menu "RT-Thread rockchip rk2106 drivers"

source "$BSP_DIR/drivers/Kconfig.audio"

config RT_USING_SYSTICK
    bool "Use internal timer of CPU for tick"
    default n

config RT_USING_CRU
    bool "Enable CRU"
    default n

config RT_USING_DMA
    bool "Enable General DMA Framework"
    default n

config RT_USING_DMA_DWDMA
    depends on RT_USING_DMA
    bool "Enable DW DMA Controller"

config RT_USING_DMA_DWDMA_IRQ_SHARED
    depends on RT_USING_DMA_DWDMA
    bool "Enable DW DMA IRQ Shared"
    default y if RKMCU_RK2106
    help
      IRQ_SHARED depends on implementation of SoC dwdma irq. please
      enable this macro if SoC using one shared irq for all dma channel.
      such as rk2106. otherwise, say NO.

menu "Enable UART"
    config RT_USING_UART
        bool "Enable UART"
        default n

    if RT_USING_UART
    config RT_USING_UART0
        bool "Enable UART0"
        default n
    config RT_USING_UART1
        bool "Enable UART1"
        default n
    endif
endmenu

if RT_USING_I2C
menu "Enable I2C"
    config RT_USING_I2C0
        bool "Enable I2C0"
        default n

    config RT_USING_I2C1
        bool "Enable I2C1"
        default n

endmenu
endif

if RT_USING_SPI
menu "Enable SPI"
    config RT_USING_SPI0
        bool "Enable SPI0"
        default n

    config RT_USING_SPI1
        bool "Enable SPI1"
        default n

endmenu
endif

endmenu
```

## rtos/bsp/rockchip/rk2106/drivers/Kconfig.audio
```kconfig
if RT_USING_AUDIO
menu "Enable Audio"
    source "$BSP_DIR/../common/drivers/audio/codecs/Kconfig"
    source "$BSP_DIR/../common/drivers/audio/pcm/Kconfig"

    menu "Audio Cards"

    config RT_USING_AUDIO_CARD
        bool "Audio Cards"
        select RT_USING_CODEC
        default n

    config RT_USING_AUDIO_CARD_RK2106
        bool "Enable Internal ADC audio card"
        depends on RT_USING_AUDIO_CARD
        select RT_USING_I2S0
        select RT_USING_ACODEC
        default n
        help
          Say Y if you want to use internal adc card
          which support stereo differential analog mics.

    endmenu

    menu "Audio Interfaces"

    config RT_USING_PCM
        bool
        select RT_USING_DMA
        default y

    config RT_USING_I2S
        bool

    config RT_USING_I2S0
        bool
        select RT_USING_I2S

    config RT_USING_I2S1
        bool
        select RT_USING_I2S

    endmenu

endmenu

endif
```

## rtos/bsp/rockchip/rk2108/board/Kconfig
```kconfig
menu "RT-Thread board config"

config RT_BOARD_NAME
    string "the board name of you use"
    default "rk2108b_evb"

config RK_SRAM_END
    hex "the address of sram end"
    default 0x20100000

source "$BSP_DIR/board/$RT_BOARD_NAME/Kconfig"

endmenu
```

## rtos/bsp/rockchip/rk2108/drivers/Kconfig
```kconfig
source "$BSP_DIR/../common/drivers/Kconfig"

menu "RT-Thread rockchip rk2108 drivers"

source "$BSP_DIR/drivers/Kconfig.audio"

config RT_USING_CRU
    bool "Enable CRU"
    default n

config RT_USING_DMA
    bool "Enable General DMA Framework"
    default n

if RT_USING_DMA
    config RT_USING_DMA_PL330
        bool "Enable PL330 DMA Controller"
        default n

    config RT_USING_DMA0
        bool "Enable PL330 DMA0 Controller"
        default n
endif

config RT_USING_PMU
    bool "Enable PMU"
    default n

config RT_USING_DISPLAY
    bool "Enable Display"
    default n

choice
    prompt "Display Controller"
    depends on RT_USING_DISPLAY

    config RT_USING_VOP
        bool "Enable VOP Composite"
        depends on RT_USING_DISPLAY
        default n

    config RT_USING_SPI_SCREEN
        bool "Enable SPI Transfer"
        depends on RT_USING_SPI
        default n
        help
          This display driver does not require the use of a VOP controller, and only
          uses SPI to transmit display data.
endchoice

choice
    prompt "Display Interface"
    depends on RT_USING_VOP

    config RT_USING_VOP_MCU
        bool "Enable MCU Display Port"
        default n

    config RT_USING_DSI
        bool "Enable MIPI DSI"
        default n
endchoice

config RT_USING_KEYCTRL
     bool "Enable KEYCTRL"
     default n

if RT_USING_PWM
config RT_USING_PWM0
    bool "Enable PWM0"
    default n
endif

menu "Enable DSP"
    config RT_USING_DSP
        bool "Enable DSP"
        select RT_USING_UNCACHE_HEAP
        default n

    if RT_USING_DSP
    config RT_USING_DSPFW_LOADER
        bool "Enable firmware loader to dsp"
        default n

    choice
        prompt "Dsp firmware path"
        default RT_USING_DSPFW_FILE
        depends on RT_USING_DSPFW_LOADER

        config RT_USING_DSPFW_BUILTIN
            bool "Store firmware data in builtin"

        config RT_USING_DSPFW_FILE
            bool "Store firmware data in file"
    endchoice

    config RT_PATH_DSPFW
        string "Dsp firmware path"
        default "/rkdsp.bin"
        depends on RT_USING_DSPFW_FILE

    config RT_DSPFW_FILE_NAME
        string "Dsp firmware file name"
        default "rkdsp_fw.c"
        depends on RT_USING_DSPFW_BUILTIN

    config RT_USING_DSP_TRACE
        bool "Enable dsp send trace to cm4"
        default n

    config RT_DSP_UART_PORT
        int "Config dsp debug uart port"
        range -1 2
        default -1
        help
            set -1, will not set uart port to dsp
    endif
endmenu

menu "Enable UART"
    config RT_USING_UART
        bool "Enable UART"
        default n

    if RT_USING_UART
    config RT_USING_UART0
        bool "Enable UART0"
        default n

    config RT_USING_UART1
        bool "Enable UART1"
        default n

    config RT_USING_UART2
        bool "Enable UART2"
        default n
    endif
endmenu

if RT_USING_I2C
menu "Enable I2C"
    config RT_USING_I2C0
        bool "Enable I2C0"
        default n

    config RT_USING_I2C1
        bool "Enable I2C1"
        default n

    config RT_USING_I2C2
        bool "Enable I2C2"
        default n
endmenu
endif

if RT_USING_SPI
menu "Enable SPI"
    config RT_USING_SPI2APB
        bool "Enable SPI0 (SPI2APB)"
        default n

    config RT_USING_SPI1
        bool "Enable SPI1"
        default n

    config RT_USING_SPI2
        bool "Enable SPI2"
        default n
endmenu
endif

if RT_USING_SDIO
menu "Enable SDIO/SDMMC/eMMC"
    config RT_USING_SDIO0
        bool "Enable SDIO controller"
        default n
endmenu
endif

config RT_USING_SYSTICK
     bool "Enable SYSTICK"
     default n

endmenu
```

## rtos/bsp/rockchip/rk2108/drivers/Kconfig.audio
```kconfig
if RT_USING_AUDIO
menu "Enable Audio"
    source "$BSP_DIR/../common/drivers/audio/codecs/Kconfig"
    source "$BSP_DIR/../common/drivers/audio/pcm/Kconfig"

    menu "Audio Cards"

    config RT_USING_AUDIO_CARD
        bool "Audio Cards"
        select RT_USING_CODEC
        default n

    config RT_USING_AUDIO_CARD_ACDCDIG
        bool "Enable Internal ADC audio card"
        depends on RT_USING_AUDIO_CARD
        select RT_USING_ACDCDIG
        default n
        help
          Say Y if you want to use internal adc card
          which support stereo differential analog mics.

    choice
        prompt "iface type"
        depends on RT_USING_AUDIO_CARD_ACDCDIG
        default RT_USING_ACDCDIG_PDM0
        help
          The internal ADC is wired to and PDM0, PDM0_SDI2
          choice one for it.

        config RT_USING_ACDCDIG_PDM0
            bool "PDM0"
            select RT_USING_PDM0

        config RT_USING_ACDCDIG_PDM0_SDI2
            bool "PDM0 SDI2"
            select RT_USING_PDM0
    endchoice

    config RT_USING_AUDIO_CARD_AUDIOPWM
        bool "Enable AUDIOPWM audio card"
        depends on RT_USING_AUDIO_CARD
        select RT_USING_AUDIOPWM
        default n
        help
          Say Y if you want to use audiopwm card
          which can drive PA for middle quality sound.

    config RT_USING_AUDIO_CARD_I2S_MIC
        bool "Enable I2S Ditigal Mic audio card"
        depends on RT_USING_AUDIO_CARD
        default n
        help
          Say Y if you want to use i2s digital mics.

    choice
        prompt "i2s select"
        depends on RT_USING_AUDIO_CARD_I2S_MIC
        default RT_USING_I2STDM1_MIC
        help
          Choice the i2s which wired to external i2s mics.

        config RT_USING_I2STDM0_MIC
            bool "I2STDM0"
            select RT_USING_I2STDM0

        config RT_USING_I2STDM1_MIC
            bool "I2STDM1"
            select RT_USING_I2STDM1
    endchoice

    config RT_USING_AUDIO_CARD_PDM_MIC
        bool "Enable PDM Digital Mic audio card"
        depends on RT_USING_AUDIO_CARD
        select RT_USING_PDM0
        help
          Say Y if you want to use pdm digital mics card.

    config RT_USING_AUDIO_CARD_PCM_BT
        bool "Enable PCM BT audio card"
        depends on RT_USING_AUDIO_CARD
        select RT_USING_I2STDM0
        help
          Say Y if you want to use pcm bt card.

    choice
        prompt "pcm iomux select"
        depends on RT_USING_AUDIO_CARD_PCM_BT
        default RT_USING_PCM_M1
        help
          Choice the pcm iomux which wired to external bt.

        config RT_USING_PCM_M0
            bool "pcm m0"
            select RT_USING_I2STDM0

        config RT_USING_PCM_M1
            bool "pcm m1"
            select RT_USING_I2STDM0
    endchoice

    config RT_USING_AUDIO_CARD_AW8896
        bool "Enable AWINIC AW8896 audio card"
        depends on RT_USING_AUDIO_CARD
        select RT_USING_I2STDM1
        select RT_USING_CODEC_AW8896
        default n
        help
          Say Y if you want to use AWINIC AW8896 audio card.

    config RT_USING_AUDIO_CARD_ES7243
        bool "Enable Everest Semi ES7243 audio card"
        depends on RT_USING_AUDIO_CARD
        select RT_USING_I2STDM1
        select RT_USING_CODEC_ES7243
        default n
        help
          Say Y if you want to use Everest Semi ES7243 audio card.

    config RT_USING_AUDIO_CARD_ES8156
        bool "Enable Everest Semi ES8156 audio card"
        depends on RT_USING_AUDIO_CARD
        select RT_USING_I2STDM1
        select RT_USING_CODEC_ES8156
        default n
        help
          Say Y if you want to use Everest Semi ES8156 audio card.

    config RT_USING_AUDIO_CARD_ES8311
        bool "Enable Everest Semi ES8311 audio card"
        depends on RT_USING_AUDIO_CARD
        select RT_USING_I2STDM1
        select RT_USING_CODEC_ES8311
        default n
        help
          Say Y if you want to use Everest Semi ES8311 audio card.

    config RT_USING_AUDIO_CARD_ES8388
        bool "Enable Everest Semi ES8388 audio card"
        depends on RT_USING_AUDIO_CARD
        select RT_USING_I2STDM1
        select RT_USING_CODEC_ES8388
        default n
        help
          Say Y if you want to use Everest Semi ES8388 audio card.

    config RT_USING_AUDIO_CARD_ADC_ES8311_ECHO
        bool "Enable mix audio card with Interal ADC + ES8311"
        depends on RT_USING_AUDIO_CARD
        select RT_USING_I2STDM1
        select RT_USING_PDM0
        select RT_USING_MULTI_DAIS
        select RT_USING_MULTI_PCM
        select RT_USING_CODEC_ES8311
        select RT_USING_ACDCDIG
        default n
        help
          Say Y if you want to use mix audio card which support quad channels
          capture and stereo channels playback.

          Stereo Playback - ES8388
          Quad Capture - Internal ADC + External ES8311

          Internal ADC - stereo analog mics
          External ES8311 - stereo loopback

    config RT_USING_AUDIO_CARD_PDM_ES8388_ECHO
        bool "Enable mix audio card with PDM Mics + ES8388"
        depends on RT_USING_AUDIO_CARD
        select RT_USING_I2STDM1
        select RT_USING_PDM0
        select RT_USING_MULTI_DAIS
        select RT_USING_MULTI_PCM
        select RT_USING_CODEC_ES8388
        default n
        help
          Say Y if you want to use mix audio card which support quad channels
          capture and stereo channels playback.

          Stereo Playback - ES8388
          Quad Capture - PDM mics + External ES8388

          PDM - stereo pdm digital mics
          External ES8388 - stereo loopback

    config RT_USING_AUDIO_CARD_ES7202_ACDCDIG_COMBINE
        bool "Enable mix audio card with ES7202 + ADC"
        depends on RT_USING_AUDIO_CARD
        select RT_USING_PDM0
        select RT_USING_MULTI_CODECS
        select RT_USING_CODEC_ES7202
        select RT_USING_AUDIO_CARD_ACDCDIG
        select RT_USING_ACDCDIG_PDM0_SDI2
        default n
        help
          Say Y if you want to use mix audio card which support six channels
          capture.

          The first four channels come from ES7202(SDI0 SDI1)
          The last two channels come from ADC(SDI2)

    endmenu

    menu "Audio Interfaces"

    config RT_USING_PCM
        bool
        select RT_USING_DMA
        default y

    config RT_USING_MULTI_CODECS
        bool

    config RT_USING_MULTI_DAIS
        bool

    config RT_USING_MULTI_PCM
        bool

    config RT_USING_AUDIOPWM
        bool

    config RT_USING_I2STDM
        bool

    config RT_USING_I2STDM0
        bool
        select RT_USING_I2STDM

    config RT_USING_I2STDM1
        bool
        select RT_USING_I2STDM

    config RT_USING_PDM
        bool

    config RT_USING_PDM0
        bool
        select RT_USING_PDM

    config RT_USING_VAD
        bool "Enable VAD"
        default n

    choice
        prompt "VAD irq handler"
        depends on RT_USING_VAD
        default RT_VAD_IRQ_HANDLED_BY_DSP

        config RT_VAD_IRQ_HANDLED_BY_DSP
            bool "handled by DSP"

        config RT_VAD_IRQ_HANDLED_BY_CPU
            bool "handled by CPU"

    endchoice

    endmenu

endmenu

endif
```

## rtos/bsp/rockchip/rk2116/Kconfig
```kconfig
mainmenu "RT-Thread Configuration"

config BSP_DIR
    string
    option env = "BSP_ROOT"
    default "."

config RTT_DIR
    string
    option env = "RTT_ROOT"
    default "../../.."

config PKGS_DIR
    string
    option env = "PKGS_ROOT"
    default "packages"

config RKMCU_RK2116
    bool
    default y

source "$RTT_DIR/Kconfig"

menuconfig RT_USING_PKGS
    bool "Enable RT-Thread online packages"

if RT_USING_PKGS
    source "$PKGS_DIR/Kconfig"
endif

source "$BSP_DIR/drivers/Kconfig"
source "$BSP_DIR/board/Kconfig"
source "$BSP_DIR/../common/tests/Kconfig"
```

## rtos/bsp/rockchip/rk2116/board/Kconfig
```kconfig
menu "RT-Thread board config"

config IS_FPGA
    bool "Is FPGA Board"
    default n

choice
    prompt "Board Type"
    default RT_USING_BOARD_FPGA

    config RT_USING_BOARD_FPGA
        bool "Enable FPGA board"
        select IS_FPGA
endchoice

source "$RTT_DIR/components/hifi4/rtt/app/Kconfig"
source "$RTT_DIR/components/hifi4/rtt/codecs/Kconfig"
source "$RTT_DIR/components/hifi4/rtt/rkstudio_comm/Kconfig"
source "$RTT_DIR/components/hifi4/rtt/rkstudio_parser/Kconfig"
source "$BSP_DIR/../common/fwmgr/Kconfig"
endmenu
```
