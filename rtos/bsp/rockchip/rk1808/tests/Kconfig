## rtos/bsp/rockchip/rk2116/drivers/Kconfig.audio
```kconfig
if RT_USING_AUDIO
menu "Enable Audio"
    source "$BSP_DIR/../common/drivers/audio/codecs/Kconfig"
    source "$BSP_DIR/../common/drivers/audio/pcm/Kconfig"

    menu "Audio Cards"

    config RT_USING_AUDIO_CARD
        bool "Audio Cards"
        select RT_USING_CODEC
        default n

    config RT_USING_AUDIO_CARD_SAI0
        bool "Enable SAI0 Digital audio card"
        depends on RT_USING_AUDIO_CARD
        select RT_USING_SAI0
        default n
        help
          Say Y if you want to use sai0 digital audio card.

    config RT_USING_AUDIO_CARD_SAI1
        bool "Enable SAI1 Digital audio card"
        depends on RT_USING_AUDIO_CARD
        select RT_USING_SAI1
        default n
        help
          Say Y if you want to use sai1 digital audio card.

    config RT_USING_AUDIO_CARD_SAI2
        bool "Enable SAI2 Digital audio card"
        depends on RT_USING_AUDIO_CARD
        select RT_USING_SAI2
        default n
        help
          Say Y if you want to use sai2 digital audio card.

    config RT_USING_AUDIO_CARD_SAI3
        bool "Enable SAI3 Digital audio card"
        depends on RT_USING_AUDIO_CARD
        select RT_USING_SAI3
        default n
        help
          Say Y if you want to use sai3 digital audio card.

    config RT_USING_AUDIO_CARD_SAI4
        bool "Enable SAI4 Digital audio card"
        depends on RT_USING_AUDIO_CARD
        select RT_USING_SAI4
        default n
        help
          Say Y if you want to use sai4 digital audio card.

    config RT_USING_AUDIO_CARD_SAI5
        bool "Enable SAI5 Digital audio card"
        depends on RT_USING_AUDIO_CARD
        select RT_USING_SAI5
        default n
        help
          Say Y if you want to use sai5 digital audio card.

    config RT_USING_AUDIO_CARD_SAI6
        bool "Enable SAI6 Digital audio card"
        depends on RT_USING_AUDIO_CARD
        select RT_USING_SAI6
        default n
        help
          Say Y if you want to use sai6 digital audio card.

    config RT_USING_AUDIO_CARD_SAI7
        bool "Enable SAI7 Digital audio card"
        depends on RT_USING_AUDIO_CARD
        select RT_USING_SAI7
        default n
        help
          Say Y if you want to use sai7 digital audio card.

    config RT_USING_AUDIO_CARD_SPDIFRX0
        bool "Enable SPDIFRX0 Digital audio card"
        depends on RT_USING_AUDIO_CARD
        select RT_USING_SPDIFRX0
        default n
        help
          Say Y if you want to use spdifrx0 digital audio card.

    config RT_USING_AUDIO_CARD_SPDIFRX1
        bool "Enable SPDIFRX1 Digital audio card"
        depends on RT_USING_AUDIO_CARD
        select RT_USING_SPDIFRX1
        default n
        help
          Say Y if you want to use spdifrx1 digital audio card.

    config RT_USING_AUDIO_CARD_SPDIFTX0
        bool "Enable SPDIFTX0 Digital audio card"
        depends on RT_USING_AUDIO_CARD
        select RT_USING_SPDIFTX0
        default n
        help
          Say Y if you want to use spdiftx0 digital audio card.

    config RT_USING_AUDIO_CARD_PDM0
        bool "Enable PDM0 Digital audio card"
        depends on RT_USING_AUDIO_CARD
        select RT_USING_PDM0
        default n
        help
          Say Y if you want to use pdm0 digital audio card.

    endmenu

    menu "Audio Interfaces"

    config RT_USING_PCM
        bool
        select RT_USING_DMA
        default y

    config RT_USING_MULTI_DAIS
        bool

    config RT_USING_MULTI_PCM
        bool

    config RT_USING_SAI
        bool

    config RT_USING_SAI0
        bool
        select RT_USING_SAI

    config RT_USING_SAI1
        bool
        select RT_USING_SAI

    config RT_USING_SAI2
        bool
        select RT_USING_SAI

    config RT_USING_SAI3
        bool
        select RT_USING_SAI

    config RT_USING_SAI4
        bool
        select RT_USING_SAI

    config RT_USING_SAI5
        bool
        select RT_USING_SAI

    config RT_USING_SAI6
        bool
        select RT_USING_SAI

    config RT_USING_SAI7
        bool
        select RT_USING_SAI

    config RT_USING_SPDIFRX
        bool

    config RT_USING_SPDIFRX0
        bool
        select RT_USING_SPDIFRX

    config RT_USING_SPDIFTX
        bool

    config RT_USING_SPDIFTX0
        bool
        select RT_USING_SPDIFTX

    config RT_USING_PDM
        bool

    config RT_USING_PDM0
        bool
        select RT_USING_PDM

    endmenu

endmenu

endif
```

## rtos/bsp/rockchip/rk2118/Kconfig
```kconfig
mainmenu "RT-Thread Configuration"

config BSP_DIR
    string
    option env = "BSP_ROOT"
    default "."

config RTT_DIR
    string
    option env = "RTT_ROOT"
    default "../../.."

config PKGS_DIR
    string
    option env = "PKGS_ROOT"
    default "packages"

config ARCH_ARM_CORTEX_M33
    bool
    default y

config ARM_CM33_ENABLE_TRUSTZONE
    bool
    default n

config RKMCU_RK2118
    bool
    select ARCH_ARM_CORTEX_M33
    default y

choice
    prompt "RK2118 cpu core select"
    default RK2118_CPU_CORE0

    config RK2118_CPU_CORE0
        bool "STAR-MC1 CORE0"

    config RK2118_CPU_CORE1
        bool "STAR-MC1 CORE1"

endchoice

config ARCH_ARM_CORTEX_SECURE
    bool "STAR-MC1 Core0 run in security context"
    select RK2118_CPU_CORE0
    default n

config PM_HAS_CUSTOM_CONFIG
    bool
    depends on RT_USING_PM
    default n

source "$RTT_DIR/Kconfig"

menuconfig RT_USING_PKGS
    bool "Enable RT-Thread online packages"

if RT_USING_PKGS
    source "$PKGS_DIR/Kconfig"
endif

source "$BSP_DIR/drivers/Kconfig"
source "$BSP_DIR/board/Kconfig"
source "$BSP_DIR/../common/tests/Kconfig"
```

## rtos/bsp/rockchip/rk2118/board/Kconfig
```kconfig
menu "RT-Thread board config"

config IS_FPGA
    bool "Is FPGA Board"
    default n

choice
    prompt "Clock config"
    default RT_USING_CLK_CONFIG0

    config RT_USING_CLK_CONFIG0
        bool "clk config0: for RK2118M"

    config RT_USING_CLK_CONFIG1
        bool "clk config1: for rk2118BM"

    config RT_USING_CLK_CONFIG2
        bool "clk config2: for rk2118G or RK2118B"

endchoice

config RT_USING_DDR
    bool "using DRAM, only available for RK2118B or RK2118G"
    default n

choice
    prompt "Board Type"
    default RT_USING_BOARD_FPGA

    config RT_USING_BOARD_FPGA
        bool "Enable FPGA board"
        select IS_FPGA

    config RT_USING_BOARD_ADSP_DEMO
        bool "Enable ADSP demo board"

    config RT_USING_BOARD_IOTEST
        bool "Enable io test board"
        select RT_USING_DDR

    config RT_USING_BOARD_SOUNDBAR_CORE
        bool "Enable soundbar core board"
        select RT_USING_DDR

    config RT_USING_BOARD_EVB
        bool "Enable evb board"
        select RT_USING_DDR

    config RT_USING_BOARD_EVB1_V20
        bool "Enable evb1 v20 board"
        select RT_USING_DDR

    config RT_USING_BOARD_EVB3_V10
        bool "Enable evb3 v10 board"
        select RT_USING_DDR

    config RT_USING_BOARD_TEST1
        bool "Enable test1 board"
        select RT_USING_DDR

    config RT_USING_BOARD_AMP_DEMO
        bool "Enable amplifier terminal demo board"

    config RT_USING_BOARD_VEHICLE_DEMO
        bool "Enable vehicle terminal demo board"
endchoice

config RT_USING_HIFI4
    bool "Enable hifi4 driver"
    default n

    if RT_USING_HIFI4
        config RT_USING_HIFI4_FW_BUILTIN
        bool "hifi4 firmware builtin"
        default n
    endif

source "$RTT_DIR/components/hifi4/samples/rk2118/Kconfig"
source "$RTT_DIR/components/hifi4/rtt/app/Kconfig"
source "$RTT_DIR/components/hifi4/rtt/codecs/Kconfig"
source "$RTT_DIR/components/hifi4/rtt/rkstudio_comm/Kconfig"
source "$RTT_DIR/components/hifi4/rtt/rkstudio_parser/Kconfig"
source "$BSP_DIR/../common/fwmgr/Kconfig"
endmenu
```

## rtos/bsp/rockchip/rk2118/drivers/Kconfig
```kconfig
source "$BSP_DIR/../common/drivers/Kconfig"

menu "RT-Thread rockchip RK2118 drivers"

source "$BSP_DIR/drivers/Kconfig.audio"

config RT_USING_CRU
    bool "Enable CRU"
    default n

config RT_USING_DMA
    bool "Enable General DMA Framework"
    default n

if RT_USING_DMA
config RT_USING_DMA_PL330
    bool

config RT_USING_DMA0
    bool "Enable PL330 DMA0 Controller"
    select RT_USING_DMA_PL330
    default n

config RT_USING_DMA1
    bool "Enable PL330 DMA1 Controller"
    select RT_USING_DMA_PL330
    default n

config RT_USING_DMA2
    bool "Enable PL330 DMA2 Controller"
    select RT_USING_DMA_PL330
    default n

config RT_USING_DMA3
    bool "Enable PL330 DMA3 Controller"
    select RT_USING_DMA_PL330
    default n

config RT_USING_DMA4
    bool "Enable PL330 DMA4 Controller"
    select RT_USING_DMA_PL330
    default n
endif

menu "Enable GMAC"
    config RT_USING_GMAC
        bool "Enable GMAC"
        select RT_USING_LWIP
        select RT_LWIP_USING_HW_CHECKSUM
        default n

    if RT_USING_GMAC
    config RT_USING_GMAC0
        bool "Enable GMAC0"
        default n

    config RT_USING_GMAC_PTP
        bool "Enable GMAC PTP"
        select RT_USING_LWIP_PTP
        default n
    endif
endmenu

if RT_USING_I2C
menu "Enable I2C"
    config RT_USING_I2C0
        bool "Enable I2C0"
        default n

    config RT_USING_I2C1
        bool "Enable I2C1"
        default n

    config RT_USING_I2C2
        bool "Enable I2C2"
        default n

    config RT_USING_I2C3
        bool "Enable I2C3"
        default n

    config RT_USING_I2C4
        bool "Enable I2C4"
        default n

    config RT_USING_I2C5
        bool "Enable I2C5"
        default n
endmenu
endif

config RT_USING_OPP
    select RT_USING_TSADC
    bool "Enable OPP"
    default n

config RT_USING_OTP
    bool "Enable OTP"
    default n

if RT_USING_PWM
    config RT_USING_PWM0
        bool "Enable PWM0"
        default n

    config RT_USING_PWM1
        bool "Enable PWM1"
        default n
endif

config RT_USING_SARADC
    select RT_USING_ADC
    bool "Enable SARADC"
    default n

if RT_USING_SDIO
menu "Enable SDIO/SDMMC/eMMC"
    config RT_USING_SDIO0
        bool "Enable SDIO0 controller"
        default n
    config RT_USING_SDIO1
        bool "Enable SDIO1 controller"
        default n
endmenu
endif

if RT_USING_SPI
menu "Enable SPI"
    config RT_USING_SPI2APB
        bool "Enable SPI2APB(SPI0)"
        default n

    config RT_USING_SPI1
        bool "Enable SPI1"
        default n

    config RT_USING_SPI2
        bool "Enable SPI2"
        default n

    config RT_USING_SPI_PM_PERFORMANCE
        bool "Turn off power consumption operation to enhance performance"
        default n

    config RT_USING_SPI_SLAVE_FLEXIBLE_LENGTH
        bool "Support stop SPI slave transmission when cs inactive"
        default n

    if RT_USING_SPI_SLAVE_FLEXIBLE_LENGTH
    menu "Enable SPI Slave flexible length"
        config RT_USING_SLAVE_DMA_RX_BURST_SIZE
            int "Config DMA burst size, the master device on the opposite end needs to complete burst size aligned transmission"
            default 1
    endmenu
    endif
endmenu
endif

config RT_USING_SYSTICK
    bool "Enable SYSTICK"
    default y

config RT_USING_TSADC
    bool "Enable TSADC"
    default n

config RT_USING_TOUCHKEY
    bool "Enable Touchkey"
    default n

menu "Enable UART"
    config RT_USING_UART
        bool "Enable UART"
        default n

    if RT_USING_UART
    config RT_USING_UART0
        bool "Enable UART0"
        default n

    config RT_USING_UART1
        bool "Enable UART1"
        default n

    config RT_USING_UART2
        bool "Enable UART2"
        default n

    config RT_USING_UART3
        bool "Enable UART3"
        default n
    endif
endmenu

config RT_USING_DISPLAY
    bool "Enable Display"
    default n

choice
    prompt "Display Controller"
    depends on RT_USING_DISPLAY

    config RT_USING_VOP
        bool "Enable VOP Composite"
        depends on RT_USING_DISPLAY
        default n
endchoice

choice
    prompt "Display Interface"
    depends on RT_USING_VOP

    config RT_USING_VOP_MCU
        bool "Enable MCU Display Interface"
        default n
endchoice

config RT_USING_RKNPU
    bool "Enable RKNPU"
    default n

config RT_USING_NPOR
    bool "Enable NPOR"
    default n

if RT_USING_USB_HOST
menu "Enable USB HOST"
    config RT_USING_DWC2_USBH
        bool "Enable USB OTG HOST"
        depends on !RT_USING_USB_DEVICE
        default n

    if RT_USING_DWC2_USBH
    config RT_USING_DWC2_USBH0
        bool "Enable USB OTG0 HOST"
        default n
    endif
endmenu
endif

endmenu
```

## rtos/bsp/rockchip/rk2206/Kconfig
```kconfig
mainmenu "RT-Thread Configuration"

config BSP_DIR
    string
    option env="BSP_ROOT"
    default "."

config RTT_DIR
    string
    option env="RTT_ROOT"
    default "../../.."

config PKGS_DIR
    string
    option env="PKGS_ROOT"
    default "packages"

config RKMCU_RK2206
    bool
    select ARCH_ARM_CORTEX_M4
    default y

config PM_HAS_CUSTOM_CONFIG
    bool
    depends on RT_USING_PM
    default y

source "$RTT_DIR/Kconfig"
source "$RTT_DIR/applications/Kconfig"
source "$RTT_DIR/third_party/Kconfig"

menuconfig RT_USING_PKGS
    bool "Enable RT-Thread online packages"

if RT_USING_PKGS
source "$PKGS_DIR/Kconfig"
endif

source "$BSP_DIR/board/Kconfig"
source "$BSP_DIR/drivers/Kconfig"
source "$BSP_DIR/tests/Kconfig"
```

## rtos/bsp/rockchip/rk2206/board/Kconfig
```kconfig
menu "RT-Thread board config"

choice
    prompt "Board Type"
    default RT_USING_BOARD_RK2206_EVB

    config RT_USING_BOARD_RK2206_EVB
        bool "Enable RK2206_EVB board"
endchoice

if RT_USING_BOARD_RK2206_EVB
    source "$BSP_DIR/board/rk2206_evb/Kconfig"
endif

endmenu
```

## rtos/bsp/rockchip/rk2206/board/rk2206_evb/Kconfig
```kconfig
config M4_JTAG_ENABLE
    bool "Enable Cortex M4 JTAG"
    default n
    help
        Select to enable M4F Jtag

config DSP_JTAG_ENABLE
    bool "Enable DSP JTAG"
    default n
```
