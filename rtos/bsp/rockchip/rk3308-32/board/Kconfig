## rtos/bsp/rockchip/rk3506-32/driver/Kconfig
```kconfig
source "$BSP_DIR/../common/drivers/Kconfig"

menu "RT-Thread rockchip RK3506 drivers"

source "$BSP_DIR/driver/Kconfig.audio"
source "$BSP_DIR/../common/fwmgr/Kconfig"

config RT_USING_CRU
    bool "Enable CRU"
    default n

config RT_USING_DMA
    bool "Enable General DMA Framework"
    default n

if RT_USING_DMA
config RT_USING_DMA_PL330
    bool "Enable PL330 DMA Controller"
    default n

config RT_USING_DMA0
    bool "Enable PL330 DMA0 Controller"
    default n

config RT_USING_DMA1
    bool "Enable PL330 DMA1 Controller"
    default n
endif

config RT_USING_DSMC_HOST
    bool "Enable DSMC HOST"
    default n

config RT_USING_DSMC_SLAVE
    bool "Enable DSMC SLAVE"
    default n

config RT_USING_FLEXBUS
    bool "Enable Flexbus"
    default n

if RT_USING_FLEXBUS
config RT_USING_FLEXBUS_ADC
    bool "Enable Flexbus ADC mode"
    select RT_USING_ADC
    select RT_USING_DMA
    default n

config RT_USING_FLEXBUS_DAC
    bool "Enable Flexbus DAC mode"
    select RT_USING_DAC
    select RT_USING_DMA
    default n

config RT_USING_FLEXBUS_SPI
    bool "Enable Flexbus SPI mode"
    default n
endif

menu "Enable GMAC"
    config RT_USING_GMAC
        bool "Enable GMAC"
        select RT_USING_LWIP
        select RT_LWIP_USING_HW_CHECKSUM
        default n

    if RT_USING_GMAC
    config RT_USING_GMAC0
        bool "Enable GMAC0"
        default n

    config RT_USING_GMAC1
        bool "Enable GMAC1"
        default n

    config RT_USING_GMAC_PTP
        bool "Enable GMAC PTP"
        select RT_USING_LWIP_PTP
        default n
    endif
endmenu

if RT_USING_I2C
menu "Enable I2C"
    config RT_USING_I2C0
        bool "Enable I2C0"
        default n

    config RT_USING_I2C1
        bool "Enable I2C1"
        default n

    config RT_USING_I2C2
        bool "Enable I2C2"
        default n
endmenu
endif

config RT_USING_NPOR
    bool "Enable NPOR"
    default n

if RT_USING_PWM
menu "Enable PWM"
    config RT_USING_PWM0
        bool "Enable PWM0"
        default n

    config RT_USING_PWM1
        bool "Enable PWM1"
        default n
endmenu
endif

config RT_USING_SARADC
    select RT_USING_ADC
    bool "Enable SARADC"
    default n

config RT_USING_TOUCHKEY
    bool "Enable TOUCHKEY"
    default n

if RT_USING_SDIO
menu "Enable SDIO/SDMMC/eMMC"
    config RT_USING_SDIO0
        bool "Enable MMC controller"
        default n
endmenu
endif

if RT_USING_SPI
menu "Enable SPI"
    config RT_USING_SPI0
        bool "Enable SPI0"
        default n

    config RT_USING_SPI1
        bool "Enable SPI1"
        default n

    config RT_USING_SPI2APB
        bool "Enable SPI2APB(SPI2)"
        default n
endmenu
endif

config RT_USING_SYSTICK
    bool "Enable SYSTICK"
    default y

config RT_USING_TSADC
    bool "Enable TSADC"
    default n

menu "Enable UART"
    config RT_USING_UART
        bool "Enable UART"
        default y

    if RT_USING_UART
    config RT_USING_UART0
        bool "Enable UART0"
        default n

    config RT_USING_UART1
        bool "Enable UART1"
        default n

    config RT_USING_UART2
        bool "Enable UART2"
        default n

    config RT_USING_UART3
        bool "Enable UART3"
        default n

    config RT_USING_UART4
        bool "Enable UART4"
        default n

    config RT_USING_UART5
        bool "Enable UART5"
        default n

    endif
endmenu

config RT_USING_DISPLAY
    bool "Enable Display"
    default n

choice
    prompt "Display Controller"
    depends on RT_USING_DISPLAY

    config RT_USING_VOP
        bool "Enable VOP Composite"
        depends on RT_USING_DISPLAY
        default n
endchoice

choice
    prompt "Display Interface"
    depends on RT_USING_VOP

    config RT_USING_DW_MIPI_DSI
        bool "Enable MIPI Display Interface"
        default n

    config RT_USING_VOP_RGB
        bool "Enable RGB Display Interface"
        default n

    config RT_USING_VOP_MCU
        bool "Enable MCU Display Interface"
        default n
endchoice

if RT_USING_USB_HOST
menu "Enable USB HOST"
    config RT_USING_DWC2_USBH
        bool "Enable USB OTG HOST"
        default n

    if RT_USING_DWC2_USBH
    config RT_USING_DWC2_USBH0
        bool "Enable USB OTG0 HOST"
        depends on !RT_USING_USB_DEVICE
        default n

    config RT_USING_DWC2_USBH1
        bool "Enable USB OTG1 HOST"
        default n
    endif
endmenu
endif

if RT_USING_DFS_RAMFS
menu "Config RAMFS"
    config RT_DFS_RAMFS_SIZE
    int "Ram filesystem size config"
    default 1048576
endmenu
endif

endmenu
```

## rtos/bsp/rockchip/rk3506-32/driver/Kconfig.audio
```kconfig
if RT_USING_AUDIO
menu "Enable Audio"
    source "$BSP_DIR/../common/drivers/audio/codecs/Kconfig"
    source "$BSP_DIR/../common/drivers/audio/pcm/Kconfig"

    menu "Audio Cards"

    config RT_USING_AUDIO_CARD
        bool "Audio Cards"
        select RT_USING_CODEC
        default n

    config RT_USING_AUDIO_CARD_ACODEC
        bool "Enable Internal acodec audio card"
        depends on RT_USING_AUDIO_CARD
        select RT_USING_ACODEC
        select RT_USING_SAI4
        default n
        help
          Say Y if you want to use internal acodec card
          which support 2ch differential analog mics.

    config RT_USING_AUDIO_CARD_ACDCDIG_DSM
        bool "Enable Internal acdcdig_dsm audio card"
        depends on RT_USING_AUDIO_CARD
        select RT_USING_ACDCDIG_DSM0
        select RT_USING_SAI3
        default n
        help
          Say Y if you want to use internal acodec card
          which support 2ch differential analog mics.

    config RT_USING_AUDIO_CARD_PDM0
        bool "Enable PDM0 Digital audio card"
        depends on RT_USING_AUDIO_CARD
        select RT_USING_PDM0
        default n
        help
          Say Y if you want to use pdm0 digital audio card.

    config RT_USING_AUDIO_CARD_SAI0
        bool "Enable SAI0 Digital audio card"
        depends on RT_USING_AUDIO_CARD
        select RT_USING_SAI0
        default n
        help
          Say Y if you want to use sai0 digital audio card.

    config RT_USING_AUDIO_CARD_SAI1
        bool "Enable SAI1 Digital audio card"
        depends on RT_USING_AUDIO_CARD
        select RT_USING_SAI1
        default n
        help
          Say Y if you want to use sai1 digital audio card.

    config RT_USING_AUDIO_CARD_SAI2
        bool "Enable SAI2 Digital audio card"
        depends on RT_USING_AUDIO_CARD
        select RT_USING_SAI2
        default n
        help
          Say Y if you want to use sai2 digital audio card.

    config RT_USING_AUDIO_CARD_SAI3
        bool "Enable SAI3 Digital audio card"
        depends on RT_USING_AUDIO_CARD
        select RT_USING_SAI3
        default n
        help
          Say Y if you want to use sai3 digital audio card.

    config RT_USING_AUDIO_CARD_SAI4
        bool "Enable SAI4 Digital audio card"
        depends on RT_USING_AUDIO_CARD
        select RT_USING_SAI4
        default n
        help
          Say Y if you want to use sai4 digital audio card.

    config RT_USING_AUDIO_CARD_SPDIFRX0
        bool "Enable SPDIFRX0 Digital audio card"
        depends on RT_USING_AUDIO_CARD
        select RT_USING_SPDIFRX0
        default n
        help
          Say Y if you want to use spdifrx0 digital audio card.

    config RT_USING_AUDIO_CARD_SPDIFTX0
        bool "Enable SPDIFTX0 Digital audio card"
        depends on RT_USING_AUDIO_CARD
        select RT_USING_SPDIFTX0
        default n
        help
          Say Y if you want to use spdiftx0 digital audio card.

    config RT_USING_AUDIO_CARD_ES8388
        bool "Enable ES8388 audio card"
        depends on RT_USING_AUDIO_CARD
        select RT_USING_SAI1
        select RT_USING_CODEC_ES8388
        default n
        help
          Say Y if you want to use es8388 audio card.

    endmenu

    menu "Audio Interfaces"

    config RT_USING_PCM
        bool
        select RT_USING_DMA
        default y

    config RT_USING_MULTI_DAIS
        bool

    config RT_USING_MULTI_PCM
        bool

    config RT_USING_PDM
        bool

    config RT_USING_PDM0
        bool
        select RT_USING_PDM

    config RT_USING_SAI
        bool

    config RT_USING_SAI0
        bool
        select RT_USING_SAI

    config RT_USING_SAI1
        bool
        select RT_USING_SAI

    config RT_USING_SAI2
        bool
        select RT_USING_SAI

    config RT_USING_SAI3
        bool
        select RT_USING_SAI

    config RT_USING_SAI4
        bool
        select RT_USING_SAI

    config RT_USING_SPDIFRX
        bool

    config RT_USING_SPDIFRX0
        bool
        select RT_USING_SPDIFRX

    config RT_USING_SPDIFTX
        bool

    config RT_USING_SPDIFTX0
        bool
        select RT_USING_SPDIFTX

    config RT_USING_ACDCDIG_DSM
        bool

    config RT_USING_ACDCDIG_DSM0
        bool
        select RT_USING_ACDCDIG_DSM

    endmenu

endmenu

endif
```

## rtos/bsp/rockchip/rk3562-32/Image/amp_linux.its
```
/* SPDX-License-Identifier: BSD-3-Clause */
/*
 * Copyright (c) 2023 Rockchip Electronics Co., Ltd.
 */

/dts-v1/;
/ {
	description = "FIT source file for rockchip AMP";
	#address-cells = <1>;

	images {
		amp3 {
			description  = "bare-mental-core3";
			data         = /incbin/("rtt3.bin");
			type         = "firmware";
			compression  = "none";
			arch         = "arm";
			sys          = "rtt";    // "hal" or "rtt"
			cpu          = <0x3>;
			thumb        = <0>;
			hyp          = <0>;
			load         = <0x01800000>;
			udelay       = <10000>;
			hash {
				algo = "sha256";
			};
		};
	};

    share_memory {
        base         = <0x07800000>;
        size         = <0x00400000>;
    };

	configurations {
		default = "conf";
		conf {
			description = "Rockchip AMP images";
			rollback-index = <0x0>;
			loadables = "amp3";
			primary = <0x3>;
			signature {
				algo = "sha256,rsa2048";
				padding = "pss";
				key-name-hint = "dev";
				sign-images = "loadables";
			};

			/* - run linux on cpu0
			 * - it is brought up by amp(that run on U-Boot)
			 * - it is boot entry depends on U-Boot
			 */
			linux {
				description  = "linux-os";
				arch         = "arm64";
				cpu          = <0x000>;
				thumb        = <0>;
				hyp          = <0>;
				udelay       = <0>;
				load         = <0x2000000>; // optional
				load_c       = <0x4880000>; // optional
			};
		};
	};
};
```

## rtos/bsp/rockchip/rk3562-32/board/Kconfig
```kconfig
menu "RT-Thread board config"

config RT_BOARD_NAME
    string "the board name that you use"
    default "rk3562_evb1_lp4x"

source "$BSP_DIR/board/$RT_BOARD_NAME/Kconfig"

endmenu
```

## rtos/bsp/rockchip/rk3562-32/driver/Kconfig
```kconfig
source "$BSP_DIR/../common/drivers/Kconfig"

menu "RT-Thread rockchip RK3562 drivers"

source "$BSP_DIR/driver/Kconfig.audio"

config RT_USING_CRU
    bool "Enable CRU"
    default n

config RT_USING_DMA
    bool "Enable General DMA Framework"
    default n

if RT_USING_DMA
config RT_USING_DMA_PL330
    bool "Enable PL330 DMA Controller"
    default n

config RT_USING_DMA0
    bool "Enable PL330 DMA0 Controller"
    default n
endif

if RT_USING_I2C
menu "Enable I2C"
    config RT_USING_I2C0
        bool "Enable I2C0"
        default n

    config RT_USING_I2C1
        bool "Enable I2C1"
        default n

    config RT_USING_I2C2
        bool "Enable I2C2"
        default n
endmenu
endif

if RT_USING_PWM
config RT_USING_PWM0
    bool "Enable PWM0"
    default n
endif

config RT_USING_MULTI_SARADC
    select RT_USING_ADC
    bool "Enable SARADC"
    default n

if RT_USING_MULTI_SARADC
menu "Enable SARADC"
    config RT_USING_SARADC0
        bool "Enable SARADC0"
        default n

    config RT_USING_SARADC1
        bool "Enable SARADC1"
        default n
endmenu
endif

if RT_USING_SPI
menu "Enable SPI"
    config RT_USING_SPI0
        bool "Enable SPI0"
        default n

    config RT_USING_SPI1
        bool "Enable SPI1"
        default n

    config RT_USING_SPI2
        bool "Enable SPI2"
        default n
endmenu
endif

menu "Enable GMAC"
    config RT_USING_GMAC
        bool "Enable GMAC"
        select RT_USING_LWIP
        select RT_LWIP_USING_HW_CHECKSUM
        default n

    if RT_USING_GMAC
    config RT_USING_GMAC0
        bool "Enable GMAC0"
        default n
    endif
endmenu

config RT_USING_SYSTICK
    bool "Enable SYSTICK"
    default y

config RT_USING_TSADC
    bool "Enable TSADC"
    default n

menu "Enable UART"
    config RT_USING_UART
        bool "Enable UART"
        default y

    if RT_USING_UART
    config RT_USING_UART0
        bool "Enable UART0"
        default y

    config RT_USING_UART1
        bool "Enable UART1"
        default n

    config RT_USING_UART2
        bool "Enable UART2"
        default n

    config RT_USING_UART3
        bool "Enable UART3"
        default n

    config RT_USING_UART4
        bool "Enable UART4"
        default n

    config RT_USING_UART5
        bool "Enable UART5"
        default n

    config RT_USING_UART6
        bool "Enable UART6"
        default n

    config RT_USING_UART7
        bool "Enable UART7"
        default n
    endif
endmenu

endmenu
```

## rtos/bsp/rockchip/rk3562-32/driver/Kconfig.audio
```kconfig
if RT_USING_AUDIO
menu "Enable Audio"
    source "$BSP_DIR/../common/drivers/audio/codecs/Kconfig"
    source "$BSP_DIR/../common/drivers/audio/pcm/Kconfig"

    menu "Audio Cards"

    config RT_USING_AUDIO_CARD
        bool "Audio Cards"
        select RT_USING_CODEC
        default n

    config RT_USING_AUDIO_CARD_SAI0
        bool "Enable SAI0 Digital audio card"
        depends on RT_USING_AUDIO_CARD
        select RT_USING_SAI0
        default n
        help
          Say Y if you want to use sai0 digital audio card.

    config RT_USING_AUDIO_CARD_SAI1
        bool "Enable SAI1 Digital audio card"
        depends on RT_USING_AUDIO_CARD
        select RT_USING_SAI1
        default n
        help
          Say Y if you want to use sai1 digital audio card.

    config RT_USING_AUDIO_CARD_SAI2
        bool "Enable SAI2 Digital audio card"
        depends on RT_USING_AUDIO_CARD
        select RT_USING_SAI2
        default n
        help
          Say Y if you want to use sai2 digital audio card.

    endmenu

    menu "Audio Interfaces"

    config RT_USING_PCM
        bool
        select RT_USING_DMA
        default y

    config RT_USING_MULTI_DAIS
        bool

    config RT_USING_MULTI_PCM
        bool

    config RT_USING_SAI
        bool

    config RT_USING_SAI0
        bool
        select RT_USING_SAI

    config RT_USING_SAI1
        bool
        select RT_USING_SAI

    config RT_USING_SAI2
        bool
        select RT_USING_SAI

    config RT_USING_PDM
        bool

    config RT_USING_PDM0
        bool
        select RT_USING_PDM

    endmenu

endmenu

endif
```

## rtos/bsp/rockchip/rk3562-mcu/Kconfig
```kconfig
mainmenu "RT-Thread Configuration"

config BSP_DIR
    string
    option env="BSP_ROOT"
    default "."

config RTT_DIR
    string
    option env="RTT_ROOT"
    default "../../.."

config PKGS_DIR
    string
    option env="PKGS_ROOT"
    default "packages"

choice
    prompt "RK3562 MCU"
    default HAL_BUS_MCU_CORE

    config HAL_PMU_MCU_CORE
        select ARCH_ARM_CORTEX_M0
        bool "RK3562 MCU of PMU(no cache)"

    config HAL_BUS_MCU_CORE
        select ARCH_ARM_CORTEX_M0
        bool "RK3562 MCU of BUS"
endchoice

source "$RTT_DIR/Kconfig"
source "$BSP_DIR/drivers/Kconfig"
source "$BSP_DIR/board/Kconfig"
#source "$PKGS_DIR/Kconfig"
source "$BSP_DIR/../common/tests/Kconfig"
```
