## rtos/bsp/rockchip/rk3308-32/board/Kconfig
```kconfig
menu "RT-Thread board config"

config RT_BOARD_NAME
    string "the board name that you use"
    default "rk3308_ddr2_v10"

source "$BSP_DIR/board/$RT_BOARD_NAME/Kconfig"

endmenu
```

## rtos/bsp/rockchip/rk3308-32/driver/Kconfig
```kconfig
source "$BSP_DIR/../common/drivers/Kconfig"

menu "RT-Thread rockchip RK3308 drivers"

source "$BSP_DIR/driver/Kconfig.audio"

config RT_USING_CRU
    bool "Enable CRU"
    default n

config RT_USING_DMA
    bool "Enable General DMA Framework"
    default n

if RT_USING_DMA
config RT_USING_DMA_PL330
    bool "Enable PL330 DMA Controller"
    default n

config RT_USING_DMA0
    bool "Enable PL330 DMA0 Controller"
    default n

config RT_USING_DMA1
    bool "Enable PL330 DMA1 Controller"
    default n
endif

if RT_USING_I2C
menu "Enable I2C"
    config RT_USING_I2C0
        bool "Enable I2C0"
        default n

    config RT_USING_I2C1
        bool "Enable I2C1"
        default n

    config RT_USING_I2C2
        bool "Enable I2C2"
        default n
endmenu
endif

if RT_USING_PWM
config RT_USING_PWM0
    bool "Enable PWM0"
    default n
endif

config RT_USING_SARADC
    select RT_USING_ADC
    bool "Enable SARADC"
    default n

if RT_USING_SPI
menu "Enable SPI"
    config RT_USING_SPI0
        bool "Enable SPI0"
        default n

    config RT_USING_SPI1
        bool "Enable SPI1"
        default n

    config RT_USING_SPI2
        bool "Enable SPI2"
        default n
endmenu
endif

if RT_USING_SDIO
menu "Enable SDIO/SDMMC/eMMC"
    config RT_USING_SDIO0
        bool "Enable eMMC controller"
        default n
endmenu
endif

menu "Enable GMAC"
    config RT_USING_GMAC
        bool "Enable GMAC"
        select RT_USING_LWIP
        default n

    if RT_USING_GMAC
    config RT_USING_GMAC0
        bool "Enable GMAC0"
        default n
    endif
endmenu

config RT_USING_SYSTICK
    bool "Enable SYSTICK"
    default y

config RT_USING_TSADC
    bool "Enable TSADC"
    default n

menu "Enable UART"
    config RT_USING_UART
        bool "Enable UART"
        default y

    if RT_USING_UART
    config RT_USING_UART0
        bool "Enable UART0"
        default n

    config RT_USING_UART1
        bool "Enable UART1"
        default n

    config RT_USING_UART2
        bool "Enable UART2"
        default y

    config RT_USING_UART3
        bool "Enable UART3"
        default n

    config RT_USING_UART4
        bool "Enable UART4"
        default n
    endif
endmenu

config RT_USING_DISPLAY
    bool "Enable Display"
    default n

choice
    prompt "Display Controller"
    depends on RT_USING_DISPLAY

    config RT_USING_VOP
        bool "Enable VOP Composite"
        depends on RT_USING_DISPLAY
        default y
endchoice

choice
    prompt "Display Interface"
    depends on RT_USING_VOP

    config RT_USING_VOP_RGB
        bool "Enable RGB Display Interface"
        default y

    config RT_USING_VOP_MCU
        bool "Enable MCU Display Interface"
        default n
endchoice

config RT_USING_SHARE_CONSOLE_OUT
    bool "Enable spinlock for share console output"
    default y

if RT_USING_USB_HOST
menu "Enable USB HOST"
    config RT_USING_DWC2_USBH
        bool "Enable USB OTG HOST"
        depends on !RT_USING_USB_DEVICE
        default n

    if RT_USING_DWC2_USBH
    config RT_USING_DWC2_USBH0
        bool "Enable USB OTG0 HOST"
        default n
    endif

    config RT_USING_USBH_EHCI
        bool "Enable USB2.0 HOST"
        default n

    if RT_USING_USBH_EHCI
    config RT_USING_EHCI_USBH0
        bool "Enable USB EHCI0 HOST"
        default n
    endif

    config RT_USING_USBH_OHCI
        bool "Enable USB1.1 HOST"
        default n

    if RT_USING_USBH_OHCI
    config RT_USING_OHCI_USBH0
        bool "Enable USB OHCI0 HOST"
        default n
    endif
endmenu
endif

endmenu
```

## rtos/bsp/rockchip/rk3358-32/Image/smp.its
```
/* SPDX-License-Identifier: BSD-3-Clause */
/*
 * Copyright (c) 2023 Rockchip Electronics Co., Ltd.
 */

/dts-v1/;
/ {
	description = "FIT source file for rockchip AMP";
	#address-cells = <1>;

	images {

		amp0 {
			description  = "bare-mental-core0";
			data         = /incbin/("rtt0.bin");
			type         = "firmware";
			compression  = "none";
			arch         = "arm";	 // "arm64" or "arm"
			cpu          = <0x000>;  // mpidr
			thumb        = <0>;      // 0: arm or thumb2; 1: thumb
			hyp          = <0>;      // 0: el1/svc; 1: el2/hyp
			load         = <0x02600000>;
			udelay       = <10000>;
			hash {
				algo = "sha256";
			};
		};

	};

	configurations {
		default = "conf";
		conf {
			description = "Rockchip AMP images";
			rollback-index = <0x0>;
			loadables = "amp0";

			signature {
				algo = "sha256,rsa2048";
				padding = "pss";
				key-name-hint = "dev";
				sign-images = "loadables";
			};
		};
	};
};
```

## rtos/bsp/rockchip/rk3358-32/driver/Kconfig
```kconfig
source "$BSP_DIR/../common/drivers/Kconfig"

menu "RT-Thread rockchip RK3358 drivers"

source "$BSP_DIR/driver/Kconfig.audio"

config RT_USING_CRU
    bool "Enable CRU"
    default n

config RT_USING_DMA
    bool "Enable General DMA Framework"
    default n

if RT_USING_DMA
config RT_USING_DMA_PL330
    bool "Enable PL330 DMA Controller"
    default n

config RT_USING_DMA0
    bool "Enable PL330 DMA0 Controller"
    default n

config RT_USING_DMA1
    bool "Enable PL330 DMA1 Controller"
    default n
endif

if RT_USING_I2C
menu "Enable I2C"
    config RT_USING_I2C0
        bool "Enable I2C0"
        default n

    config RT_USING_I2C1
        bool "Enable I2C1"
        default n

    config RT_USING_I2C2
        bool "Enable I2C2"
        default n
endmenu
endif

if RT_USING_PWM
config RT_USING_PWM0
    bool "Enable PWM0"
    default n
endif

config RT_USING_SARADC
    select RT_USING_ADC
    bool "Enable SARADC"
    default n

if RT_USING_SPI
menu "Enable SPI"
    config RT_USING_SPI0
        bool "Enable SPI0"
        default n

    config RT_USING_SPI1
        bool "Enable SPI1"
        default n

    config RT_USING_SPI2
        bool "Enable SPI2"
        default n
endmenu
endif

config RT_USING_SYSTICK
    bool "Enable SYSTICK"
    default y

config RT_USING_TSADC
    bool "Enable TSADC"
    default n

menu "Enable UART"
    config RT_USING_UART
        bool "Enable UART"
        default y

    if RT_USING_UART
    config RT_USING_UART2
        bool "Enable UART2"
        default y

    config RT_USING_UART4
        bool "Enable UART4"
        default n
    endif
endmenu

if RT_USING_USB_HOST
menu "Enable USB HOST"
    config RT_USING_DWC2_USBH
        bool "Enable USB OTG HOST"
        depends on !RT_USING_USB_DEVICE
        default n

    if RT_USING_DWC2_USBH
    config RT_USING_DWC2_USBH0
        bool "Enable USB OTG0 HOST"
        default n
    endif
endmenu
endif

endmenu
```

## rtos/bsp/rockchip/rk3358-32/driver/Kconfig.audio
```kconfig
if RT_USING_AUDIO
menu "Enable Audio"
    source "$BSP_DIR/../common/drivers/audio/codecs/Kconfig"
    source "$BSP_DIR/../common/drivers/audio/pcm/Kconfig"

    menu "Audio Cards"

    config RT_USING_AUDIO_CARD
        bool "Audio Cards"
        select RT_USING_CODEC
        default n

    config RT_USING_AUDIO_CARD_ACODEC
        bool "Enable Internal acodec audio card"
        depends on RT_USING_AUDIO_CARD
        select RT_USING_ACODEC
        select RT_USING_I2STDM2
        default n
        help
          Say Y if you want to use internal acodec card
          which support 8ch differential analog mics
          and stereo analog output.

    config RT_USING_AUDIO_CARD_I2S0
        bool "Enable I2S0 Digital audio card"
        depends on RT_USING_AUDIO_CARD
        select RT_USING_I2STDM0
        default n
        help
          Say Y if you want to use i2s0 digital audio card.

    config RT_USING_AUDIO_CARD_I2S1
        bool "Enable I2S1 Digital audio card"
        depends on RT_USING_AUDIO_CARD
        select RT_USING_I2STDM1
        default n
        help
          Say Y if you want to use i2s1 digital audio card.

    endmenu

    menu "Audio Interfaces"

    config RT_USING_PCM
        bool
        select RT_USING_DMA
        default y

    config RT_USING_MULTI_DAIS
        bool

    config RT_USING_MULTI_PCM
        bool

    config RT_USING_I2STDM
        bool

    config RT_USING_I2STDM0
        bool
        select RT_USING_I2STDM

    config RT_USING_I2STDM1
        bool
        select RT_USING_I2STDM

    config RT_USING_I2STDM2
        bool
        select RT_USING_I2STDM

    config RT_USING_PDM
        bool

    config RT_USING_PDM0
        bool
        select RT_USING_PDM

    config RT_USING_VAD
        bool "Enable VAD"
        default n

    endmenu

endmenu

endif
```

## rtos/bsp/rockchip/rk3506-32/Image/amp_linux.its
```
/* SPDX-License-Identifier: BSD-3-Clause */
/*
 * Copyright (c) 2024 Rockchip Electronics Co., Ltd.
 */

/dts-v1/;
/ {
	description = "FIT source file for rockchip AMP";
	#address-cells = <1>;

	images {
		amp2 {
			description  = "rtos-core2";
			data         = /incbin/("rtt2.bin");
			type         = "firmware";
			compression  = "none";
			arch         = "arm";	 // "arm64" or "arm"
			cpu          = <0xf02>;  // mpidr
			thumb        = <0>;      // 0: arm or thumb2; 1: thumb
			hyp          = <0>;      // 0: el1/svc; 1: el2/hyp
			load         = <0x03e00000>;
			size         = <0x00100000>;
			srambase     = <0xfff80000>;
			sramsize     = <0x0000c000>;
			udelay       = <10000>;
			hash {
				algo = "sha256";
			};
		};
	};

	configurations {
		default = "conf";
		conf {
			description = "Rockchip AMP images";
			rollback-index = <0x0>;
			loadables = "amp2";

			signature {
				algo = "sha256,rsa2048";
				padding = "pss";
				key-name-hint = "dev";
				sign-images = "loadables";
			};

			/* - run linux on cpu0
			 * - it is brought up by amp(that run on U-Boot)
			 * - it is boot entry depends on U-Boot
                         */
			linux {
				description  = "linux-os";
				arch         = "arm";
				cpu          = <0xf00>;
				thumb        = <0>;
				hyp          = <0>;
				load         = <0x00900000>;     // 0x00900000-0x00d00000, kernel must be package in fit image.
				udelay       = <0>;
			};
		};
	};
};
```

## rtos/bsp/rockchip/rk3506-32/Image/smp.its
```
/*
 * Copyright (C) 2020 Rockchip Electronic Co.,Ltd
 *
 * Simple U-boot fit source file containing ATF/OP-TEE/U-Boot/dtb/MCU
 */

/dts-v1/;

/ {
	description = "FIT Image with RT-thread";
	#address-cells = <1>;

	images {

		amp0 {
			description = "rtos-smp";
			data = /incbin/("rtt0.bin");
			type = "firmware";
                        compression  = "none";
			arch = "arm";
			os = "rtos";
                        cpu = <0xf00>;  // mpidr
                        thumb = <0>;    // 0: arm or thumb2; 1: thumb
                        hyp = <0>;      // 0: el1/svc; 1: el2/hyp
			load = <0x03900000>;
			udelay = <10000>;
			hash {
				algo = "sha256";
			};
		};
	};

	configurations {
		default = "conf";
		conf {
			description = "RK3506-rtt-smp";
			loadables = "amp0";

			signature {
				algo = "sha256,rsa2048";
                                padding = "pss";
				key-name-hint = "dev";
				sign-images = "loadables";
			};
		};
	};
};
```

## rtos/bsp/rockchip/rk3506-32/Kconfig
```kconfig
mainmenu "RT-Thread Project Configuration"

config BSP_DIR
    string
    option env="BSP_ROOT"
    default "."

config RTT_DIR
    string
    option env="RTT_ROOT"
    default "../../.."

source "$RTT_DIR/Kconfig"

config BSP_RK3506
    bool
    select ARCH_ARM_CORTEX_A
    select RT_USING_GIC_V2
    select RT_USING_COMPONENTS_INIT
    select RT_USING_USER_MAIN
    select RT_USING_FPU
    select RT_USING_CPU_FFS
    default y

config RT_USING_FPU
    bool

source "$BSP_DIR/board/Kconfig"
source "$BSP_DIR/driver/Kconfig"
source "$BSP_DIR/tests/Kconfig"
source "$RTT_DIR/applications/Kconfig"
```

## rtos/bsp/rockchip/rk3506-32/board/Kconfig
```kconfig
menu "RT-Thread board config"

config RT_BOARD_NAME
    string "the board name that you use"
    default "rk3506_fpga"

source "$BSP_DIR/board/$RT_BOARD_NAME/Kconfig"

endmenu
```
