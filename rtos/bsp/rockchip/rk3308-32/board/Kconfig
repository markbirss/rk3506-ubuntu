## rtos/bsp/rockchip/rk3562-mcu/drivers/Kconfig
```kconfig
source "$BSP_DIR/../common/drivers/Kconfig"

menu "RT-Thread rockchip rk3562_mcu drivers"

config RT_USING_CRU
    bool "Enable CRU"
    default n

menu "Enable UART"
    config RT_USING_UART
        bool "Enable UART"
        default n

    if RT_USING_UART
    config RT_USING_UART0
        bool "Enable UART0"
        default n
    config RT_USING_UART2
        bool "Enable UART2"
        default n
    config RT_USING_UART5
        bool "Enable UART5"
        default n
    config RT_USING_UART7
        bool "Enable UART7"
        default n
    endif
endmenu

config RT_USING_I2C0
    bool "Enable I2C0"
    select RT_USING_I2C
    default n

config RT_USING_MULTI_SARADC
    select RT_USING_ADC
    bool "Enable SARADC"
    default n

if RT_USING_SPI
menu "Enable SPI"
    config RT_USING_SPI0
        bool "Enable SPI0"
        default n
endmenu
endif

if RT_USING_PWM
menu "Enable PWM"
    config RT_USING_PWM0
        bool "Enable PWM0"
        default n

    config RT_USING_PWM1
        bool "Enable PWM1"
        default n

    config RT_USING_PWM2
        bool "Enable PWM2"
        default n

    config RT_USING_PWM3
        bool "Enable PWM3"
        default n
endmenu
endif

endmenu
```

## rtos/bsp/rockchip/rk3568-32/Kconfig
```kconfig
mainmenu "RT-Thread Project Configuration"

config BSP_DIR
    string
    option env="BSP_ROOT"
    default "."

config RTT_DIR
    string
    option env="RTT_ROOT"
    default "../../.."

source "$RTT_DIR/Kconfig"

config BSP_RK3568
    bool
    select ARCH_ARMV8
    select ARCH_ARM_CORTEX_A
    select RT_USING_GIC_V3
    select RT_USING_COMPONENTS_INIT
    select RT_USING_USER_MAIN
    select RT_USING_FPU
    select RT_USING_CPU_FFS
    default y

config ARCH_ARMV8
    bool

config RT_USING_FPU
    bool

source "$BSP_DIR/board/Kconfig"
source "$BSP_DIR/driver/Kconfig"
source "$BSP_DIR/tests/Kconfig"
source "$RTT_DIR/third_party/Kconfig"
```

## rtos/bsp/rockchip/rk3568-32/driver/Kconfig
```kconfig
source "$BSP_DIR/../common/drivers/Kconfig"

menu "RT-Thread rockchip RK3568 drivers"

source "$BSP_DIR/driver/Kconfig.audio"

config RT_USING_CACHE_ECC
    bool "Enable Cache ECC"
    default n

menu "Enable CAN"
    config RT_USING_CAN
        bool "Enable CAN"
        default n

    if RT_USING_CAN
    config RT_USING_CAN1
        bool "Enable CAN1"
        default n
    endif
endmenu

config RT_USING_CRU
    bool "Enable CRU"
    default n

menu "Enable GMAC"
    config RT_USING_GMAC
        bool "Enable GMAC"
        select RT_USING_LWIP
        default n

    if RT_USING_GMAC
    config RT_USING_GMAC0
        bool "Enable GMAC0"
        default n
    config RT_USING_GMAC1
        bool "Enable GMAC1"
        default n
    endif
endmenu

config RT_USING_DMA
    bool "Enable General DMA Framework"
    default n

if RT_USING_DMA
config RT_USING_DMA_PL330
    bool "Enable PL330 DMA Controller"
    default n

config RT_USING_DMA0
    bool "Enable PL330 DMA0 Controller"
    default n

config RT_USING_DMA1
    bool "Enable PL330 DMA1 Controller"
    default n
endif

config RT_USING_I2C0
    bool "Enable I2C0"
    select RT_USING_I2C
    default n

config RT_USING_SYSTICK
    bool "Enable SYSTICK"
    default y

menu "Enable UART"
    config RT_USING_UART
        bool "Enable UART"
        default y

    if RT_USING_UART
    config RT_USING_UART2
        bool "Enable UART2"
        default y

    config RT_USING_UART4
        bool "Enable UART4"
        default n
    endif
endmenu

if RT_USING_SDIO
menu "Enable SDIO/SDMMC/eMMC"
    config RT_USING_SDIO0
        bool "Enable SDIO controller"
        default n
endmenu
endif

config RT_USING_DW_PCIE
    bool "Enable DW PCIE"
    default n

config RT_USING_PCIE_DMA
    bool "Enable PCIE DMA"
    default n

config RT_USING_WITH_LINUX
    bool "Enable USING WITH LINUX"
    default n

if RT_USING_PWM
menu "Enable PWM"
    config RT_USING_PWM0
        bool "Enable PWM0"
        default n

    config RT_USING_PWM1
        bool "Enable PWM1"
        default n

    config RT_USING_PWM2
        bool "Enable PWM2"
        default n

    config RT_USING_PWM3
        bool "Enable PWM3"
        default n
endmenu
endif

if RT_USING_USB_HOST
menu "Enable USB HOST"
    config RT_USING_USBH_EHCI
        bool "Enable USB2.0 HOST"
        default n

    if RT_USING_USBH_EHCI
    config RT_USING_EHCI_USBH0
        bool "Enable USB EHCI0 HOST"
        default n
    config RT_USING_EHCI_USBH1
        bool "Enable USB EHCI1 HOST"
        default n
    endif

    config RT_USING_USBH_OHCI
        bool "Enable USB1.1 HOST"
        default n

    if RT_USING_USBH_OHCI
    config RT_USING_OHCI_USBH0
        bool "Enable USB OHCI0 HOST"
        default n
    config RT_USING_OHCI_USBH1
        bool "Enable USB OHCI1 HOST"
        default n
    endif
endmenu
endif

config RT_USING_DISPLAY
    bool "Enable Display"
    default n

choice
    prompt "Display Controller"
    depends on RT_USING_DISPLAY

    config RT_USING_VOP2
        bool "Enable VOP2 Composite"
        depends on RT_USING_DISPLAY
        default n
endchoice

choice
    prompt "WFD Board Config"
    depends on RT_USING_DISPLAY

    config RT_USING_WFD_RK3568_EVB1
        bool "Using wfd board config rk3568_evb1.c"
        depends on RT_USING_VOP2
        default n
endchoice

endmenu
```

## rtos/bsp/rockchip/rk3568-mcu/Kconfig
```kconfig
mainmenu "RT-Thread Configuration"

config BSP_DIR
    string
    option env="BSP_ROOT"
    default "."

config RTT_DIR
    string
    option env="RTT_ROOT"
    default "../../.."

config PKGS_DIR
    string
    option env="PKGS_ROOT"
    default "packages"

config SOC_RK3568
    bool

config BOARD_RK3568_RISCV_EVB
    bool
    select ARCH_RISCV
    select SOC_RK3568
    default y

source "$RTT_DIR/Kconfig"
source "$BSP_DIR/board/Kconfig"
source "$BSP_DIR/drivers/Kconfig"
source "$BSP_DIR/../common/tests/Kconfig"
```

## rtos/bsp/rockchip/rk3568-mcu/board/Kconfig
```kconfig
menu "RT-Thread board config"

config RT_BOARD_NAME
    string "the board name of you use"
    default "rk3568_evb"

source "$BSP_DIR/board/$RT_BOARD_NAME/Kconfig"

endmenu
```

## rtos/bsp/rockchip/rk3576-64/Image/amp.its
```
/* SPDX-License-Identifier: BSD-3-Clause */
/*
 * Copyright (c) 2023 Rockchip Electronics Co., Ltd.
 */

/dts-v1/;
/ {
	description = "FIT source file for rockchip AMP";
	#address-cells = <1>;

	images {

		amp0 {
			description  = "bare-mental-core0";
			data         = /incbin/("rtt0.bin");
			type         = "firmware";
			compression  = "none";
			arch         = "arm64";	 // "arm64" or "arm"
			cpu          = <0x000>;  // mpidr
			thumb        = <0>;      // 0: arm or thumb2; 1: thumb
			hyp          = <0>;      // 0: el1/svc; 1: el2/hyp
			load         = <0x44000000>;
			size         = <0x00800000>;
			srambase     = <0xff000000>;
			sramsize     = <0x00100000>;
			udelay       = <10000>;
			hash {
				algo = "sha256";
			};
		};

		amp1 {
			description  = "bare-mental-core1";
			data         = /incbin/("rtt1.bin");
			type         = "firmware";
			compression  = "none";
			arch         = "arm64";	 // "arm64" or "arm"
			cpu          = <0x100>;  // mpidr
			thumb        = <0>;      // 0: arm or thumb2; 1: thumb
			hyp          = <0>;      // 0: el1/svc; 1: el2/hyp
			load         = <0x00800000>;
			size         = <0x00800000>;
			srambase     = <0xff000000>;
			sramsize     = <0x00100000>;
			udelay       = <10000>;
			hash {
				algo = "sha256";
			};
		};

		amp2 {
			description  = "bare-mental-core2";
			data         = /incbin/("rtt2.bin");
			type         = "firmware";
			compression  = "none";
			arch         = "arm64";	 // "arm64" or "arm"
			cpu          = <0x200>;  // mpidr
			thumb        = <0>;      // 0: arm or thumb2; 1: thumb
			hyp          = <0>;      // 0: el1/svc; 1: el2/hyp
			load         = <0x01000000>;
			size         = <0x00800000>;
			srambase     = <0xff000000>;
			sramsize     = <0x00100000>;
			udelay       = <10000>;
			hash {
				algo = "sha256";
			};
		};

		amp3 {
			description  = "bare-mental-core3";
			data         = /incbin/("rtt3.bin");
			type         = "firmware";
			compression  = "none";
			arch         = "arm64";	 // "arm64" or "arm"
			cpu          = <0x300>;  // mpidr
			thumb        = <0>;      // 0: arm or thumb2; 1: thumb
			hyp          = <0>;      // 0: el1/svc; 1: el2/hyp
			load         = <0x01800000>;
			size         = <0x00800000>;
			srambase     = <0xff000000>;
			sramsize     = <0x00100000>;
			udelay       = <10000>;
			hash {
				algo = "sha256";
			};
		};

		amp4 {
			description  = "bare-mental-core4";
			data         = /incbin/("rtt4.bin");
			type         = "firmware";
			compression  = "none";
			arch         = "arm64";	 // "arm64" or "arm"
			cpu          = <0x400>;  // mpidr
			thumb        = <0>;      // 0: arm or thumb2; 1: thumb
			hyp          = <0>;      // 0: el1/svc; 1: el2/hyp
			load         = <0x02000000>;
			size         = <0x00800000>;
			srambase     = <0xff000000>;
			sramsize     = <0x00100000>;
			udelay       = <10000>;
			hash {
				algo = "sha256";
			};
		};

		amp5 {
			description  = "bare-mental-core5";
			data         = /incbin/("rtt5.bin");
			type         = "firmware";
			compression  = "none";
			arch         = "arm64";	 // "arm64" or "arm"
			cpu          = <0x500>;  // mpidr
			thumb        = <0>;      // 0: arm or thumb2; 1: thumb
			hyp          = <0>;      // 0: el1/svc; 1: el2/hyp
			load         = <0x02800000>;
			size         = <0x00800000>;
			srambase     = <0xff000000>;
			sramsize     = <0x00100000>;
			udelay       = <10000>;
			hash {
				algo = "sha256";
			};
		};

		amp6 {
			description  = "bare-mental-core6";
			data         = /incbin/("rtt6.bin");
			type         = "firmware";
			compression  = "none";
			arch         = "arm64";	 // "arm64" or "arm"
			cpu          = <0x600>;  // mpidr
			thumb        = <0>;      // 0: arm or thumb2; 1: thumb
			hyp          = <0>;      // 0: el1/svc; 1: el2/hyp
			load         = <0x03000000>;
			size         = <0x00800000>;
			srambase     = <0xff000000>;
			sramsize     = <0x00100000>;
			udelay       = <10000>;
			hash {
				algo = "sha256";
			};
		};

		amp7 {
			description  = "bare-mental-core7";
			data         = /incbin/("rtt7.bin");
			type         = "firmware";
			compression  = "none";
			arch         = "arm64";	 // "arm64" or "arm"
			cpu          = <0x700>;  // mpidr
			thumb        = <0>;      // 0: arm or thumb2; 1: thumb
			hyp          = <0>;      // 0: el1/svc; 1: el2/hyp
			load         = <0x03800000>;
			size         = <0x00800000>;
			srambase     = <0xff000000>;
			sramsize     = <0x00100000>;
			udelay       = <10000>;
			hash {
				algo = "sha256";
			};
		};

	};

	share_memory {
		base         = <0x07800000>;
		size         = <0x00400000>;
	};

	configurations {
		default = "conf";
		conf {
			description = "Rockchip AMP images";
			rollback-index = <0x0>;
			loadables = "amp0", "amp1", "amp2", "amp3", "amp4", "amp5", "amp6", "amp7";

			signature {
				algo = "sha256,rsa2048";
				padding = "pss";
				key-name-hint = "dev";
				sign-images = "loadables";
			};
		};
	};
};
```

## rtos/bsp/rockchip/rk3576-64/driver/Kconfig
```kconfig
source "$BSP_DIR/../common/drivers/Kconfig"

menu "RT-Thread rockchip RK3576 drivers"

config RT_USING_CACHE_ECC
    bool "Enable Cache ECC"
    default n

menu "Enable CAN"
    config RT_USING_CAN
        bool "Enable CAN"
        default n

    if RT_USING_CAN
    config RT_USING_CAN1
        bool "Enable CAN1"
        default n
    endif
endmenu

config RT_USING_CRU
    bool "Enable CRU"
    default n

config RT_USING_DMA
    bool "Enable General DMA Framework"
    default n

if RT_USING_DMA
config RT_USING_DMA_PL330
    bool "Enable PL330 DMA Controller"
    default n

config RT_USING_DMA0
    bool "Enable PL330 DMA0 Controller"
    default n

config RT_USING_DMA1
    bool "Enable PL330 DMA1 Controller"
    default n
endif

menu "Enable GMAC"
    config RT_USING_GMAC
        bool "Enable GMAC"
        select RT_USING_LWIP
        default n

    if RT_USING_GMAC
    config RT_USING_GMAC0
        bool "Enable GMAC0"
        default n
    config RT_USING_GMAC1
        bool "Enable GMAC1"
        default n
    endif
endmenu

config RT_USING_PMU
    bool "Enable PMU"
    default y

if RT_USING_PWM
menu "Enable PWM"
    config RT_USING_PWM0
        bool "Enable PWM0"
        default n

    config RT_USING_PWM1
        bool "Enable PWM1"
        default n

    config RT_USING_PWM2
        bool "Enable PWM2"
        default n

    config RT_USING_PWM3
        bool "Enable PWM3"
        default n
endmenu
endif

config RT_USING_SYSTICK
    bool "Enable SYSTICK"
    default y

menu "Enable UART"
    config RT_USING_UART
        bool "Enable UART"
        default y

    if RT_USING_UART
    config RT_USING_UART0
        bool "Enable UART0"
        default n

    config RT_USING_UART5
        bool "Enable UART5"
        default n
    endif
endmenu

if RT_USING_SPI
menu "Enable SPI"
    config RT_USING_SPI0
        bool "Enable SPI0"
        default n

    config RT_USING_SPI1
        bool "Enable SPI1"
        default n

    config RT_USING_SPI2
        bool "Enable SPI2"
        default n

    config RT_USING_SPI3
        bool "Enable SPI3"
        default n

    config RT_USING_SPI4
        bool "Enable SPI4"
        default n
endmenu
endif

config RT_USING_DW_PCIE
    bool "Enable DW PCIE"
    default n

config RT_USING_PCIE_DMA
    bool "Enable PCIE DMA"
    default n

menu "Enable Audio Card"
    config RT_USING_AUDIO_CARD_I2S0_8CH
       bool "Enable TDM0 Digital audio card"
       select RT_USING_I2STDM0
       default n

    config RT_USING_AUDIO_CARD_I2S1_8CH
       bool "Enable TDM1 Digital audio card"
       select RT_USING_I2STDM1
       default n

menu "Audio Interfaces"
    config RT_USING_I2STDM
        bool

    config RT_USING_I2STDM0
        bool
        select RT_USING_I2STDM

    config RT_USING_I2STDM1
        bool
        select RT_USING_I2STDM

    config RT_USING_PCM
        bool
        select RT_USING_DMA
endmenu
endmenu
endmenu
```
