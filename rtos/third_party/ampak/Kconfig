## rtos/third_party/ampak/Kconfig
```kconfig
menuconfig RT_USING_AMPAK
bool "Enable Ampak WiFi Modules"
default n

if RT_USING_AMPAK
	config RT_AMPAK_WIFI
	bool "Enable Ampak WiFi Module Driver"
		default y
		select RT_WLAN_PROT_LWIP_ENABLE
		select RT_WLAN_PROT_LWIP_PBUF_FORCE
		select RT_USING_SDIO
		select RT_USING_SDIO0
		select RT_USING_DMA
	if RT_AMPAK_WIFI
	choice
		prompt "Ampak WiFi Module Selection"
		default RT_USING_WLAN_SIP_AP6212A

		config RT_USING_WLAN_SIP_AP6212A
			 bool "AP6212A"

		config RT_USING_WLAN_SIP_AP6214A
			 bool "AP6214A"

		config RT_USING_WLAN_SIP_AP6256
			bool "AP6256"

		config RT_USING_WLAN_SIP_AP6203
			bool "AP6203"
	endchoice
	
	config RT_USING_MHD_MFG_TEST
	bool "Select MFG FW Test Feature"
	default n

	endif
endif
```

## yocto/build/conf/bblayers.conf
```bitbake
# POKY_BBLAYERS_CONF_VERSION is increased each time build/conf/bblayers.conf
# changes incompatibly
POKY_BBLAYERS_CONF_VERSION = "2"

BBPATH = "${TOPDIR}"
BBFILES ?= ""

BBLAYERS ?= " \
  ${TOPDIR}/../meta-openembedded/meta-oe \
  ${TOPDIR}/../meta-openembedded/meta-python \
  ${TOPDIR}/../meta-openembedded/meta-networking \
  ${TOPDIR}/../meta-openembedded/meta-multimedia \
  ${TOPDIR}/../meta-browser/meta-chromium \
  ${TOPDIR}/../meta-clang \
  ${TOPDIR}/../meta-rockchip \
  ${TOPDIR}/../poky/meta \
  ${TOPDIR}/../poky/meta-poky \
  ${TOPDIR}/../poky/meta-yocto-bsp \
"
```
